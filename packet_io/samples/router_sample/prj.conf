## CMakeLists.txt
```
# Packet Router Sample

cmake_minimum_required(VERSION 3.20.0)

find_package(Zephyr REQUIRED HINTS $ENV{ZEPHYR_BASE})
project(packet_router_sample)

# Include directories for the router library and application
target_include_directories(app PRIVATE
  src
)

# Source files
target_sources(app PRIVATE
  # Generic router framework
  src/framework/packet_router.c

  # Protocol implementations
  src/protocols/iotsense_router.c

  # Application modules
  src/modules/tcp_server.c
  src/modules/temperature_sensor.c
  src/modules/system_control.c
  src/modules/led_controller.c

  # Main application
  src/main.c
)

# Add linker script fragment for router iterable sections
zephyr_linker_sources(SECTIONS sections-rom.ld)
```

## prj.conf
```kconfig
# Packet Router Sample Configuration
# Platform-agnostic configuration - works on any board with networking

# Core Requirements
# =================
CONFIG_NET_BUF=y           # Network buffer support
CONFIG_PACKET_IO=y         # Packet I/O subsystem
CONFIG_LOG=y               # Logging support
CONFIG_ASSERT=y            # Runtime assertions
CONFIG_POLL=y              # k_poll support for event processing

# Packet I/O Configuration
# ========================
CONFIG_PACKET_IO_STATS=y       # Enable statistics tracking
CONFIG_PACKET_IO_NAMES=y       # Enable debug names
CONFIG_PACKET_IO_LOG_LEVEL=2   # Info level logging

# Networking Stack
# ================
CONFIG_NETWORKING=y             # Enable networking subsystem
CONFIG_NET_IPV4=y              # IPv4 support
CONFIG_NET_TCP=y               # TCP protocol support
CONFIG_NET_SOCKETS=y           # BSD socket API
CONFIG_NET_SOCKETS_POSIX_NAMES=y  # Use standard socket names

# Network Configuration
# =====================
CONFIG_NET_CONFIG_SETTINGS=y    # Enable network configuration
CONFIG_NET_CONFIG_AUTO_INIT=y   # Auto-initialize network

# Default IP configuration (overridden by board configs)
CONFIG_NET_CONFIG_MY_IPV4_ADDR="127.0.0.1"
CONFIG_NET_CONFIG_PEER_IPV4_ADDR="127.0.0.1"

# Network Buffers
# ===============
CONFIG_NET_PKT_RX_COUNT=10      # RX packet count
CONFIG_NET_PKT_TX_COUNT=10      # TX packet count
CONFIG_NET_BUF_RX_COUNT=20      # RX buffer count
CONFIG_NET_BUF_TX_COUNT=20      # TX buffer count

# Thread Configuration
# ====================
CONFIG_MAIN_STACK_SIZE=4096     # Main thread stack size
CONFIG_MAIN_THREAD_PRIORITY=7   # Main thread priority
CONFIG_SYSTEM_WORKQUEUE_STACK_SIZE=2048  # System workqueue stack

# Timing & Scheduling
# ===================
CONFIG_TIMESLICING=y            # Enable time slicing
CONFIG_TIMESLICE_SIZE=10        # Time slice duration (ms)
CONFIG_TIMESLICE_PRIORITY=0    # Time slice priority threshold

# Logging Configuration
# =====================
CONFIG_LOG_MODE_DEFERRED=y      # Deferred logging for performance
CONFIG_LOG_BUFFER_SIZE=2048     # Log buffer size

# Memory Management
# =================
CONFIG_HEAP_MEM_POOL_SIZE=8192  # Heap size for dynamic allocation

# Application Features
# ====================
CONFIG_CRC=y                    # CRC32 for protocol integrity
CONFIG_TEST_RANDOM_GENERATOR=y  # Random numbers for sensor simulation
CONFIG_REBOOT=y                 # System reboot capability
```

## overlay-native.conf
```kconfig
# Native POSIX socket configuration for native_sim
# This allows the sample to use host sockets directly

# Disable the ethernet driver and use native sockets
CONFIG_ETH_NATIVE_POSIX=n
CONFIG_NET_LOOPBACK=n

# Enable native socket offload
CONFIG_NET_DRIVERS=y
CONFIG_NET_SOCKETS=y
CONFIG_NET_SOCKETS_OFFLOAD=y
CONFIG_NET_NATIVE_OFFLOADED_SOCKETS=y

# IPv6 DAD requires lower level network interface access
CONFIG_NET_IPV6_DAD=n

# Use real host IP addresses
CONFIG_NET_CONFIG_MY_IPV4_ADDR="0.0.0.0"
CONFIG_NET_CONFIG_PEER_IPV4_ADDR=""

# Additional heap for socket operations
CONFIG_HEAP_MEM_POOL_SIZE=16384
```

## src/main.c
```c
/* Packet Router Sample
 * Demonstrates IoTSense protocol routing with modular architecture
 */

#include <stdlib.h>
#include <zephyr/kernel.h>
#include <zephyr/logging/log.h>
#include <zephyr/packet_io/packet_io.h>

#include "protocols/iotsense_router.h"
#include "modules/led_controller.h"
#include "modules/system_control.h"
#include "modules/tcp_server.h"
#include "modules/temperature_sensor.h"

LOG_MODULE_REGISTER(main, LOG_LEVEL_INF);

/* Packet type registrations */

/* Temperature sensor - outbound only */
ROUTER_OUTBOUND_ROUTE_DEFINE(iotsense_router, PKT_ID_SENSOR_TEMP, temperature_sensor_source);

/* System control - bidirectional */
ROUTER_OUTBOUND_ROUTE_DEFINE(iotsense_router, PKT_ID_SYSTEM_CONFIG, system_control_source);
ROUTER_INBOUND_ROUTE_DEFINE(iotsense_router, PKT_ID_SYSTEM_CONFIG, system_control_sink);

/* LED controller - inbound only */
ROUTER_INBOUND_ROUTE_DEFINE(iotsense_router, PKT_ID_ACTUATOR_LED, led_controller_sink);

/* Network connections */
PACKET_CONNECT(&tcp_server_source, &iotsense_router.network_sink);
PACKET_CONNECT(&iotsense_router.network_source, &tcp_server_sink);

/* Statistics reporting thread */
static void stats_thread(void *p1, void *p2, void *p3)
{
	struct router_stats stats;

	ARG_UNUSED(p1);
	ARG_UNUSED(p2);
	ARG_UNUSED(p3);

	while (1) {
		k_sleep(K_SECONDS(30));

		LOG_INF("System status:");

#ifdef CONFIG_PACKET_IO_STATS
		router_get_stats(&iotsense_router, &stats);
		LOG_INF("Router: in=%u out=%u unknown=%u errors=%u buffers=%u",
			stats.inbound_packets, stats.outbound_packets, stats.unknown_packet_ids,
			stats.parse_errors, stats.buffer_errors);
#endif
	}
}

K_THREAD_DEFINE(stats_tid, 1024, stats_thread, NULL, NULL, NULL, 9, 0, 0);
```

## src/iotsense_router.c
```c
/*
 * IoTSense Router Implementation
 *
 * Protocol-specific router for IoTSense packets.
 * Handles packet routing with simplified 4-byte headers.
 */

#include "iotsense_router.h"
#include "lib/packet_router.h"
#include <zephyr/kernel.h>
#include <zephyr/logging/log.h>
#include <zephyr/net/buf.h>

LOG_MODULE_REGISTER(iotsense_router, LOG_LEVEL_INF);

/* Protocol constants */
#define IOTSENSE_VERSION 0x01 /* v1.0 simplified */
#define IOTSENSE_HEADER_SIZE sizeof(struct iotsense_header)
#define IOTSENSE_MIN_PACKET IOTSENSE_HEADER_SIZE

/* ========================================================================== */
/* INTERNAL HELPER FUNCTIONS */
/* ========================================================================== */

/**
 * @brief Check if packet ID is valid (internal use)
 * @param packet_id Packet ID to validate
 * @return true if valid, false if reserved/invalid
 */
static inline bool is_valid_packet_id(uint8_t packet_id) {
  return (packet_id != PKT_ID_INVALID);
}

/* ========================================================================== */
/* PROTOCOL PARSER FUNCTIONS */
/* ========================================================================== */

/**
 * @brief Extract packet ID from IoTSense header
 * @param buf Buffer containing packet with header
 * @return Packet ID, or 0 if invalid
 */
static uint16_t iotsense_get_packet_id(const struct net_buf *buf) {
  if (buf->len < IOTSENSE_HEADER_SIZE) {
    return PKT_ID_INVALID;
  }

  const struct iotsense_header *hdr = (const struct iotsense_header *)buf->data;

  /* Validate version */
  if (hdr->version != IOTSENSE_VERSION) {
    return PKT_ID_INVALID;
  }

  return hdr->packet_id;
}

/**
 * @brief Validate IoTSense packet header
 * @param buf Buffer containing complete packet
 * @return 0 if valid, negative errno if invalid
 */
static int iotsense_validate_header(const struct net_buf *buf) {
  const struct iotsense_header *hdr;
  uint16_t total_len;

  if (buf->len < IOTSENSE_HEADER_SIZE) {
    return -EINVAL;
  }

  hdr = (const struct iotsense_header *)buf->data;

  /* Check version */
  if (hdr->version != IOTSENSE_VERSION) {
    return -EPROTONOSUPPORT; /* Unsupported version */
  }

  /* Validate packet length */
  total_len = IOTSENSE_HEADER_SIZE + hdr->payload_len;
  if (buf->len != total_len) {
    return -EMSGSIZE; /* Length mismatch */
  }

  /* Validate packet ID */
  if (!is_valid_packet_id(hdr->packet_id)) {
    return -EINVAL; /* Invalid packet ID */
  }

  return 0; /* Valid packet */
}

/**
 * @brief Add IoTSense header by creating and chaining header buffer
 * @param payload_buf Payload buffer to add header to
 * @param packet_id Packet ID for header
 * @param header_pool Buffer pool for header allocation
 * @param context Optional context (unused)
 * @return Pointer to complete packet (header + payload), or NULL on error
 */
static struct net_buf *iotsense_add_header(struct net_buf *payload_buf,
                                           uint16_t packet_id,
                                           struct net_buf_pool *header_pool,
                                           void *context) {
  struct net_buf *header_buf;
  struct iotsense_header *hdr;

  ARG_UNUSED(context);

  /* Allocate buffer for header */
  header_buf = net_buf_alloc(header_pool, K_NO_WAIT);
  if (!header_buf) {
    return NULL; /* Allocation failed */
  }

  /* Add header to buffer */
  hdr = (struct iotsense_header *)net_buf_add(header_buf, IOTSENSE_HEADER_SIZE);

  /* Fill header fields */
  hdr->version = IOTSENSE_VERSION;
  hdr->packet_id = packet_id;
  hdr->payload_len = payload_buf ? payload_buf->len : 0;

  /* Chain payload after header (zero-copy) */
  if (payload_buf) {
    net_buf_frag_add(header_buf, payload_buf);
  }

  return header_buf; /* Return complete packet */
}

/* ========================================================================== */
/* BUFFER POOL */
/* ========================================================================== */

NET_BUF_POOL_DEFINE(iotsense_header_pool, 32, 64, 4, NULL);

/* ========================================================================== */
/* PROTOCOL HANDLERS */
/* ========================================================================== */

static void iotsense_network_inbound_handler(struct packet_sink *sink,
                                             struct net_buf *buf);
static void iotsense_network_outbound_handler(struct packet_router *router,
                                              struct net_buf *buf,
                                              uint16_t packet_id);

/* ========================================================================== */
/* ROUTER INSTANCE */
/* ========================================================================== */

ROUTER_DEFINE(iotsense_router, iotsense_network_inbound_handler,
              iotsense_network_outbound_handler);

static void iotsense_network_inbound_handler(struct packet_sink *sink,
                                             struct net_buf *buf) {
  struct router_inbound_route *route;
  uint16_t packet_id;

  /* Validate packet size */
  if (buf->len < IOTSENSE_HEADER_SIZE) {
#ifdef CONFIG_PACKET_IO_STATS
    atomic_inc(&iotsense_router.parse_errors);
#endif
    LOG_WRN("Packet too small: %d bytes", buf->len);
    return;
  }

  /* Validate header */
  if (iotsense_validate_header(buf) < 0) {
#ifdef CONFIG_PACKET_IO_STATS
    atomic_inc(&iotsense_router.parse_errors);
#endif
    LOG_WRN("Invalid header");
    return;
  }

  /* Extract packet ID */
  packet_id = iotsense_get_packet_id(buf);
  if (packet_id == PKT_ID_INVALID) {
#ifdef CONFIG_PACKET_IO_STATS
    atomic_inc(&iotsense_router.parse_errors);
#endif
    LOG_WRN("Invalid packet ID");
    return;
  }

  /* Find route */
  route = router_find_inbound_route(&iotsense_router, packet_id);
  if (!route) {
#ifdef CONFIG_PACKET_IO_STATS
    atomic_inc(&iotsense_router.unknown_packet_ids);
#endif
    LOG_WRN("Unknown packet ID: 0x%04x", packet_id);
    return;
  }

  /* Strip header and deliver payload (buffer will be consumed) */
  net_buf_pull(buf, IOTSENSE_HEADER_SIZE);

  /* Deliver to application sink */
  int ret = packet_sink_deliver_consume(route->app_sink_ptr, buf, K_NO_WAIT);
  if (ret < 0) {
    LOG_WRN("Delivery failed: %d", ret);
  }

#ifdef CONFIG_PACKET_IO_STATS
  atomic_inc(&iotsense_router.inbound_packets);
#endif
}

static void iotsense_network_outbound_handler(struct packet_router *router,
                                              struct net_buf *payload,
                                              uint16_t packet_id) {
  struct net_buf *complete_packet;

  /* Add IoTSense header */
  complete_packet =
      iotsense_add_header(payload, packet_id, &iotsense_header_pool, NULL);
  if (!complete_packet) {
#ifdef CONFIG_PACKET_IO_STATS
    atomic_inc(&router->buffer_errors);
#endif
    LOG_ERR("Failed to add header");
    net_buf_unref(payload);
    return;
  }

  /* Send to network */
  int ret = packet_source_send_consume(&router->network_source, complete_packet,
                                       K_NO_WAIT);
  if (ret < 0) {
    LOG_WRN("Network send failed: %d", ret);
  }

#ifdef CONFIG_PACKET_IO_STATS
  atomic_inc(&router->outbound_packets);
#endif
}

/* ========================================================================== */
/* MODULE INITIALIZATION */
/* ========================================================================== */

static int iotsense_router_init(void) {
  int ret;

  ret = router_init(&iotsense_router);
  if (ret < 0) {
    LOG_ERR("Failed to initialize IoTSense router: %d", ret);
    return ret;
  }

  LOG_INF("IoTSense router initialized");
  return 0;
}

/* Initialize during application phase */
SYS_INIT(iotsense_router_init, APPLICATION, CONFIG_APPLICATION_INIT_PRIORITY);
```

## src/iotsense_router.h
```c
/*
 * IoTSense Router Header
 *
 * Defines the IoTSense protocol packet format and router instance.
 */

#ifndef IOTSENSE_ROUTER_H
#define IOTSENSE_ROUTER_H

#include "lib/packet_router.h"
#include <stdbool.h>
#include <stdint.h>

/* ========================================================================== */
/* IOTSENSE PACKET HEADER FORMAT */
/* ========================================================================== */

/**
 * @brief Simplified IoTSense Protocol Header
 *
 * Wire format (all fields little-endian):
 * +--------+--------+
 * |  VER   | PKT_ID |
 * +--------+--------+
 * |   PAYLOAD_LEN   |
 * +-----------------+
 * |    PAYLOAD...   |
 * +-----------------+
 *
 * Total header size: 4 bytes
 */
struct iotsense_header {
  uint8_t version;      /** Protocol version (0x01) */
  uint8_t packet_id;    /** Packet type identifier */
  uint16_t payload_len; /** Length of payload data */
} __packed;

/* ========================================================================== */
/* ROUTER INSTANCE */
/* ========================================================================== */

ROUTER_DECLARE(iotsense_router);

/* ========================================================================== */
/* IOTSENSE PROTOCOL PACKET IDs */
/* ========================================================================== */

/*
 * Simplified IoT Sensor Protocol
 *
 * Packet ID space allocation (8-bit IDs):
 * 0x00        - Reserved (invalid/error)
 * 0x01-0x0F   - Sensor data packets
 * 0x10-0x1F   - Actuator commands
 * 0x20-0x2F   - System/Control packets
 * 0x30-0x3F   - Status/monitoring
 * 0x40-0xFF   - Application specific
 */

/* Invalid Packet */
#define PKT_ID_INVALID 0x00 /** Invalid/error packet */

/* Used packet IDs in this sample */
#define PKT_ID_SENSOR_TEMP 0x01   /** Temperature sensor data */
#define PKT_ID_ACTUATOR_LED 0x02  /** LED control commands */
#define PKT_ID_SYSTEM_CONFIG 0x09 /** System configuration */

#endif /* IOTSENSE_ROUTER_H */
```
