## CMakeLists.txt
```
# SPDX-License-Identifier: Apache-2.0

cmake_minimum_required(VERSION 3.20.0)
find_package(Zephyr REQUIRED HINTS $ENV{ZEPHYR_BASE})
project(packet_io_basic_sample)

target_sources(app PRIVATE
    src/main.c
    src/sensors.c
    src/processor.c
    src/network.c
    src/validator.c
)
```

## sample.yaml
```
sample:
  description: Modular packet processing pipeline with header addition, TCP transmission, and integrity validation
  name: Packet I/O Basic Routing Sample
tests:
  sample.packet_io.basic_routing:
    tags:
      - packet_io
      - samples
      - networking
      - validation
    harness: console
    harness_config:
      type: multi_line
      ordered: false
      regex:
        - "Sensor module started \\(256B \\+ 384B payloads\\)"
        - "TCP network transmitter started"
        - "Packet validator started \\(immediate mode\\)"
        - "Packet processor started"
        - "TCP Stats: [0-9]+ packets, [0-9]+ bytes, [0-9]+ B/s"
        - "Validator: Checked [0-9]+ packets - Valid=[0-9]+, Failed=[0-9]+, Success rate=[0-9]+%"
    timeout: 5
    min_ram: 32
    integration_platforms:
      - native_sim
    platform_allow:
      - native_sim
      - qemu_x86
      - qemu_cortex_m3
```

## prj.conf
```kconfig
# Packet I/O Basic Sample Configuration

# Enable packet I/O subsystem
CONFIG_PACKET_IO=y
CONFIG_PACKET_IO_STATS=y

# Enable networking buffer support
CONFIG_NET_BUF=y

# Enable logging
CONFIG_LOG=y
CONFIG_LOG_DEFAULT_LEVEL=3

# Enable poll support for efficient multi-sink handling
CONFIG_POLL=y

# Thread configuration
CONFIG_MAIN_STACK_SIZE=2048
```

## src/main.c
```c
/*
 * Packet I/O Basic Sample - Main
 *
 * Demonstrates modular packet routing with header addition and validation.
 * Each module (sensors, processor, network, validator) is self-contained
 * with its own thread and buffer pool, initialized automatically via K_THREAD_DEFINE.
 *
 * Packet flow:
 *   sensor1_source ─┐                                      ┌─→ tcp_sink (network)
 *                   ├─→ processor_sink → processor_source ─┤
 *   sensor2_source ─┘                                      └─→ validator_sink
 */

#include <zephyr/kernel.h>
#include <zephyr/packet_io/packet_io.h>
#include <zephyr/logging/log.h>

#include "sensors.h"
#include "processor.h"
#include "network.h"
#include "validator.h"

LOG_MODULE_REGISTER(main, LOG_LEVEL_INF);

/* Wire up the connections at compile time */
PACKET_CONNECT(&sensor1_source, &processor_sink);
PACKET_CONNECT(&sensor2_source, &processor_sink);
PACKET_CONNECT(&processor_source, &tcp_sink);
PACKET_CONNECT(&processor_source, &validator_sink);

int main(void)
{
	LOG_INF("Packet I/O Routing Sample");
	LOG_INF("==========================");
	LOG_INF("Demonstrating modular packet flow with header addition and validation");
	LOG_INF("Routing to TCP network and packet validator");
	LOG_INF("");
	LOG_INF("Module threads start automatically:");
	LOG_INF("  - Sensors: Generate test packets");
	LOG_INF("  - Processor: Add headers and forward");
	LOG_INF("  - Network: TCP transmission");
	LOG_INF("  - Validator: Check packet integrity");

	/* All threads start automatically via K_THREAD_DEFINE */
	/* Main thread can just sleep */
	while (1) {
		k_sleep(K_FOREVER);
	}

	return 0;
}
```

## src/network.c
```c
/*
 * Packet I/O Sample - Network Module Implementation
 *
 * Self-contained TCP network transmitter
 */

#include <zephyr/kernel.h>
#include <zephyr/net/buf.h>
#include <zephyr/packet_io/packet_io.h>
#include <zephyr/logging/log.h>

#include "network.h"
#include "packet_defs.h"

LOG_MODULE_REGISTER(network, LOG_LEVEL_INF);

/* Event queue for network sink */
PACKET_EVENT_QUEUE_DEFINE(network_queue, 10);

/* Handler for TCP transmission */
static void tcp_handler(struct packet_sink *sink, struct net_buf *buf);

/* Define TCP network sink with queued handler */
PACKET_SINK_DEFINE_QUEUED(tcp_sink, tcp_handler, network_queue);

/* Network statistics */
static uint32_t packets_transmitted;
static uint32_t bytes_transmitted;
static uint32_t first_packet_time;

static void tcp_handler(struct packet_sink *sink, struct net_buf *buf)
{
	size_t total_len = net_buf_frags_len(buf);

	/* Track first packet time for rate calculation */
	if (packets_transmitted == 0) {
		first_packet_time = k_uptime_get_32();
	}

	/* Simulate TCP transmission with guaranteed delivery */
	k_msleep(50); /* Simulate network latency */

	/* Parse and log packet header if present */
	if (buf->len >= sizeof(struct packet_header)) {
		struct packet_header *hdr = (struct packet_header *)buf->data;
		LOG_INF("TCP TX: Sensor %d, Type %02x, Seq %u, %zu bytes",
			hdr->source_id, hdr->packet_type,
			hdr->sequence, total_len);
	} else {
		LOG_INF("TCP TX: %zu bytes (no header)", total_len);
	}

	/* Update statistics */
	packets_transmitted++;
	bytes_transmitted += total_len;

	/* Log statistics with every packet */
	uint32_t elapsed = k_uptime_get_32() - first_packet_time;
	if (elapsed > 0) {
		uint32_t rate = (bytes_transmitted * 1000) / elapsed;
		LOG_INF("TCP Stats: %u packets, %u bytes, %u B/s",
			packets_transmitted, bytes_transmitted, rate);
	}

	/* Buffer unref handled by framework */
}

static void network_thread_fn(void *p1, void *p2, void *p3)
{
	ARG_UNUSED(p1);
	ARG_UNUSED(p2);
	ARG_UNUSED(p3);

	LOG_INF("TCP network transmitter started");

	while (1) {
		/* Process events from the network queue */
		int ret = packet_event_process(&network_queue, K_FOREVER);
		if (ret != 0 && ret != -EAGAIN) {
			LOG_ERR("Failed to process network event: %d", ret);
		}
	}
}

/* Auto-start network thread */
K_THREAD_DEFINE(network_thread, 1024,
		network_thread_fn, NULL, NULL, NULL,
		7, 0, 0);
```

## src/network.h
```c
/*
 * Packet I/O Sample - Network Module
 *
 * Handles TCP network transmission
 */

#ifndef NETWORK_H
#define NETWORK_H

#include <zephyr/packet_io/packet_io.h>

/* Declare packet sink for external use */
PACKET_SINK_DECLARE(tcp_sink);

#endif /* NETWORK_H */
```

## src/packet_defs.h
```c
/*
 * Packet I/O Sample - Common Definitions
 *
 * Shared packet structures used by all modules
 */

#ifndef PACKET_DEFS_H
#define PACKET_DEFS_H

#include <stdint.h>

/* Define a simple header structure */
struct packet_header {
	uint8_t  source_id;
	uint8_t  packet_type;
	uint16_t sequence;
	uint32_t timestamp;
	uint16_t content_length;  /* Length of payload (excluding header) */
	uint16_t reserved;        /* Reserved for future use */
} __packed;

/* Packet types */
#define PACKET_TYPE_DATA	0x01
#define PACKET_TYPE_CONTROL	0x02

/* Source IDs */
#define SOURCE_ID_SENSOR1	1
#define SOURCE_ID_SENSOR2	2

#endif /* PACKET_DEFS_H */
```

## src/processor.c
```c
/*
 * Packet I/O Sample - Processor Module Implementation
 *
 * Self-contained packet processor with own buffer pool and thread
 */

#include <zephyr/kernel.h>
#include <zephyr/net/buf.h>
#include <zephyr/packet_io/packet_io.h>
#include <zephyr/logging/log.h>

#include "processor.h"
#include "packet_defs.h"

LOG_MODULE_REGISTER(processor, LOG_LEVEL_INF);

/* Processor module's own buffer pool (small - only for headers) */
NET_BUF_POOL_DEFINE(processor_pool, 16, sizeof(struct packet_header), 4, NULL);

/* Event queue for processor sink */
PACKET_EVENT_QUEUE_DEFINE(processor_queue, 10);

/* Handler for incoming packets */
static void processor_handler(struct packet_sink *sink, struct net_buf *buf);

/* Define processor sink with queued handler and source */
PACKET_SINK_DEFINE_QUEUED(processor_sink, processor_handler, processor_queue);
PACKET_SOURCE_DEFINE(processor_source);

/* Sequence counter */
static uint16_t sequence_counter;

static void processor_handler(struct packet_sink *sink, struct net_buf *buf)
{
	struct net_buf *header_buf;
	struct packet_header *header;
	uint8_t source_id = 0;

	/* Allocate buffer for header */
	header_buf = net_buf_alloc(&processor_pool, K_NO_WAIT);
	if (!header_buf) {
		LOG_WRN("No buffer for header");
		/* Buffer unref handled by framework */
		return;
	}

	/* Determine source from packet data (first byte convention) */
	if (buf->len > 0) {
		source_id = (buf->data[0] == 0xA0) ? 1 : 2;
	}

	/* Calculate the original payload length before chaining */
	uint16_t payload_len = buf->len;  /* Get length of single buffer */

	/* Fill in header */
	header = (struct packet_header *)net_buf_add(header_buf, sizeof(*header));
	header->source_id = source_id;
	header->packet_type = PACKET_TYPE_DATA;
	header->sequence = sequence_counter++;
	header->timestamp = k_uptime_get_32();
	header->content_length = payload_len;  /* Set payload length */
	header->reserved = 0;

	/* Chain original data after header - frag_add takes ownership of buf */
	/* Add reference since handler doesn't own the buffer it received */
	buf = net_buf_ref(buf);
	net_buf_frag_add(header_buf, buf);

	/* Log the processing */
	size_t total_len = net_buf_frags_len(header_buf);
	LOG_INF("Processed from sensor %d, seq %u, total %zu bytes",
		source_id, header->sequence, total_len);

	/* Forward the packet with header to all connected sinks */
	packet_source_send(&processor_source, header_buf, K_NO_WAIT);
}

static void processor_thread_fn(void *p1, void *p2, void *p3)
{
	ARG_UNUSED(p1);
	ARG_UNUSED(p2);
	ARG_UNUSED(p3);

	LOG_INF("Packet processor started");

	while (1) {
		/* Process events from the queue */
		int ret = packet_event_process(&processor_queue, K_FOREVER);
		if (ret != 0 && ret != -EAGAIN) {
			LOG_ERR("Failed to process packet event: %d", ret);
		}
	}
}

/* Auto-start processor thread */
K_THREAD_DEFINE(processor_thread, 1024,
		processor_thread_fn, NULL, NULL, NULL,
		7, 0, 0);
```

## src/processor.h
```c
/*
 * Packet I/O Sample - Processor Module
 *
 * Processes packets by adding headers and forwarding
 */

#ifndef PROCESSOR_H
#define PROCESSOR_H

#include <zephyr/packet_io/packet_io.h>

/* Declare packet sink and source for external use */
PACKET_SINK_DECLARE(processor_sink);
PACKET_SOURCE_DECLARE(processor_source);

#endif /* PROCESSOR_H */
```

## src/sensors.c
```c
/*
 * Packet I/O Sample - Sensor Module Implementation
 *
 * Self-contained sensor simulation with own buffer pool and thread
 */

#include <zephyr/kernel.h>
#include <zephyr/net/buf.h>
#include <zephyr/packet_io/packet_io.h>
#include <zephyr/logging/log.h>

#include "sensors.h"
#include "packet_defs.h"

LOG_MODULE_REGISTER(sensors, LOG_LEVEL_INF);

/* Sensor module's own buffer pool - larger for bigger packets */
NET_BUF_POOL_DEFINE(sensor_pool, 8, 512, 4, NULL);

/* Define packet sources */
PACKET_SOURCE_DEFINE(sensor1_source);
PACKET_SOURCE_DEFINE(sensor2_source);

/* Sensor data patterns - simulating larger sensor payloads */
static uint8_t sensor1_data[256];  /* 256 byte payload */
static uint8_t sensor2_data[384];  /* 384 byte payload */

static void init_sensor_data(void)
{
	/* Initialize sensor 1 with pattern starting with 0xA0 */
	sensor1_data[0] = 0xA0;
	for (int i = 1; i < sizeof(sensor1_data); i++) {
		sensor1_data[i] = (uint8_t)(i & 0xFF);
	}

	/* Initialize sensor 2 with pattern starting with 0xB0 */
	sensor2_data[0] = 0xB0;
	for (int i = 1; i < sizeof(sensor2_data); i++) {
		sensor2_data[i] = (uint8_t)((i * 2) & 0xFF);
	}
}

static void sensor_thread_fn(void *p1, void *p2, void *p3)
{
	struct net_buf *buf;
	int ret;

	ARG_UNUSED(p1);
	ARG_UNUSED(p2);
	ARG_UNUSED(p3);

	/* Initialize sensor data patterns */
	init_sensor_data();

	LOG_INF("Sensor module started (256B + 384B payloads)");

	while (1) {
		/* Sensor 1 packet - 256 bytes */
		buf = net_buf_alloc(&sensor_pool, K_NO_WAIT);
		if (buf) {
			net_buf_add_mem(buf, sensor1_data, sizeof(sensor1_data));
			ret = packet_source_send(&sensor1_source, buf, K_NO_WAIT);
			LOG_DBG("Sensor 1 sent %d bytes to %d sinks",
				sizeof(sensor1_data), ret);
			net_buf_unref(buf);
		}

		k_sleep(K_MSEC(200));  /* Faster data rate */

		/* Sensor 2 packet - 384 bytes */
		buf = net_buf_alloc(&sensor_pool, K_NO_WAIT);
		if (buf) {
			net_buf_add_mem(buf, sensor2_data, sizeof(sensor2_data));
			ret = packet_source_send_consume(&sensor2_source, buf, K_NO_WAIT);
			LOG_DBG("Sensor 2 sent %d bytes to %d sinks",
				sizeof(sensor2_data), ret);
		}

		k_sleep(K_MSEC(200));  /* Faster data rate */
	}
}

/* Static thread initialization - starts automatically */
K_THREAD_DEFINE(sensor_thread, 1024,
		sensor_thread_fn, NULL, NULL, NULL,
		7, 0, 0);
```

## src/sensors.h
```c
/*
 * Packet I/O Sample - Sensor Module
 *
 * Simulates sensor data sources generating packets
 */

#ifndef SENSORS_H
#define SENSORS_H

#include <zephyr/packet_io/packet_io.h>

/* Declare packet sources for external use */
PACKET_SOURCE_DECLARE(sensor1_source);
PACKET_SOURCE_DECLARE(sensor2_source);

#endif /* SENSORS_H */
```

## src/validator.c
```c
/*
 * Packet I/O Sample - Validator Module Implementation
 *
 * Self-contained packet validator checking integrity and content
 */

#include <zephyr/kernel.h>
#include <zephyr/net/buf.h>
#include <zephyr/packet_io/packet_io.h>
#include <zephyr/logging/log.h>

#include "validator.h"
#include "packet_defs.h"

LOG_MODULE_REGISTER(validator, LOG_LEVEL_INF);

/* Handler for validation */
static void validator_handler(struct packet_sink *sink, struct net_buf *buf);

/* Define validator sink with immediate execution */
PACKET_SINK_DEFINE_IMMEDIATE(validator_sink, validator_handler);

/* Statistics tracking */
static uint32_t packets_validated;
static uint32_t packets_failed;
static uint32_t last_sequence = UINT32_MAX;  /* Global sequence tracking */

static bool validate_packet_integrity(struct net_buf *buf)
{
	struct packet_header *header = (struct packet_header *)buf->data;
	size_t total_len = net_buf_frags_len(buf);
	size_t expected_len = sizeof(struct packet_header) + header->content_length;

	/* Check size integrity */
	if (total_len != expected_len) {
		LOG_ERR("Size mismatch! Total=%d, Expected=%d (hdr=%d + content=%d)",
			total_len, expected_len,
			sizeof(struct packet_header), header->content_length);
		return false;
	}

	/* Validate source ID */
	if (header->source_id != SOURCE_ID_SENSOR1 &&
	    header->source_id != SOURCE_ID_SENSOR2) {
		LOG_ERR("Invalid source ID: %d", header->source_id);
		return false;
	}

	/* Validate packet type */
	if (header->packet_type != PACKET_TYPE_DATA &&
	    header->packet_type != PACKET_TYPE_CONTROL) {
		LOG_ERR("Invalid packet type: 0x%02x", header->packet_type);
		return false;
	}

	/* Check sequence number progression (global sequence from processor) */
	if (last_sequence != UINT32_MAX) {
		uint32_t expected_seq = last_sequence + 1;
		if (header->sequence != expected_seq) {
			LOG_WRN("Sequence gap detected! Expected %d, Got %d (Source %d)",
				expected_seq, header->sequence, header->source_id);
		}
	}
	last_sequence = header->sequence;

	/* Validate content (check for expected patterns) */
	/* Content is in the chained buffer after the header */
	if (buf->frags) {
		/* The content starts in the second buffer of the chain */
		uint8_t first_byte = buf->frags->data[0];
		uint8_t expected = (header->source_id == SOURCE_ID_SENSOR1) ? 0xA0 : 0xB0;
		if (first_byte != expected) {
			LOG_ERR("Content validation failed! Source %d: Expected 0x%02x, Got 0x%02x",
				header->source_id, expected, first_byte);
			return false;
		}
	}

	LOG_DBG("Packet validated: Source %d, Seq %d, Type 0x%02x, %d bytes",
		header->source_id, header->sequence, header->packet_type,
		total_len);

	return true;
}

static void validator_handler(struct packet_sink *sink, struct net_buf *buf)
{
	struct packet_header *header;
	static bool first_packet = true;
	static uint32_t packets_received = 0;

	packets_received++;

	if (first_packet) {
		LOG_INF("Packet validator started (immediate mode)");
		first_packet = false;
	}

	/* Check if buffer has enough data for header */
	if (buf->len < sizeof(struct packet_header)) {
		LOG_ERR("Buffer too small for header: %d bytes", buf->len);
		packets_failed++;
		/* Buffer unref handled by framework */
		return;
	}

	header = (struct packet_header *)buf->data;

	/* Validate packet */
	if (validate_packet_integrity(buf)) {
		packets_validated++;
		LOG_INF("VALID: Sensor %d, Seq %d, Type 0x%02x [Total valid: %d]",
			header->source_id, header->sequence, header->packet_type, packets_validated);
	} else {
		packets_failed++;
		LOG_ERR("INVALID: Sensor %d, Seq %d [Total failed: %d]",
			header->source_id, header->sequence, packets_failed);
	}

	/* Report statistics with every packet */
	uint32_t total = packets_validated + packets_failed;
	uint32_t rate = (total > 0) ? (packets_validated * 100) / total : 0;
	LOG_INF("Validator: Checked %d packets - Valid=%d, Failed=%d, Success rate=%d%%",
		total, packets_validated, packets_failed, rate);

	/* Buffer unref handled by framework */
}

/* No thread needed for immediate handler - executes in source context */
```

## src/validator.h
```c
/*
 * Packet I/O Sample - Validator Module
 *
 * Validates packet integrity and content correctness
 */

#ifndef VALIDATOR_H
#define VALIDATOR_H

#include <zephyr/packet_io/packet_io.h>

/* Declare packet sink for external use */
PACKET_SINK_DECLARE(validator_sink);

#endif /* VALIDATOR_H */
```
