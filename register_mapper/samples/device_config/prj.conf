## CMakeLists.txt
```
# SPDX-License-Identifier: Apache-2.0

cmake_minimum_required(VERSION 3.20.0)
find_package(Zephyr REQUIRED HINTS $ENV{ZEPHYR_BASE})
project(register_mapper_sample)

target_sources(app PRIVATE
    src/main.c
    src/sensor_module.c
    src/motor_module.c
    src/register_map.c
    src/uart_handler.c
)
```

## sample.yaml
```
sample:
  name: Register Mapper Device Configuration
  description: |
    Demonstrates the register mapper subsystem with sensor and motor
    modules, UART protocol handler, and block write operations.

tests:
  sample.register_mapper.device_config:
    platform_allow: native_sim
    tags: register_mapper zbus
    harness: console
    harness_config:
      type: multi_line
      ordered: false
      regex:
        # Core initialization
        - "Register mapper initialized successfully"
        - "Register Mapper Sample Starting"
        - "UART Protocol Demo"
        # Register listing validation
        - "Demo 1: Available registers"
        - "reg_sensor_status"
        - "reg_motor_status"
        - "reg_sensor_control"
        # Read operations
        - "READ 0x1000 \\(reg_sensor_status\\): Success"
        - "READ 0x1004 \\(reg_motor_status\\): Success"
        # Write operations
        - "WRITE 0x4000 \\(reg_sensor_control\\): Success"
        - "WRITE 0x2012 \\(reg_motor_speed\\): Success"
        # Block write
        - "BLOCK WRITE: Starting transaction"
        - "BLOCK WRITE: Committed successfully"
        # Module updates
        - "Sensor config updated"
        - "Motor config changed"
        # Completion
        - "UART Demo Complete"
        - "PROJECT EXECUTION SUCCESSFUL"
```

## prj.conf
```kconfig
# Core requirements
CONFIG_ZBUS=y
CONFIG_REGISTER_MAPPER=y
CONFIG_REGISTER_MAPPER_BLOCK_WRITE=y
CONFIG_REGISTER_MAPPER_VALIDATION=y
CONFIG_REGISTER_MAPPER_NAMES=y

# Logging
CONFIG_LOG=y
CONFIG_REGISTER_MAPPER_LOG_LEVEL_INF=y

# Serial console
CONFIG_SERIAL=y

# Threading
CONFIG_MAIN_STACK_SIZE=2048
CONFIG_SYSTEM_WORKQUEUE_STACK_SIZE=2048

# Poll support for sensor module
CONFIG_POLL=y

# Debug options
CONFIG_ASSERT=y
CONFIG_DEBUG=y
```

## src/main.c
```c
/*
 * Copyright (c) 2024 Zephyr Project
 *
 * SPDX-License-Identifier: Apache-2.0
 */

/**
 * @file
 * @brief Register Mapper Sample Application
 *
 * Demonstrates:
 * - Module-based configuration with ZBUS channels
 * - Register mapping for external interfaces
 * - Block write transactions
 * - Automatic change notifications
 */

#include <zephyr/kernel.h>
#include <zephyr/zbus/zbus.h>
#include <zephyr/logging/log.h>
#include "sensor_module.h"
#include "uart_handler.h"

LOG_MODULE_REGISTER(main, LOG_LEVEL_INF);

/* Note: Sensor channels are now separated into status, config, and command */
/* The sensor module updates its own status via timer */

int main(void)
{
	LOG_INF("Register Mapper Sample Starting");

	/* Modules are initialized via SYS_INIT */
	/* Wait a bit for system to stabilize */
	k_sleep(K_MSEC(500));

	/* Run UART demo to show external register access */
	uart_demo_commands();

	/* Main loop - modules run independently via ZBUS */
	while (1) {
		k_sleep(K_SECONDS(10));
		/* System runs autonomously via ZBUS and timers */
	}

	return 0;
}
```

## src/motor_module.c
```c
/*
 * Copyright (c) 2024 Zephyr Project
 *
 * SPDX-License-Identifier: Apache-2.0
 */

#include <zephyr/kernel.h>
#include <zephyr/zbus/zbus.h>
#include <zephyr/logging/log.h>
#include <zephyr_io/register_mapper/register_channel.h>
#include "motor_module.h"
#include "sensor_module.h"

LOG_MODULE_REGISTER(motor_module, LOG_LEVEL_INF);

REGISTER_CHAN_DEFINE(motor_chan, struct motor_config, NULL, NULL, ZBUS_OBSERVERS_EMPTY,
		     (ZBUS_MSG_INIT(.status = MOTOR_STATUS_IDLE, .direction = MOTOR_DIR_FORWARD,
				    .speed = 0, .acceleration = 100, .current = 0)));

static void motor_handler_cb(const struct zbus_channel *chan)
{
	/* Channel is already locked by ZBUS - direct access is safe */
	struct motor_config *cfg = zbus_chan_msg(chan);

	LOG_INF("Motor config changed: speed=%u dir=%s accel=%d", cfg->speed,
		cfg->direction == MOTOR_DIR_FORWARD ? "FWD" : "REV", cfg->acceleration);

	/* Apply configuration to motor controller (simulated) */
	if (cfg->speed > 0) {
		cfg->status = MOTOR_STATUS_RUNNING;
		/* Simulate current draw based on speed */
		cfg->current = (cfg->speed / 10); /* Simple linear model */
	} else {
		cfg->status = MOTOR_STATUS_IDLE;
		cfg->current = 0;
	}

	/* Safety check - limit speed if sensor alert is active */
	struct sensor_status sensor_status;
	if (zbus_chan_read(&sensor_status_chan, &sensor_status, K_NO_WAIT) == 0) {
		if (sensor_status.status & SENSOR_STATUS_ALERT) {
			if (cfg->speed > 5000) {
				LOG_WRN("Limiting motor speed due to sensor alert");
				cfg->speed = 5000;
			}
		}
	}
}

/* Define the listener and connect it to the channel */
ZBUS_LISTENER_DEFINE(motor_handler, motor_handler_cb);
ZBUS_CHAN_ADD_OBS(motor_chan, motor_handler, 0);
```

## src/motor_module.h
```c
/*
 * Copyright (c) 2024 Zephyr Project
 *
 * SPDX-License-Identifier: Apache-2.0
 */

#ifndef MOTOR_MODULE_H_
#define MOTOR_MODULE_H_

#include <stdint.h>
#include <zephyr/zbus/zbus.h>
#include <zephyr/sys/util.h>

/* Direction values */
#define MOTOR_DIR_FORWARD 0
#define MOTOR_DIR_REVERSE 1

/* Motor configuration structure - stored in ZBUS channel */
struct motor_config {
	uint8_t status;       /* Runtime status */
	uint8_t direction;    /* Motor direction (0=forward, 1=reverse) */
	uint16_t speed;       /* RPM 0-10000 */
	int16_t acceleration; /* RPM/s (-1000 to 1000) */
	uint16_t current;     /* Current draw in mA */
};

/* Status bits */
#define MOTOR_STATUS_IDLE    BIT(0)
#define MOTOR_STATUS_RUNNING BIT(1)
#define MOTOR_STATUS_FAULT   BIT(2)

/* Export channel for use by register mapper */
ZBUS_CHAN_DECLARE(motor_chan);

#endif /* MOTOR_MODULE_H_ */
```

## src/register_map.c
```c
/*
 * Copyright (c) 2024 Zephyr Project
 *
 * SPDX-License-Identifier: Apache-2.0
 */

/**
 * @file
 * @brief Application-defined register map
 *
 * This file defines how register addresses map to ZBUS channels.
 * The application has complete control over the register layout,
 * while modules only define their configuration structures.
 */

#include <zephyr/kernel.h>
#include <zephyr/zbus/zbus.h>
#include <zephyr_io/register_mapper/register_mapper.h>
#include "sensor_module.h"
#include "motor_module.h"

/*
 * Register Layout:
 *
 * Status Registers (0x1000-0x1FFF) - Read-only runtime status
 * Configuration Registers (0x2000-0x2FFF) - Read-write configuration
 * Data Registers (0x3000-0x3FFF) - Data values
 * Command Registers (0x4000-0x4FFF) - Write-only commands/control
 *
 * This demonstrates grouped layout, but any layout is possible
 */

/* Status registers group at 0x1000 */
REG_MAPPING_DEFINE(reg_sensor_status, 0x1000, &sensor_status_chan, struct sensor_status, status,
		   REG_TYPE_U8, REG_FLAGS_RO);

REG_MAPPING_DEFINE(reg_motor_status, 0x1004, &motor_chan, struct motor_config, status, REG_TYPE_U8,
		   REG_FLAGS_RO);

REG_MAPPING_DEFINE(reg_motor_current, 0x1006, &motor_chan, struct motor_config, current,
		   REG_TYPE_U16, REG_FLAGS_RO);

/* Configuration registers group at 0x2000 */
/* Sensor config: 0x2000-0x200F */
REG_MAPPING_DEFINE(reg_sensor_threshold, 0x2000, &sensor_config_chan, struct sensor_config,
		   threshold, REG_TYPE_U32, REG_FLAGS_RW);

/* Motor config: 0x2010-0x201F */
REG_MAPPING_DEFINE(reg_motor_direction, 0x2010, &motor_chan, struct motor_config, direction,
		   REG_TYPE_U8, REG_FLAGS_RW);

REG_MAPPING_DEFINE(reg_motor_speed, 0x2012, &motor_chan, struct motor_config, speed, REG_TYPE_U16,
		   REG_FLAGS_RW);

REG_MAPPING_DEFINE(reg_motor_acceleration, 0x2014, &motor_chan, struct motor_config, acceleration,
		   REG_TYPE_I16, REG_FLAGS_RW);

/* Data registers group at 0x3000 */
REG_MAPPING_DEFINE(reg_sensor_data, 0x3000, &sensor_status_chan, struct sensor_status, data,
		   REG_TYPE_U32, REG_FLAGS_RO);

/* Command registers group at 0x4000 */
REG_MAPPING_DEFINE(reg_sensor_control, 0x4000, &sensor_command_chan, struct sensor_command, control,
		   REG_TYPE_U8, REG_FLAGS_WO);

/*
 * Register Map Summary:
 * 0x1000: Sensor Status (U8, RO)
 * 0x1004: Motor Status (U8, RO)
 * 0x1006: Motor Current (U16, RO)
 * 0x2000: Sensor Threshold (U32, RW)
 * 0x2010: Motor Direction (U8, RW)
 * 0x2012: Motor Speed (U16, RW)
 * 0x2014: Motor Acceleration (I16, RW)
 * 0x3000: Sensor Data (U32, RO)
 * 0x4000: Sensor Control Commands (U8, WO)
 */
```

## src/sensor_module.c
```c
/*
 * Copyright (c) 2024 Zephyr Project
 *
 * SPDX-License-Identifier: Apache-2.0
 */

#include <zephyr/kernel.h>
#include <zephyr/zbus/zbus.h>
#include <zephyr/logging/log.h>
#include <zephyr_io/register_mapper/register_channel.h>
#include "sensor_module.h"

LOG_MODULE_REGISTER(sensor_module, LOG_LEVEL_INF);

REGISTER_CHAN_DEFINE(sensor_status_chan, struct sensor_status, NULL, NULL, ZBUS_OBSERVERS_EMPTY,
		     (ZBUS_MSG_INIT(.status = SENSOR_STATUS_READY, .data = 0)));

REGISTER_CHAN_DEFINE(sensor_config_chan, struct sensor_config, NULL, NULL, ZBUS_OBSERVERS_EMPTY,
		     (ZBUS_MSG_INIT(.threshold = 2048, .reserved = 0)));

REGISTER_CHAN_DEFINE(sensor_command_chan, struct sensor_command, NULL, NULL, ZBUS_OBSERVERS_EMPTY,
		     (ZBUS_MSG_INIT(.control = 0, .reserved = {0})));

ZBUS_SUBSCRIBER_DEFINE(sensor_subscriber, 8);

/* Subscribe to both config and command channels */
ZBUS_CHAN_ADD_OBS(sensor_config_chan, sensor_subscriber, 0);
ZBUS_CHAN_ADD_OBS(sensor_command_chan, sensor_subscriber, 1);

/* Timer for periodic sampling */
static void sensor_timer_handler(struct k_timer *timer);
K_TIMER_DEFINE(sensor_timer, sensor_timer_handler, NULL);

/* Signal for timer events */
static struct k_poll_signal sensor_timer_signal = K_POLL_SIGNAL_INITIALIZER(sensor_timer_signal);

/* Poll events for the sensor thread (initialized at runtime) */
static struct k_poll_event sensor_events[2]; /* Timer + subscriber */

/* Timer handler - raises signal for thread */
static void sensor_timer_handler(struct k_timer *timer)
{
	k_poll_signal_raise(&sensor_timer_signal, 1);
}

/* Perform sensor sampling and update status */
static void sensor_sample(void)
{
	struct sensor_status *status;
	struct sensor_config config;
	uint8_t old_status;

	/* Claim status channel for atomic update */
	if (zbus_chan_claim(&sensor_status_chan, K_MSEC(100)) != 0) {
		LOG_ERR("Failed to claim sensor status channel");
		return;
	}

	/* Get direct pointer to status data (no copy needed) */
	status = (struct sensor_status *)zbus_chan_const_msg(&sensor_status_chan);

	/* Check if sensor is running */
	if (!(status->status & SENSOR_STATUS_RUNNING)) {
		zbus_chan_finish(&sensor_status_chan);
		return;
	}

	/* Read current config for threshold */
	if (zbus_chan_read(&sensor_config_chan, &config, K_MSEC(100)) != 0) {
		zbus_chan_finish(&sensor_status_chan);
		return;
	}

	old_status = status->status;

	/* Simulate sensor data */
	status->data += 10;

	/* Check threshold */
	if (status->data > config.threshold && config.threshold > 0) {
		if (!(status->status & SENSOR_STATUS_ALERT)) {
			status->status |= SENSOR_STATUS_ALERT;
			LOG_WRN("Sensor alert: data %u exceeds threshold %u", status->data,
				config.threshold);
		}
	} else {
		status->status &= ~SENSOR_STATUS_ALERT;
	}

	/* Finish the claim */
	zbus_chan_finish(&sensor_status_chan);

	/* Notify if status changed (alert triggered/cleared) */
	if (status->status != old_status) {
		zbus_chan_notify(&sensor_status_chan, K_NO_WAIT);
	}
}

/* Process sensor control commands */
static void sensor_process_command(void)
{
	struct sensor_command cmd;
	struct sensor_status *status;
	uint8_t old_status;

	/* Read command */
	if (zbus_chan_read(&sensor_command_chan, &cmd, K_MSEC(100)) != 0) {
		return;
	}

	if (cmd.control == 0) {
		return; /* No command to process */
	}

	LOG_INF("Sensor command: control=0x%02x", cmd.control);

	/* Clear command register (self-clearing) */
	struct sensor_command clear_cmd = {0};
	zbus_chan_pub(&sensor_command_chan, &clear_cmd, K_MSEC(100));

	/* Claim status channel for atomic update */
	if (zbus_chan_claim(&sensor_status_chan, K_MSEC(100)) != 0) {
		LOG_ERR("Failed to claim sensor status channel");
		return;
	}

	/* Get direct pointer to status data (no copy needed) */
	status = (struct sensor_status *)zbus_chan_const_msg(&sensor_status_chan);
	old_status = status->status;

	/* Handle START command */
	if (cmd.control & SENSOR_CTRL_START) {
		LOG_INF("Starting sensor sampling");
		status->status |= SENSOR_STATUS_RUNNING;
	}

	/* Handle STOP command */
	if (cmd.control & SENSOR_CTRL_STOP) {
		LOG_INF("Stopping sensor sampling");
		status->status &= ~SENSOR_STATUS_RUNNING;
		status->data = 0;
	}

	/* Handle RESET command */
	if (cmd.control & SENSOR_CTRL_RESET) {
		LOG_INF("Resetting sensor");
		status->data = 0;
		status->status = SENSOR_STATUS_READY;
	}

	/* Finish and notify if status changed */
	zbus_chan_finish(&sensor_status_chan);

	if (status->status != old_status) {
		zbus_chan_notify(&sensor_status_chan, K_NO_WAIT);
	}
}

/* Process sensor configuration changes */
static void sensor_process_config(void)
{
	struct sensor_config config;

	/* Read config */
	if (zbus_chan_read(&sensor_config_chan, &config, K_MSEC(100)) != 0) {
		return;
	}

	LOG_INF("Sensor config updated: threshold=%u", config.threshold);
	/* Config is just stored, no action needed */
}

/* Sensor processing thread */
static void sensor_thread(void *p1, void *p2, void *p3)
{
	const struct zbus_channel *chan;

	/* Set thread name */
	k_thread_name_set(k_current_get(), "sensor");

	LOG_INF("Sensor thread started");

	/* Initialize poll events */
	k_poll_event_init(&sensor_events[0], K_POLL_TYPE_SIGNAL, K_POLL_MODE_NOTIFY_ONLY,
			  &sensor_timer_signal);
	k_poll_event_init(&sensor_events[1], K_POLL_TYPE_MSGQ_DATA_AVAILABLE,
			  K_POLL_MODE_NOTIFY_ONLY, sensor_subscriber.queue);

	/* Start the periodic timer (100ms interval) */
	k_timer_start(&sensor_timer, K_MSEC(100), K_MSEC(100));

	while (true) {
		/* Wait for timer signal or ZBUS messages */
		k_poll(sensor_events, ARRAY_SIZE(sensor_events), K_FOREVER);

		/* Handle timer event - perform sampling */
		if (sensor_events[0].state == K_POLL_STATE_SIGNALED) {
			k_poll_signal_reset(&sensor_timer_signal);
			sensor_sample();
		}

		/* Handle ZBUS notifications (config or command) */
		if (sensor_events[1].state == K_POLL_STATE_MSGQ_DATA_AVAILABLE) {
			while (zbus_sub_wait(&sensor_subscriber, &chan, K_NO_WAIT) == 0) {
				/* Process based on which channel sent the notification */
				if (chan == &sensor_config_chan) {
					sensor_process_config();
				} else if (chan == &sensor_command_chan) {
					sensor_process_command();
				}
			}
		}
	}
}

/* Define and start thread automatically */
K_THREAD_DEFINE(sensor_thread_id, 2048, sensor_thread, NULL, NULL, NULL, K_PRIO_PREEMPT(5), 0, 0);
```

## src/sensor_module.h
```c
/*
 * Copyright (c) 2024 Zephyr Project
 *
 * SPDX-License-Identifier: Apache-2.0
 */

#ifndef SENSOR_MODULE_H_
#define SENSOR_MODULE_H_

#include <stdint.h>
#include <zephyr/zbus/zbus.h>
#include <zephyr/sys/util.h>

/* Sensor status structure - Read-only runtime state */
struct sensor_status {
	uint8_t status; /* Runtime status bits */
	uint32_t data;  /* Current sensor reading */
};

/* Sensor configuration structure - Read-write persistent config */
struct sensor_config {
	uint32_t threshold; /* Alert threshold */
	uint32_t reserved;  /* Reserved for alignment/future use */
};

/* Sensor command structure - Write-only commands */
struct sensor_command {
	uint8_t control;     /* Control command bits */
	uint8_t reserved[3]; /* Reserved for alignment */
};

/* Control bits */
#define SENSOR_CTRL_START BIT(0)
#define SENSOR_CTRL_STOP  BIT(1)
#define SENSOR_CTRL_RESET BIT(2)

/* Status bits */
#define SENSOR_STATUS_READY   BIT(0)
#define SENSOR_STATUS_RUNNING BIT(1)
#define SENSOR_STATUS_ERROR   BIT(2)
#define SENSOR_STATUS_ALERT   BIT(3)

/* Export channels for use by register mapper and motor module */
ZBUS_CHAN_DECLARE(sensor_status_chan);
ZBUS_CHAN_DECLARE(sensor_config_chan);
ZBUS_CHAN_DECLARE(sensor_command_chan);

#endif /* SENSOR_MODULE_H_ */
```

## src/uart_handler.c
```c
/*
 * Copyright (c) 2024 Zephyr Project
 *
 * SPDX-License-Identifier: Apache-2.0
 */

/**
 * @file
 * @brief UART protocol handler demonstrating external register access
 *
 * Simulates a UART-based protocol for register read/write operations,
 * demonstrating how external systems can interact with the device
 * through the register mapper interface.
 */

#include <zephyr/kernel.h>
#include <zephyr/logging/log.h>
#include <zephyr/sys/byteorder.h>
#include <zephyr_io/register_mapper/register_mapper.h>
#include <zephyr_io/register_mapper/register_types.h>
#include <string.h>
#include <stdio.h>
#include "sensor_module.h"

LOG_MODULE_REGISTER(uart_handler, LOG_LEVEL_INF);

/* Callback to print register info */
static int list_register_cb(const struct reg_mapping *map, void *user_data)
{
	const char *type_str[] = {"u8 ", "u16", "u32", "u64", "i8 ", "i16", "i32", "i64"};
	const char *access_str = map->flags.readable ? (map->flags.writable ? "RW" : "RO")
						     : (map->flags.writable ? "WO" : "--");

	struct reg_value value = {0};
	char value_str[20];

	/* Try to read the current value if readable */
	if (map->flags.readable && reg_read_value(map->address, &value) == 0) {
		/* Format value based on type */
		switch (map->type) {
		case REG_TYPE_U8:
			snprintf(value_str, sizeof(value_str), "%u", value.val.u8);
			break;
		case REG_TYPE_U16:
			snprintf(value_str, sizeof(value_str), "%u", value.val.u16);
			break;
		case REG_TYPE_U32:
			snprintf(value_str, sizeof(value_str), "%u", value.val.u32);
			break;
		case REG_TYPE_U64:
			snprintf(value_str, sizeof(value_str), "%llu",
				 (unsigned long long)value.val.u64);
			break;
		case REG_TYPE_I8:
			snprintf(value_str, sizeof(value_str), "%d", value.val.i8);
			break;
		case REG_TYPE_I16:
			snprintf(value_str, sizeof(value_str), "%d", value.val.i16);
			break;
		case REG_TYPE_I32:
			snprintf(value_str, sizeof(value_str), "%d", value.val.i32);
			break;
		case REG_TYPE_I64:
			snprintf(value_str, sizeof(value_str), "%lld", (long long)value.val.i64);
			break;
		default:
			strcpy(value_str, "???");
			break;
		}
	} else {
		strcpy(value_str, "-");
	}

#ifdef CONFIG_REGISTER_MAPPER_NAMES
	const char *name = map->name ? map->name : "-";
#else
	const char *name = "-";
#endif

	LOG_INF("  0x%05X | %-4s | %3s | %3u | %9p | %-10s | %-20s", map->address,
		type_str[map->type], access_str, map->offset, map->channel, value_str, name);

	return 0; /* Continue iteration */
}

/* Function to list all registered addresses */
static void reg_list_all(void)
{
	int count;

	LOG_INF("Register Map:");
	LOG_INF("  Address | Type | Acc | Off | Channel   | Value      | Name");
	LOG_INF("  --------|------|-----|-----|-----------|------------|----------------------");
	count = reg_foreach(list_register_cb, NULL);
	LOG_INF("  Total: %d registers", count);
}

/* Example callback: Count readable registers */
static int count_readable_cb(const struct reg_mapping *map, void *user_data)
{
	int *count = (int *)user_data;
	if (map->flags.readable) {
		(*count)++;
	}
	return 0; /* Continue iteration */
}

/* Helper to find register name by address */
struct find_reg_by_addr_data {
	uint16_t addr;
	const char *name;
};

static int find_reg_by_addr_cb(const struct reg_mapping *map, void *user_data)
{
	struct find_reg_by_addr_data *data = (struct find_reg_by_addr_data *)user_data;
	if (map->address == data->addr) {
#ifdef CONFIG_REGISTER_MAPPER_NAMES
		data->name = map->name ? map->name : "unknown";
#else
		data->name = "unknown";
#endif
		return 1; /* Stop iteration - found it */
	}
	return 0; /* Continue iteration */
}

static const char *get_register_name(uint16_t addr)
{
	struct find_reg_by_addr_data data = {.addr = addr, .name = NULL};
	reg_foreach(find_reg_by_addr_cb, &data);
	return data.name ? data.name : "unknown";
}

/* Demonstrate custom register iteration */
static void demo_custom_register_iteration(void)
{
	int ret;

	/* Example: Count readable registers */
	int readable_count = 0;
	ret = reg_foreach(count_readable_cb, &readable_count);
	LOG_INF("Found %d readable registers out of %d total", readable_count, ret);
}

/* Protocol commands */
enum uart_cmd {
	CMD_READ_REG = 0x01,
	CMD_WRITE_REG = 0x02,
	CMD_BLOCK_WRITE = 0x03,
	CMD_LIST_REGS = 0x04,
};

/* Response codes */
enum uart_rsp {
	RSP_OK = 0x00,
	RSP_ERROR = 0x01,
	RSP_INVALID = 0x02,
};

/* Simulate UART command processing */
static void process_read_command(uint16_t addr)
{
	struct reg_value value;
	int ret = reg_read_value(addr, &value);

	if (ret == 0) {
		LOG_INF("READ 0x%04x (%s): Success", addr, get_register_name(addr));

		/* Log the value based on type */
		switch (value.type) {
		case REG_TYPE_U8:
			LOG_INF("  Value: 0x%02x (U8)", value.val.u8);
			break;
		case REG_TYPE_U16:
			LOG_INF("  Value: 0x%04x (U16)", value.val.u16);
			break;
		case REG_TYPE_U32:
			LOG_INF("  Value: 0x%08x (U32)", value.val.u32);
			break;
		case REG_TYPE_I16:
			LOG_INF("  Value: %d (I16)", value.val.i16);
			break;
		default:
			LOG_INF("  Value: (type %d)", value.type);
			break;
		}
	} else {
		LOG_ERR("READ 0x%04x (%s): Failed (%d)", addr, get_register_name(addr), ret);
	}
}

static void process_write_command(uint16_t addr, struct reg_value value)
{
	int ret = reg_write_value(addr, value, K_MSEC(100));

	if (ret == 0) {
		LOG_INF("WRITE 0x%04x (%s): Success", addr, get_register_name(addr));
	} else {
		LOG_ERR("WRITE 0x%04x (%s): Failed (%d)", addr, get_register_name(addr), ret);
	}
}

static void process_block_write_command(void)
{
	LOG_INF("BLOCK WRITE: Starting transaction");

	/* Begin block transaction */
	int ret = reg_block_write_begin(K_MSEC(500));
	if (ret != 0) {
		LOG_ERR("Failed to begin block write: %d", ret);
		return;
	}

	/* Simulate writing multiple registers */
	/* Example: Configure motor for operation */
	ret = reg_block_write_register(0x2010, REG_VALUE_U8(0)); /* Direction forward */
	if (ret == 0) {
		ret = reg_block_write_register(0x2012, REG_VALUE_U16(3000)); /* Speed 3000 RPM */
	}
	if (ret == 0) {
		ret = reg_block_write_register(0x2014,
					       REG_VALUE_I16(200)); /* Acceleration 200 RPM/s */
	}

	/* Also update sensor threshold */
	if (ret == 0) {
		ret = reg_block_write_register(0x2000, REG_VALUE_U32(3500)); /* New threshold */
	}

	/* Commit all changes */
	if (ret == 0) {
		ret = reg_block_write_commit(K_MSEC(100));
		if (ret == 0) {
			LOG_INF("BLOCK WRITE: Committed successfully");
		} else {
			LOG_ERR("BLOCK WRITE: Commit failed (%d)", ret);
		}
	} else {
		/* Abort on error - commit will still unlock mutex */
		reg_block_write_commit(K_NO_WAIT);
		LOG_ERR("BLOCK WRITE: Aborted due to error");
	}
}

/* Demo function to simulate UART commands */
void uart_demo_commands(void)
{
	LOG_INF("=== UART Protocol Demo ===");

	/* Wait for system to stabilize */
	k_sleep(K_MSEC(100));

	/* Demo 1: List all available registers first */
	LOG_INF("Demo 1: Available registers in the system");
	reg_list_all();

	k_sleep(K_MSEC(500));

	/* Demo 2: Read some registers */
	LOG_INF("Demo 2: Reading registers");
	process_read_command(0x1000); /* Sensor status */
	process_read_command(0x1004); /* Motor status */
	process_read_command(0x3000); /* Sensor data */

	k_sleep(K_MSEC(500));

	/* Demo 3: Write individual registers */
	LOG_INF("Demo 3: Writing individual registers");
	process_write_command(0x4000, REG_VALUE_U8(SENSOR_CTRL_START)); /* Start sensor command */
	k_sleep(K_MSEC(100));
	process_write_command(0x2012, REG_VALUE_U16(1500)); /* Set motor speed */

	k_sleep(K_MSEC(500));

	/* Demo 4: Block write transaction */
	LOG_INF("Demo 4: Block write transaction");
	process_block_write_command();

	k_sleep(K_MSEC(500));

	/* Demo 5: Read updated values */
	LOG_INF("Demo 5: Reading updated values");
	process_read_command(0x1000); /* Sensor status */
	process_read_command(0x1004); /* Motor status */
	process_read_command(0x2000); /* Sensor threshold */
	process_read_command(0x2012); /* Motor speed */

	/* Demo 6: Motor control sequence */
	LOG_INF("Demo 6: Motor control sequence");
	process_write_command(0x2010, REG_VALUE_U8(1)); /* Set reverse direction */
	k_sleep(K_MSEC(100));
	process_write_command(0x2014, REG_VALUE_I16(-50)); /* Set deceleration */
	k_sleep(K_MSEC(100));
	process_write_command(0x2012, REG_VALUE_U16(500)); /* Set slow speed */
	k_sleep(K_MSEC(100));

	/* Demo 7: Read final system state */
	LOG_INF("Demo 7: Reading final system state");
	process_read_command(0x1000); /* Sensor status */
	process_read_command(0x1004); /* Motor status */
	process_read_command(0x1006); /* Motor current */
	process_read_command(0x3000); /* Sensor data */

	/* Demo 8: Custom iteration over registers */
	LOG_INF("Demo 8: Custom register iteration");
	demo_custom_register_iteration();

	LOG_INF("=== UART Demo Complete ===");
	LOG_INF("PROJECT EXECUTION SUCCESSFUL");
}
```

## src/uart_handler.h
```c
/*
 * Copyright (c) 2024 Zephyr Project
 *
 * SPDX-License-Identifier: Apache-2.0
 */

#ifndef UART_HANDLER_H_
#define UART_HANDLER_H_

void uart_demo_commands(void);

#endif /* UART_HANDLER_H_ */
```
