## prj.conf
```kconfig
# Packet Router Sample Configuration
# Platform-agnostic configuration - works on any board with networking

# Core Requirements
# =================
CONFIG_NET_BUF=y           
CONFIG_SWIFT_IO=y         
CONFIG_LOG=y               
CONFIG_ASSERT=y            
CONFIG_POLL=y              

# Packet I/O Configuration
# ========================
# Enable packet router subsystem
CONFIG_SWIFT_IO=y
CONFIG_SWIFT_ROUTER=y
# Enable statistics tracking
CONFIG_SWIFT_IO_STATS=y
# Enable debug names
CONFIG_SWIFT_IO_NAMES=y
# Info level logging
CONFIG_SWIFT_IO_LOG_LEVEL=2

# Networking Stack
# ================
CONFIG_NETWORKING=y             
CONFIG_NET_IPV4=y              
CONFIG_NET_TCP=y               
CONFIG_NET_SOCKETS=y           
CONFIG_NET_SOCKETS_POSIX_NAMES=y  

# Network Configuration
# =====================
CONFIG_NET_CONFIG_SETTINGS=y    
CONFIG_NET_CONFIG_AUTO_INIT=y   

# Default IP configuration (overridden by board configs)
CONFIG_NET_CONFIG_MY_IPV4_ADDR="127.0.0.1"
CONFIG_NET_CONFIG_PEER_IPV4_ADDR="127.0.0.1"

# Network Buffers
# ===============
CONFIG_NET_PKT_RX_COUNT=10      
CONFIG_NET_PKT_TX_COUNT=10      
CONFIG_NET_BUF_RX_COUNT=20      
CONFIG_NET_BUF_TX_COUNT=20      

# Thread Configuration
# ====================
CONFIG_MAIN_STACK_SIZE=4096     
CONFIG_MAIN_THREAD_PRIORITY=7   
CONFIG_SYSTEM_WORKQUEUE_STACK_SIZE=2048  

# Timing & Scheduling
# ===================
CONFIG_TIMESLICING=y            
CONFIG_TIMESLICE_SIZE=10        
CONFIG_TIMESLICE_PRIORITY=0    

# Logging Configuration
# =====================
CONFIG_LOG_MODE_DEFERRED=y      
CONFIG_LOG_BUFFER_SIZE=2048     

# Memory Management
# =================
CONFIG_HEAP_MEM_POOL_SIZE=8192  

# Application Features
# ====================
CONFIG_CRC=y                    
CONFIG_TEST_RANDOM_GENERATOR=y  
CONFIG_REBOOT=y                 
```

## boards/native_sim.conf
```kconfig
# Native simulator configuration
# Uses host networking through socket offload

# Native socket offload for direct host networking
CONFIG_NET_DRIVERS=y
CONFIG_NET_SOCKETS_OFFLOAD=y
CONFIG_NET_NATIVE_OFFLOADED_SOCKETS=y

# Disable unused drivers
CONFIG_ETH_NATIVE_POSIX=n
CONFIG_NET_LOOPBACK=n

# IPv6 DAD requires lower level network interface access
CONFIG_NET_IPV6_DAD=n

# Bind to all interfaces on host
CONFIG_NET_CONFIG_MY_IPV4_ADDR="0.0.0.0"
CONFIG_NET_CONFIG_PEER_IPV4_ADDR=""

# Additional heap for socket operations
CONFIG_HEAP_MEM_POOL_SIZE=16384
```

## src/main.c
```c
/* Packet Router Sample
 * Demonstrates IoTSense protocol routing with modular architecture
 */

#include <stdlib.h>
#include <zephyr/kernel.h>
#include <zephyr/logging/log.h>
#include <zephyr_io/swift_io/swift_io.h>

#include "protocols/iotsense_router.h"
#include "modules/led_controller.h"
#include "modules/system_control.h"
#include "modules/tcp_server.h"
#include "modules/temperature_sensor.h"

LOG_MODULE_REGISTER(main, LOG_LEVEL_INF);

/* Packet type registrations */

/* Temperature sensor - outbound only */
ROUTER_OUTBOUND_ROUTE_DEFINE(iotsense_router, PKT_ID_SENSOR_TEMP, temperature_sensor_source);

/* System control - bidirectional */
ROUTER_OUTBOUND_ROUTE_DEFINE(iotsense_router, PKT_ID_SYSTEM_CONFIG, system_control_source);
ROUTER_INBOUND_ROUTE_DEFINE(iotsense_router, PKT_ID_SYSTEM_CONFIG, system_control_sink);

/* LED controller - inbound only */
ROUTER_INBOUND_ROUTE_DEFINE(iotsense_router, PKT_ID_ACTUATOR_LED, led_controller_sink);

/* Network connections */
SWIFT_IO_CONNECT(&tcp_server_source, &iotsense_router.network_sink);
SWIFT_IO_CONNECT(&iotsense_router.network_source, &tcp_server_sink);

/* Statistics reporting thread */
static void stats_thread(void *p1, void *p2, void *p3)
{
	struct router_stats stats;

	ARG_UNUSED(p1);
	ARG_UNUSED(p2);
	ARG_UNUSED(p3);

	while (1) {
		k_sleep(K_SECONDS(30));

		LOG_INF("System status:");

#ifdef CONFIG_SWIFT_IO_STATS
		router_get_stats(&iotsense_router, &stats);
		LOG_INF("Router: in=%u out=%u unknown=%u errors=%u buffers=%u",
			stats.inbound_packets, stats.outbound_packets, stats.unknown_packet_ids,
			stats.parse_errors, stats.buffer_errors);
#endif
	}
}

K_THREAD_DEFINE(stats_tid, 1024, stats_thread, NULL, NULL, NULL, 9, 0, 0);
```
