## swift_io/tests/subsys/swift_io/integration/testcase.yaml
```yaml
tests:
  swift_io.integration:
    tags: swift_io integration
    integration_platforms:
      - native_sim
      - qemu_cortex_m3
      - qemu_x86
    harness: ztest
    min_ram: 32
    timeout: 60
```

## swift_io/tests/subsys/swift_io/runtime_test/testcase.yaml
```yaml
tests:
  swift_io.runtime:
    harness: ztest
    tags: swift_io
    platform_allow: native_sim
```

## swift_io/tests/subsys/swift_io/unit_test/testcase.yaml
```yaml
tests:
  swift_io.unit_test:
    tags: swift_io unit_test
    integration_platforms:
      - native_sim
      - qemu_cortex_m3
    harness: ztest
  swift_io.unit_test.no_stats:
    tags: swift_io unit_test no_stats
    integration_platforms:
      - native_sim
      - qemu_cortex_m3
    harness: ztest
    extra_configs:
      - CONFIG_SWIFT_IO_STATS=n
```

## tests/core/unit_test/testcase.yaml
```yaml
tests:
  weave.core.unit_test:
    tags: weave core unit_test
    integration_platforms:
      - native_sim
      - qemu_cortex_m3
    harness: ztest
```

## tests/method/unit_test/testcase.yaml
```yaml
tests:
  weave.method.unit_test:
    tags: weave method unit_test
    integration_platforms:
      - native_sim
      - qemu_cortex_m3
    harness: ztest
```

## weave/Kconfig
```kconfig
# Copyright (c) 2024 Zephyr IO Project
# SPDX-License-Identifier: Apache-2.0

menuconfig WEAVE
	bool "Weave message passing framework"
	depends on POLL
	help
	  Enable the Weave message passing framework for inter-module
	  communication using method calls and signals.

if WEAVE

config WEAVE_MAX_REQUEST_SIZE
	int "Maximum request message size"
	default 256
	help
	  Maximum size in bytes for request messages.

config WEAVE_MAX_REPLY_SIZE
	int "Maximum reply message size"
	default 256
	help
	  Maximum size in bytes for reply messages in method calls.

config WEAVE_MAX_PENDING_REQUESTS
	int "Maximum number of pending requests"
	default 8
	help
	  Maximum number of concurrent pending requests in the system.

config WEAVE_DATA_HEAP_SIZE
	int "Size of data heap for message payloads"
	default 2048
	help
	  Size of the heap used for variable-sized message data buffers.
	  This should be large enough to handle the expected concurrent
	  message traffic with various payload sizes.

config WEAVE_INIT_PRIORITY
	int "Initialization priority"
	default 90
	help
	  Weave initialization priority.

module = WEAVE
module-str = weave
source "subsys/logging/Kconfig.template.log_config"

endif # WEAVE
```

## weave/tests/subsys/weave/unit_test/testcase.yaml
```yaml
tests:
  weave.unit_test:
    tags: weave unit_test
    integration_platforms:
      - native_sim
      - qemu_cortex_m3
    harness: ztest
  weave.unit_test.large_heap:
    tags: weave unit_test large_heap
    integration_platforms:
      - native_sim
      - qemu_cortex_m3
    harness: ztest
    extra_configs:
      - CONFIG_WEAVE_DATA_HEAP_SIZE=8192
      - CONFIG_WEAVE_MAX_PENDING_REQUESTS=32
```
