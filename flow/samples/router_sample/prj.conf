## CMakeLists.txt
```
# SPDX-License-Identifier: Apache-2.0

cmake_minimum_required(VERSION 3.20.0)
find_package(Zephyr REQUIRED HINTS $ENV{ZEPHYR_BASE})
project(flow_router_sample)

target_sources(app PRIVATE
    src/main.c
    src/sensors.c
    src/protocol.c
    src/tcp_server.c
    src/cmd_handler.c
)
```

## Kconfig
```
# Router Sample Configuration

config ROUTER_AUTO_START_SAMPLING
	bool "Automatically start sampling on boot"
	default y
	help
	  When enabled, the router sample will automatically start
	  generating sensor data packets on boot. When disabled,
	  sampling must be started manually via TCP command.

source "Kconfig.zephyr"
```

## prj.conf
```kconfig
# Flow Router Sample with TCP Server Configuration

# Enable packet I/O subsystem
CONFIG_FLOW=y
CONFIG_FLOW_NAMES=y
CONFIG_FLOW_STATS=y
CONFIG_FLOW_BUF_TIMESTAMP_HIRES=y

# Enable networking buffer support
CONFIG_NET_BUF=y

# Enable networking
CONFIG_NETWORKING=y
CONFIG_NET_TCP=y
CONFIG_NET_SOCKETS=y
CONFIG_NET_SOCKETS_POSIX_NAMES=y

# Network stack configuration
CONFIG_NET_IPV4=y
CONFIG_NET_IPV6=n
CONFIG_NET_DHCPV4=n

# Native networking for native_sim
CONFIG_NET_DRIVERS=y
CONFIG_NET_LOOPBACK=y

# Use host sockets for native_sim (allows connections from host)
CONFIG_NET_SOCKETS_OFFLOAD=y
CONFIG_NET_NATIVE_OFFLOADED_SOCKETS=y
CONFIG_HEAP_MEM_POOL_SIZE=8192

# Network buffers
CONFIG_NET_PKT_RX_COUNT=16
CONFIG_NET_PKT_TX_COUNT=16
CONFIG_NET_BUF_RX_COUNT=16
CONFIG_NET_BUF_TX_COUNT=16

# Enable logging
CONFIG_LOG=y
CONFIG_LOG_DEFAULT_LEVEL=3
CONFIG_NET_LOG=y

# Enable assertions to catch bugs
CONFIG_ASSERT=y
CONFIG_ASSERT_LEVEL=2

# Enable poll support for efficient multi-sink handling
CONFIG_POLL=y

# Thread configuration
CONFIG_MAIN_STACK_SIZE=2048
CONFIG_NET_TX_STACK_SIZE=2048
CONFIG_NET_RX_STACK_SIZE=2048
```

## src/main.c
```c
/*
 * Flow Router Sample - Main
 *
 * Demonstrates TCP-based sensor data routing with protocol headers and
 * remote control commands. Sensors can be started/stopped via TCP commands.
 *
 * Packet flow:
 *   sensor1_source ─┐
 *                   ├─→ processor_outbound_sink → processor_outbound_source ─→ tcp_sink
 *   sensor2_source ─┘
 *
 * Command flow:
 *   tcp_rx_source → cmd_sink (start/stop sampling)
 */

#include <zephyr/kernel.h>
#include <zephyr/logging/log.h>
#include <zephyr/net/net_if.h>
#include <zephyr/net/net_core.h>
#include <zephyr/net/net_context.h>
#include <zephyr/net/net_mgmt.h>
#include <zephyr_io/flow/flow.h>

#include "tcp_server.h"
#include "protocol.h"
#include "sensors.h"
#include "cmd_handler.h"

LOG_MODULE_REGISTER(main, LOG_LEVEL_INF);

/* Wire up the connections at compile time */

/* Sensors to protocol processor */
FLOW_CONNECT(&sensor1_source, &protocol_outbound_sink);
FLOW_CONNECT(&sensor2_source, &protocol_outbound_sink);

/* Protocol processor to TCP server */
FLOW_CONNECT(&protocol_outbound_source, &tcp_sink);

/* TCP incoming packets to command handler */
FLOW_CONNECT(&tcp_rx_source, &cmd_sink);

/* Setup networking for native_sim */
static void setup_networking(void)
{
	struct net_if *iface = net_if_get_default();

	if (!iface) {
		LOG_ERR("No network interface available");
		return;
	}

	/* For native_sim, manually configure loopback interface */
	struct in_addr addr = {{{127, 0, 0, 1}}};

	net_if_ipv4_addr_add(iface, &addr, NET_ADDR_MANUAL, 0);

	LOG_INF("Network interface configured: 127.0.0.1");
}

int main(void)
{
	LOG_INF("Flow Router Sample with TCP Server");
	LOG_INF("====================================");
	LOG_INF("Sensor data routing with remote control:");
	LOG_INF("  1. Sensors generate data packets with metadata");
	LOG_INF("  2. Protocol module adds headers (packet_id, flags, counter)");
	LOG_INF("  3. TCP server sends packets to connected clients");
	LOG_INF("  4. Clients can send commands to start/stop sampling");
	LOG_INF("");
	LOG_INF("Commands:");
	LOG_INF("  0x01 - Start sampling");
	LOG_INF("  0x02 - Stop sampling");
	LOG_INF("");
	LOG_INF("Connect with: python tcp_client.py");

	/* Setup network interface */
	setup_networking();

	LOG_INF("All modules started, entering main loop...");

	/* All threads start automatically via K_THREAD_DEFINE */
	/* Main thread can just sleep */
	while (1) {
		LOG_DBG("Main thread sleeping...");
		k_sleep(K_FOREVER);
		LOG_ERR("Main thread woke up from K_FOREVER! This should never happen!");
	}

	LOG_ERR("Main thread exiting! This should never be reached!");
	return 0;
}
```

## src/cmd_handler.c
```c
/*
 * Flow Router Sample - Command Handler Implementation
 *
 * Processes control commands from TCP server (start/stop sampling)
 */

#include <zephyr/kernel.h>
#include <zephyr/logging/log.h>
#include <zephyr/net/buf.h>
#include <zephyr_io/flow/flow.h>

#include "cmd_handler.h"
#include "sensors.h"

LOG_MODULE_REGISTER(cmd_handler, LOG_LEVEL_INF);

/* Forward declaration of handler function */
static void cmd_handler_fn(struct flow_sink *sink, struct net_buf *buf_ref);

/* Define command sink with immediate execution */
FLOW_SINK_DEFINE_IMMEDIATE(cmd_sink, cmd_handler_fn);

/* Command statistics */
static uint32_t commands_processed;
static uint32_t start_commands;
static uint32_t stop_commands;
static uint32_t unknown_commands;

/* Command handler */
static void cmd_handler_fn(struct flow_sink *sink, struct net_buf *buf_ref)
{
	if (buf_ref->len < 1) {
		LOG_WRN("Empty command received");
		return;
	}

	uint8_t cmd = buf_ref->data[0];
	commands_processed++;

	switch (cmd) {
	case CMD_START_SAMPLING:
		start_commands++;
		LOG_INF("Command: START sampling (total: %u start, %u stop)", start_commands,
			stop_commands);
		sensor_start_sampling();
		break;

	case CMD_STOP_SAMPLING:
		stop_commands++;
		LOG_INF("Command: STOP sampling (total: %u start, %u stop)", start_commands,
			stop_commands);
		sensor_stop_sampling();
		break;

	default:
		unknown_commands++;
		LOG_WRN("Unknown command: 0x%02x (total unknown: %u)", cmd, unknown_commands);
		break;
	}
}

/* No thread needed for immediate handler - executes in source context */
```

## src/cmd_handler.h
```c
/*
 * Flow Router Sample - Command Handler Module
 *
 * Handles control commands from TCP server (start/stop sampling)
 */

#ifndef CMD_HANDLER_H
#define CMD_HANDLER_H

#include <zephyr_io/flow/flow.h>

/* Command definitions */
#define CMD_START_SAMPLING 0x01
#define CMD_STOP_SAMPLING  0x02

/* Declare command sink for external use */
FLOW_SINK_DECLARE(cmd_sink);

#endif /* CMD_HANDLER_H */
```

## src/protocol.c
```c
/*
 * Packet I/O Sample - Protocol Module Implementation
 *
 * Self-contained packet processor with own buffer pool and thread.
 * Uses flow buffer metadata (packet_id, flags, counter, timestamp).
 */

#include <zephyr/kernel.h>
#include <zephyr/logging/log.h>
#include <zephyr/net/buf.h>
#include <zephyr_io/flow/flow.h>

#include "protocol.h"
#include "sensors.h" /* For packet_id_SENSOR1/2 */

LOG_MODULE_REGISTER(protocol, LOG_LEVEL_INF);

/* Protocol packet header - private to protocol module */
struct packet_header {
	uint8_t packet_id;
	uint8_t reserved;        /* Reserved for future use */
	uint16_t counter;        /* From metadata */
	uint16_t content_length; /* Length of payload (excluding header) */
	uint64_t timestamp_ns;   /* Timestamp in nanoseconds */
} __packed;

/* Buffer pool for protocol headers */
FLOW_BUF_POOL_DEFINE(protocol_pool, 4, sizeof(struct packet_header), NULL);

/* Event queue for protocol sink */
FLOW_EVENT_QUEUE_DEFINE(protocol_queue, 10);

/* Handlers for packet processing */
static void outbound_handler(struct flow_sink *sink, struct net_buf *buf_ref);
static void inbound_handler(struct flow_sink *sink, struct net_buf *buf_ref);

/* Define outbound sink for packets from sensors */
FLOW_SINK_DEFINE_QUEUED(protocol_outbound_sink, outbound_handler, &protocol_queue);

/* Define inbound sink for packets from TCP server */
FLOW_SINK_DEFINE_QUEUED(protocol_inbound_sink, inbound_handler, &protocol_queue);

/* Define sources for forwarding packets */
FLOW_SOURCE_DEFINE(protocol_outbound_source); /* For sending to TCP server */
FLOW_SOURCE_DEFINE(protocol_inbound_source);  /* For sending processed inbound data */

static void outbound_handler(struct flow_sink *sink, struct net_buf *buf_ref)
{
	struct net_buf *header_buf;
	struct packet_header *header;
	uint8_t packet_id;
	uint16_t counter;
	uint64_t cycles;

	/* Allocate buffer for header */
	header_buf = flow_buf_alloc(&protocol_pool, K_NO_WAIT);
	if (!header_buf) {
		LOG_WRN("No buffer for header");
		/* Buffer unref handled by framework */
		return;
	}

	/* Get metadata from incoming buffer */
	if (flow_buf_get_id(buf_ref, &packet_id) != 0) {
		LOG_ERR("No packet ID in buffer");
		net_buf_unref(header_buf);
		return;
	}

	if (flow_buf_get_counter(buf_ref, &counter) != 0) {
		counter = 0;
	}

	if (flow_buf_get_timestamp_cycles(buf_ref, &cycles) != 0) {
		cycles = 0;
	}

	/* Calculate the original payload length before chaining */
	uint16_t payload_len = net_buf_frags_len(buf_ref);

	/* Fill in protocol header with metadata */
	header = (struct packet_header *)net_buf_add(header_buf, sizeof(*header));
	header->packet_id = packet_id;
	header->reserved = 0;
	header->counter = counter;
	header->content_length = payload_len;
	header->timestamp_ns = k_cyc_to_ns_floor64(cycles);

	/* Chain original data after header - frag_add takes ownership of a buffer */
	/* We need to prevent the framework from unreffing our buffer since we're
	 * transferring ownership to the fragment chain. Take a ref for the framework. */

	/* Chain original data after header - frag_add takes ownership of a buffer */
	/* Take a new reference since the framework will unref the original */
	struct net_buf *chain_buf = net_buf_ref(buf_ref);

	/* Safety check: ensure we're not creating circular references */
	if (chain_buf == header_buf) {
		LOG_ERR("CRITICAL: Trying to chain buffer to itself!");
		net_buf_unref(chain_buf);
		net_buf_unref(header_buf);
		return;
	}

	/* Check if chain_buf somehow points back to header_buf */
	if (chain_buf->frags == header_buf) {
		LOG_ERR("CRITICAL: Circular reference detected!");
		net_buf_unref(chain_buf);
		net_buf_unref(header_buf);
		return;
	}

	net_buf_frag_add(header_buf, chain_buf);

	/* Log the processing with detailed packet info */
	size_t total_len = net_buf_frags_len(header_buf);
	LOG_INF("Processed: Sensor %d, counter=%u, timestamp=%llu ns, %zu bytes (header %zu + "
		"payload %u)",
		packet_id, counter, header->timestamp_ns, total_len, sizeof(*header),
		header->content_length);

	/* Forward the packet with header to all connected sinks */
	/* The packet ID is preserved in the buffer for routing */
	/* flow_source_send consumes the buffer reference */
	int ret = flow_source_send(&protocol_outbound_source, header_buf, K_NO_WAIT);
	if (ret <= 0) {
		LOG_ERR("Failed to send to TCP server: %d sinks received", ret);
	}
}

/* Inbound handler - processes packets received from TCP server */
static void inbound_handler(struct flow_sink *sink, struct net_buf *buf_ref)
{
	struct packet_header *header;

	/* Check if buffer has header */
	if (buf_ref->len < sizeof(struct packet_header)) {
		LOG_WRN("Inbound packet too small for header: %d bytes", buf_ref->len);
		return;
	}

	/* Point to header in the buffer */
	header = (struct packet_header *)buf_ref->data;

	/* Restore metadata from protocol header for routing */
	flow_buf_set_id(buf_ref, header->packet_id);
	flow_buf_set_counter(buf_ref, header->counter);

	/* Convert nanoseconds back to cycles for timestamp restoration */
	/* Note: This assumes CONFIG_FLOW_BUF_TIMESTAMP_HIRES is enabled (per prj.conf) */
	uint64_t cycles = k_ns_to_cyc_floor64(header->timestamp_ns);
	flow_buf_set_timestamp_cycles(buf_ref, cycles);

	LOG_INF("Inbound: packet_id=%d, counter=%u, payload=%u bytes", header->packet_id,
		header->counter, buf_ref->len - sizeof(struct packet_header));

	/* Skip past the header to get to the payload */
	net_buf_pull(buf_ref, sizeof(struct packet_header));

	/* Forward the payload (without header) for further processing */
	/* Handler doesn't own the buffer, so use send_ref to preserve the reference */
	flow_source_send_ref(&protocol_inbound_source, buf_ref, K_NO_WAIT);
}

static void protocol_thread_fn(void *p1, void *p2, void *p3)
{
	ARG_UNUSED(p1);
	ARG_UNUSED(p2);
	ARG_UNUSED(p3);

	LOG_INF("Protocol processor started");

	while (1) {
		/* Process events from the queue */
		int ret = flow_event_process(&protocol_queue, K_FOREVER);
		if (ret != 0 && ret != -EAGAIN) {
			LOG_ERR("Failed to process protocol event: %d", ret);
		}
	}
}

/* Auto-start protocol thread */
K_THREAD_DEFINE(protocol_thread, 1024, protocol_thread_fn, NULL, NULL, NULL, 7, 0, 0);
```

## src/protocol.h
```c
/*
 * Packet I/O Sample - Protocol Module
 *
 * Processes packets by adding protocol headers and forwarding
 */

#ifndef PROTOCOL_H
#define PROTOCOL_H

#include <zephyr_io/flow/flow.h>

/* Declare packet sinks and sources for external use */
FLOW_SINK_DECLARE(protocol_outbound_sink);     /* Receives from sensors */
FLOW_SINK_DECLARE(protocol_inbound_sink);      /* Receives from TCP server */
FLOW_SOURCE_DECLARE(protocol_outbound_source); /* Sends to TCP */
FLOW_SOURCE_DECLARE(protocol_inbound_source);  /* Sends processed inbound data */

#endif /* PROTOCOL_H */
```

## src/sensors.c
```c
/*
 * Packet I/O Sample - Sensor Module Implementation
 *
 * Self-contained sensor simulation with own buffer pool and thread
 */

#include <zephyr/kernel.h>
#include <zephyr/logging/log.h>
#include <zephyr/net/buf.h>
#include <zephyr_io/flow/flow.h>

#include "sensors.h"

LOG_MODULE_REGISTER(sensors, LOG_LEVEL_INF);

/* Buffer pool for sensor packets */
FLOW_BUF_POOL_DEFINE(sensor_pool, 8, 512, NULL);

/* Define packet sources */
FLOW_SOURCE_DEFINE(sensor1_source);
FLOW_SOURCE_DEFINE(sensor2_source);

/* Sensor data patterns - simulating larger sensor payloads */
static uint8_t sensor1_data[256]; /* 256 byte payload */
static uint8_t sensor2_data[384]; /* 384 byte payload */

/* Sampling control - using semaphore for thread-safe start/stop */
K_SEM_DEFINE(sampling_sem, 0, 1); /* Start with sampling DISABLED */

static void init_sensor_data(void)
{
	/* Sensor 1: Repeating pattern 0xA1 throughout */
	for (int i = 0; i < sizeof(sensor1_data); i++) {
		sensor1_data[i] = 0xA1;
	}

	/* Sensor 2: Repeating pattern 0xB2 throughout */
	for (int i = 0; i < sizeof(sensor2_data); i++) {
		sensor2_data[i] = 0xB2;
	}
}

static void sensor_thread_fn(void *p1, void *p2, void *p3)
{
	struct net_buf *buf;
	int ret;

	ARG_UNUSED(p1);
	ARG_UNUSED(p2);
	ARG_UNUSED(p3);

	/* Initialize sensor data patterns */
	init_sensor_data();

	LOG_INF("Sensor module started (256B + 384B payloads)");

#ifdef CONFIG_ROUTER_AUTO_START_SAMPLING
	/* Automatically start sampling if configured */
	sensor_start_sampling();
	LOG_INF("Sampling started automatically");
#endif

	while (1) {
		/* Check if sampling is enabled (non-blocking) */
		if (k_sem_count_get(&sampling_sem) > 0) {
			/* Sensor 1 packet - 256 bytes */
			buf = flow_buf_alloc_with_id(&sensor_pool, SOURCE_ID_SENSOR1, K_NO_WAIT);
			if (buf) {
				net_buf_add_mem(buf, sensor1_data, sizeof(sensor1_data));
				ret = flow_source_send(&sensor1_source, buf, K_NO_WAIT);
				LOG_DBG("Sensor 1 sent %d bytes to %d sinks", sizeof(sensor1_data),
					ret);
			}

			/* Sensor 2 packet - 384 bytes */
			buf = flow_buf_alloc_with_id(&sensor_pool, SOURCE_ID_SENSOR2, K_NO_WAIT);
			if (buf) {
				net_buf_add_mem(buf, sensor2_data, sizeof(sensor2_data));
				ret = flow_source_send(&sensor2_source, buf, K_NO_WAIT);
				LOG_DBG("Sensor 2 sent %d bytes to %d sinks", sizeof(sensor2_data),
					ret);
			}

			/* Sleep between packet generations */
			k_sleep(K_MSEC(100)); /* Sample every 100ms for faster testing */
		} else {
			/* When sampling is disabled, sleep until enabled */
			k_sleep(K_MSEC(100));
		}
	}
}

/* Control functions */
void sensor_start_sampling(void)
{
	k_sem_give(&sampling_sem);
}

void sensor_stop_sampling(void)
{
	k_sem_reset(&sampling_sem);
}

/* Static thread initialization - starts automatically */
K_THREAD_DEFINE(sensor_thread, 1024, sensor_thread_fn, NULL, NULL, NULL, 7, 0, 0);
```

## src/sensors.h
```c
/*
 * Packet I/O Sample - Sensor Module
 *
 * Simulates sensor data sources generating packets
 */

#ifndef SENSORS_H
#define SENSORS_H

#include <zephyr_io/flow/flow.h>

/* Source IDs for sensors */
#define SOURCE_ID_SENSOR1 1
#define SOURCE_ID_SENSOR2 2

/* Declare packet sources for external use */
FLOW_SOURCE_DECLARE(sensor1_source);
FLOW_SOURCE_DECLARE(sensor2_source);

/* Control functions */
void sensor_start_sampling(void);
void sensor_stop_sampling(void);

#endif /* SENSORS_H */
```

## src/tcp_server.c
```c
/*
 * Flow Router Sample - TCP Server Implementation
 *
 * Generic TCP server that forwards packets bidirectionally
 */

#include <zephyr/kernel.h>
#include <zephyr/logging/log.h>
#include <zephyr/net/buf.h>
#include <zephyr/net/socket.h>
#include <zephyr_io/flow/flow.h>

#include "tcp_server.h"

LOG_MODULE_REGISTER(tcp_server, LOG_LEVEL_INF);

/* Event queue for TCP sink */
FLOW_EVENT_QUEUE_DEFINE(tcp_queue, 10);

/* Buffer pool for TCP receive */
FLOW_BUF_POOL_DEFINE(tcp_rx_pool, 3, 256, NULL);

/* Handler for TCP sink - receives packets to send to TCP client */
static void tcp_sink_handler(struct flow_sink *sink, struct net_buf *buf_ref);

/* Define TCP sink with queued handler */
FLOW_SINK_DEFINE_QUEUED(tcp_sink, tcp_sink_handler, &tcp_queue);

/* Define TCP source - forwards incoming packets from TCP client */
FLOW_SOURCE_DEFINE(tcp_rx_source);

/* TCP server state */
static int server_sock = -1;
static int client_sock = -1;
static bool client_connected = false;

/* Statistics */
static uint32_t packets_sent;
static uint32_t bytes_sent;
static uint32_t packets_received;

/* TCP sink handler - sends packets to connected client */
static void tcp_sink_handler(struct flow_sink *sink, struct net_buf *buf_ref)
{
	LOG_INF("TCP sink handler called, client_connected=%d, client_sock=%d", client_connected,
		client_sock);

	if (!client_connected || client_sock < 0) {
		LOG_WRN("No client connected, dropping packet");
		return;
	}

	/* Send the complete packet (with protocol header) to TCP client */
	struct net_buf *frag = buf_ref;
	ssize_t sent_total = 0;

	while (frag) {
		ssize_t sent = send(client_sock, frag->data, frag->len, 0);
		if (sent < 0) {
			if (errno == EAGAIN || errno == EWOULDBLOCK) {
				LOG_WRN("TCP send would block");
				break;
			}
			LOG_ERR("TCP send failed: %d", errno);
			client_connected = false;
			close(client_sock);
			client_sock = -1;
			return;
		}
		sent_total += sent;
		frag = frag->frags;
	}

	if (sent_total > 0) {
		packets_sent++;
		bytes_sent += sent_total;
		LOG_DBG("Sent %zd bytes to TCP client (total: %u packets, %u bytes)", sent_total,
			packets_sent, bytes_sent);
	}
}

/* TCP server thread */
static void tcp_server_thread_fn(void *p1, void *p2, void *p3)
{
	ARG_UNUSED(p1);
	ARG_UNUSED(p2);
	ARG_UNUSED(p3);

	struct sockaddr_in addr;
	int ret;

	LOG_INF("TCP server starting on port %d", TCP_SERVER_PORT);

	/* Create TCP socket */
	server_sock = socket(AF_INET, SOCK_STREAM, IPPROTO_TCP);
	if (server_sock < 0) {
		LOG_ERR("Failed to create socket: %d", errno);
		return;
	}

	/* Enable address reuse */
	int optval = 1;
	setsockopt(server_sock, SOL_SOCKET, SO_REUSEADDR, &optval, sizeof(optval));

	/* Bind to port */
	addr.sin_family = AF_INET;
	addr.sin_port = htons(TCP_SERVER_PORT);
	addr.sin_addr.s_addr = INADDR_ANY;

	ret = bind(server_sock, (struct sockaddr *)&addr, sizeof(addr));
	if (ret < 0) {
		LOG_ERR("Failed to bind socket: %d", errno);
		close(server_sock);
		return;
	}

	/* Listen for connections */
	ret = listen(server_sock, 1);
	if (ret < 0) {
		LOG_ERR("Failed to listen: %d", errno);
		close(server_sock);
		return;
	}

	/* Set accept timeout to allow cooperative scheduling */
	struct timeval accept_timeout;
	accept_timeout.tv_sec = 0;
	accept_timeout.tv_usec = 100000; /* 100ms */
	setsockopt(server_sock, SOL_SOCKET, SO_RCVTIMEO, &accept_timeout, sizeof(accept_timeout));

	LOG_INF("TCP server listening on 127.0.0.1:%d", TCP_SERVER_PORT);

	while (1) {
		struct sockaddr_in client_addr;
		socklen_t client_addr_len = sizeof(client_addr);

		/* Accept client connection (with timeout for native_sim compatibility) */
		client_sock =
			accept(server_sock, (struct sockaddr *)&client_addr, &client_addr_len);
		if (client_sock < 0) {
			if (errno == EAGAIN || errno == EWOULDBLOCK) {
				/* Timeout - yield to other threads and retry */
				k_sleep(K_MSEC(10));
				continue;
			}
			LOG_ERR("Failed to accept connection: %d", errno);
			k_sleep(K_SECONDS(1));
			continue;
		}

		client_connected = true;
		char addr_str[INET_ADDRSTRLEN];
		inet_ntop(AF_INET, &client_addr.sin_addr, addr_str, sizeof(addr_str));
		LOG_INF("Client connected from %s:%d", addr_str, ntohs(client_addr.sin_port));

		/* Handle client communication */
		while (client_connected) {
			/* Allocate buffer from pool */
			struct net_buf *rx_buf = flow_buf_alloc(&tcp_rx_pool, K_NO_WAIT);
			if (!rx_buf) {
				LOG_WRN("No buffer available for TCP RX");
				k_sleep(K_MSEC(10));
				continue;
			}

			/* Read directly into buffer */
			ssize_t received =
				recv(client_sock, rx_buf->data, net_buf_tailroom(rx_buf), 0);
			if (received < 0) {
				if (errno == EAGAIN || errno == EWOULDBLOCK) {
					net_buf_unref(rx_buf);
					k_sleep(K_MSEC(10));
					continue;
				}
				LOG_ERR("TCP recv failed: %d", errno);
				net_buf_unref(rx_buf);
				break;
			} else if (received == 0) {
				LOG_INF("Client disconnected");
				net_buf_unref(rx_buf);
				break;
			}

			/* Update buffer length */
			net_buf_add(rx_buf, received);
			packets_received++;

			LOG_DBG("Received %zd bytes from TCP client (total: %u packets)", received,
				packets_received);

			/* Forward packet through flow system */
			int ret = flow_source_send(&tcp_rx_source, rx_buf, K_NO_WAIT);
			if (ret <= 0) {
				LOG_WRN("Failed to forward packet from TCP client");
			}
		}

		/* Client disconnected */
		client_connected = false;
		close(client_sock);
		client_sock = -1;
		LOG_INF("Client session ended");
	}
}

/* Event processing thread */
static void tcp_event_thread_fn(void *p1, void *p2, void *p3)
{
	ARG_UNUSED(p1);
	ARG_UNUSED(p2);
	ARG_UNUSED(p3);

	LOG_INF("TCP event processor started");

	while (1) {
		/* Process events from the TCP queue */
		int ret = flow_event_process(&tcp_queue, K_FOREVER);
		if (ret != 0 && ret != -EAGAIN) {
			LOG_ERR("Failed to process TCP event: %d", ret);
		}
	}
}

/* Auto-start threads */
K_THREAD_DEFINE(tcp_server_thread, 2048, tcp_server_thread_fn, NULL, NULL, NULL, 7, 0, 0);
K_THREAD_DEFINE(tcp_event_thread, 1024, tcp_event_thread_fn, NULL, NULL, NULL, 7, 0, 0);
```

## src/tcp_server.h
```c
/*
 * Flow Router Sample - TCP Server Module
 *
 * Generic TCP server that forwards packets bidirectionally
 */

#ifndef TCP_SERVER_H
#define TCP_SERVER_H

#include <zephyr_io/flow/flow.h>

/* TCP server port */
#define TCP_SERVER_PORT 4242

/* Declare flow sink for packets to send to TCP client */
FLOW_SINK_DECLARE(tcp_sink);

/* Declare flow source for packets received from TCP client */
FLOW_SOURCE_DECLARE(tcp_rx_source);

#endif /* TCP_SERVER_H */
```
