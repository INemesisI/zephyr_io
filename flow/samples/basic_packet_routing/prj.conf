## CMakeLists.txt
```
# SPDX-License-Identifier: Apache-2.0

cmake_minimum_required(VERSION 3.20.0)
find_package(Zephyr REQUIRED HINTS $ENV{ZEPHYR_BASE})
project(flow_basic_sample)

target_sources(app PRIVATE
    src/main.c
    src/sensors.c
    src/processor.c
    src/echo.c
    src/validator.c
)
```

## sample.yaml
```
sample:
  description: Modular packet processing pipeline with header addition, TCP transmission, and integrity validation
  name: Packet I/O Basic Routing Sample
tests:
  sample.flow.basic_routing:
    tags:
      - flow
      - samples
      - networking
      - validation
    harness: console
    harness_config:
      type: multi_line
      ordered: false
      regex:
        - "Sensor module started \\(256B \\+ 384B payloads\\)"
        - "Echo server started"
        - "Sensor 1 validator started \\(immediate mode, filtering ID=0x01\\)"
        - "Sensor 2 validator started \\(immediate mode, filtering ID=0x02\\)"
        - "Packet processor started"
        - "SENSOR1 VALID: [0-9]+ bytes"
        - "SENSOR2 VALID: [0-9]+ bytes"
    timeout: 5
    min_ram: 32
    integration_platforms:
      - native_sim
    platform_allow:
      - native_sim
      - qemu_x86
      - qemu_cortex_m3
```

## prj.conf
```kconfig
# Packet I/O Basic Sample Configuration

# Enable packet I/O subsystem
CONFIG_FLOW=y
CONFIG_FLOW_NAMES=y
CONFIG_FLOW_STATS=y

# Enable networking buffer support
CONFIG_NET_BUF=y

# Enable logging
CONFIG_LOG=y
CONFIG_LOG_DEFAULT_LEVEL=3

# Enable assertions to catch bugs
CONFIG_ASSERT=y
CONFIG_ASSERT_LEVEL=2

# Enable poll support for efficient multi-sink handling
CONFIG_POLL=y

# Thread configuration
CONFIG_MAIN_STACK_SIZE=2048
```

## src/main.c
```c
/*
 * Flow Basic Sample - Main
 *
 * Demonstrates modular packet routing with header addition, echo server, and
 * validation. Each module (sensors, processor, echo, validators) is
 * self-contained with its own thread and buffer pool, initialized automatically
 * via K_THREAD_DEFINE.
 *
 * Packet flow:
 *   sensor1_source ─┐                                      ┌─→ echo_sink (echo
 * server) ├─→ processor_sink → processor_source ─┤          ↓ sensor2_source ─┘
 * │    echo_source ↓          ↓ validator1  processor_echo_sink validator2 ↓ ↑
 * processor_source └────────────┘
 */

#include <zephyr/kernel.h>
#include <zephyr/logging/log.h>
#include <zephyr_io/flow/flow.h>

#include "echo.h"
#include "processor.h"
#include "sensors.h"
#include "validator.h"

LOG_MODULE_REGISTER(main, LOG_LEVEL_INF);

/* Wire up the connections at compile time */
/* Sensors to processor outbound */
FLOW_CONNECT(&sensor1_source, &processor_outbound_sink);
FLOW_CONNECT(&sensor2_source, &processor_outbound_sink);

/* Processor outbound to echo server only */
FLOW_CONNECT(&processor_outbound_source, &echo_sink);

/* Echo server back to processor inbound */
FLOW_CONNECT(&echo_source, &processor_inbound_sink);

/* Processor inbound to validators (routed by packet ID) */
FLOW_CONNECT(&processor_inbound_source, &validator1_sink);
FLOW_CONNECT(&processor_inbound_source, &validator2_sink);

int main(void)
{
	LOG_INF("Packet I/O Routing Sample with Echo Server");
	LOG_INF("===========================================");
	LOG_INF("Demonstrating packet routing with ID-based filtering:");
	LOG_INF("  1. Sensors generate packets with unique IDs");
	LOG_INF("  2. Processor adds headers and forwards to echo server");
	LOG_INF("  3. Echo server sends packets back");
	LOG_INF("  4. Processor routes echoed packets to validators");
	LOG_INF("  5. Validators filter packets by sensor ID");
	LOG_INF("");
	LOG_INF("Module threads start automatically:");
	LOG_INF("  - Sensors: Generate test packets with IDs");
	LOG_INF("  - Processor: Add headers and route packets");
	LOG_INF("  - Echo: Echo server");
	LOG_INF("  - Validators: Per-sensor packet validation");

	/* All threads start automatically via K_THREAD_DEFINE */
	/* Main thread can just sleep */
	while (1) {
		k_sleep(K_FOREVER);
	}

	return 0;
}
```

## src/echo.c
```c
/*
 * Packet I/O Sample - Echo Module Implementation
 *
 * Echo Server - receives packets and echoes them back
 */

#include <zephyr/kernel.h>
#include <zephyr/logging/log.h>
#include <zephyr/net/buf.h>
#include <zephyr_io/flow/flow.h>

#include "echo.h"

LOG_MODULE_REGISTER(echo, LOG_LEVEL_INF);

/* Event queue for echo sink */
FLOW_EVENT_QUEUE_DEFINE(echo_queue, 10);

/* Handler for echo server */
static void echo_handler(struct flow_sink *sink, struct net_buf *buf);

/* Define echo sink with queued handler */
FLOW_SINK_DEFINE_QUEUED(echo_sink, echo_handler, &echo_queue);

/* Define echo source - sends received packets back */
FLOW_SOURCE_DEFINE(echo_source);

/* Echo statistics */
static uint32_t packets_received;
static uint32_t packets_echoed;
static uint32_t bytes_processed;
static uint32_t first_packet_time;

static void echo_handler(struct flow_sink *sink, struct net_buf *buf)
{
	size_t total_len = net_buf_frags_len(buf);
	int ret;

	/* Track first packet time for rate calculation */
	if (packets_received == 0) {
		first_packet_time = k_uptime_get_32();
	}

	packets_received++;
	bytes_processed += total_len;

	/* Echo the packet back to the processor */
	/* The packet ID is already stamped in the buffer by the routed source */
	ret = flow_source_send(&echo_source, buf, K_NO_WAIT);
	if (ret > 0) {
		packets_echoed++;
	} else {
		LOG_WRN("ECHO: Failed to send packet back");
	}

	/* Log statistics periodically */
	if (packets_received % 10 == 0) {
		uint32_t elapsed = k_uptime_get_32() - first_packet_time;
		if (elapsed > 0) {
			uint32_t rate = (bytes_processed * 1000) / elapsed;
			LOG_INF("Echo Stats: RX=%u, Echoed=%u, %u bytes, %u B/s", packets_received,
				packets_echoed, bytes_processed, rate);
		}
	}

	/* Buffer unref handled by framework */
}

static void echo_thread_fn(void *p1, void *p2, void *p3)
{
	ARG_UNUSED(p1);
	ARG_UNUSED(p2);
	ARG_UNUSED(p3);

	LOG_INF("Echo server started");

	while (1) {
		/* Process events from the echo queue */
		int ret = flow_event_process(&echo_queue, K_FOREVER);
		if (ret != 0 && ret != -EAGAIN) {
			LOG_ERR("Failed to process echo event: %d", ret);
		}
	}
}

/* Auto-start echo thread */
K_THREAD_DEFINE(echo_thread, 1024, echo_thread_fn, NULL, NULL, NULL, 7, 0, 0);
```

## src/echo.h
```c
/*
 * Packet I/O Sample - Echo Module
 *
 * Echo Server - receives packets and echoes them back
 */

#ifndef ECHO_H
#define ECHO_H

#include <zephyr_io/flow/flow.h>

/* Declare packet sink and echo source for external use */
FLOW_SINK_DECLARE(echo_sink);
FLOW_SOURCE_DECLARE(echo_source);

#endif /* ECHO_H */
```

## src/network.c
```c
/*
 * Packet I/O Sample - Network Module Implementation
 *
 * Self-contained TCP network transmitter
 */

#include <zephyr/kernel.h>
#include <zephyr/net/buf.h>
#include <zephyr_io/flow/flow.h>
#include <zephyr/logging/log.h>

#include "network.h"
#include "packet_defs.h"

LOG_MODULE_REGISTER(network, LOG_LEVEL_INF);

/* Event queue for network sink */
FLOW_EVENT_QUEUE_DEFINE(network_queue, 10);

/* Handler for TCP transmission */
static void tcp_handler(struct flow_sink *sink, struct net_buf *buf);

/* Define TCP network sink with queued handler */
FLOW_SINK_DEFINE_QUEUED(tcp_sink, tcp_handler, network_queue);

/* Network statistics */
static uint32_t packets_transmitted;
static uint32_t bytes_transmitted;
static uint32_t first_packet_time;

static void tcp_handler(struct flow_sink *sink, struct net_buf *buf)
{
	size_t total_len = net_buf_frags_len(buf);

	/* Track first packet time for rate calculation */
	if (packets_transmitted == 0) {
		first_packet_time = k_uptime_get_32();
	}

	/* Simulate TCP transmission with guaranteed delivery */
	k_msleep(50); /* Simulate network latency */

	/* Parse and log packet header if present */
	if (buf->len >= sizeof(struct packet_header)) {
		struct packet_header *hdr = (struct packet_header *)buf->data;
		LOG_INF("TCP TX: Sensor %d, Type %02x, Seq %u, %zu bytes", hdr->source_id,
			hdr->packet_type, hdr->sequence, total_len);
	} else {
		LOG_INF("TCP TX: %zu bytes (no header)", total_len);
	}

	/* Update statistics */
	packets_transmitted++;
	bytes_transmitted += total_len;

	/* Log statistics with every packet */
	uint32_t elapsed = k_uptime_get_32() - first_packet_time;
	if (elapsed > 0) {
		uint32_t rate = (bytes_transmitted * 1000) / elapsed;
		LOG_INF("TCP Stats: %u packets, %u bytes, %u B/s", packets_transmitted,
			bytes_transmitted, rate);
	}

	/* Buffer unref handled by framework */
}

static void network_thread_fn(void *p1, void *p2, void *p3)
{
	ARG_UNUSED(p1);
	ARG_UNUSED(p2);
	ARG_UNUSED(p3);

	LOG_INF("TCP network transmitter started");

	while (1) {
		/* Process events from the network queue */
		int ret = flow_event_process(&network_queue, K_FOREVER);
		if (ret != 0 && ret != -EAGAIN) {
			LOG_ERR("Failed to process network event: %d", ret);
		}
	}
}

/* Auto-start network thread */
K_THREAD_DEFINE(network_thread, 1024, network_thread_fn, NULL, NULL, NULL, 7, 0, 0);
```

## src/network.h
```c
/*
 * Packet I/O Sample - Network Module
 *
 * Handles TCP network transmission
 */

#ifndef NETWORK_H
#define NETWORK_H

#include <zephyr_io/flow/flow.h>

/* Declare packet sink for external use */
FLOW_SINK_DECLARE(tcp_sink);

#endif /* NETWORK_H */
```

## src/packet_defs.h
```c
/*
 * Packet I/O Sample - Common Definitions
 *
 * Shared packet structures used by all modules
 */

#ifndef PACKET_DEFS_H
#define PACKET_DEFS_H

#include <stdint.h>

/* Define a simple header structure */
struct packet_header {
	uint8_t source_id;
	uint8_t packet_type;
	uint16_t sequence;
	uint32_t timestamp;
	uint16_t content_length; /* Length of payload (excluding header) */
	uint16_t reserved;       /* Reserved for future use */
} __packed;

/* Packet types */
#define PACKET_TYPE_DATA    0x01
#define PACKET_TYPE_CONTROL 0x02

/* Source IDs */
#define SOURCE_ID_SENSOR1 1
#define SOURCE_ID_SENSOR2 2

#endif /* PACKET_DEFS_H */
```

## src/processor.c
```c
/*
 * Packet I/O Sample - Processor Module Implementation
 *
 * Self-contained packet processor with own buffer pool and thread
 */

#include <zephyr/kernel.h>
#include <zephyr/logging/log.h>
#include <zephyr/net/buf.h>
#include <zephyr_io/flow/flow.h>

#include "processor.h"
#include "sensors.h" /* For packet_id_SENSOR1/2 */

LOG_MODULE_REGISTER(processor, LOG_LEVEL_INF);

/* Simplified packet header - private to processor module */
struct packet_header {
	uint16_t packet_id;
	uint16_t content_length; /* Length of payload (excluding header) */
} __packed;

/* Processor module's own buffer pool (small - only for headers) */
NET_BUF_POOL_DEFINE(processor_pool, 16, sizeof(struct packet_header), 4, NULL);

/* Event queue for processor sink */
FLOW_EVENT_QUEUE_DEFINE(processor_queue, 10);

/* Handlers for packet processing */
static void outbound_handler(struct flow_sink *sink, struct net_buf *buf);
static void inbound_handler(struct flow_sink *sink, struct net_buf *buf);

/* Define outbound sink for packets from sensors */
FLOW_SINK_DEFINE_QUEUED(processor_outbound_sink, outbound_handler, &processor_queue);

/* Define inbound sink for packets from echo server */
FLOW_SINK_DEFINE_QUEUED(processor_inbound_sink, inbound_handler, &processor_queue);

/* Define sources for forwarding packets */
FLOW_SOURCE_DEFINE(processor_outbound_source); /* For sending to echo server */
FLOW_SOURCE_DEFINE(processor_inbound_source);  /* For sending to validators */

static void outbound_handler(struct flow_sink *sink, struct net_buf *buf)
{
	struct net_buf *header_buf;
	struct packet_header *header;

	/* Allocate buffer for header */
	header_buf = net_buf_alloc(&processor_pool, K_NO_WAIT);
	if (!header_buf) {
		LOG_WRN("No buffer for header");
		/* Buffer unref handled by framework */
		return;
	}

	/* Get source ID from packet ID in buffer's user data (set by
	 * FLOW_SOURCE_DEFINE_ROUTED) */
	uint16_t packet_id;
	if (flow_packet_id_get(buf, &packet_id) != 0) {
		/* If no packet ID available, default to unknown source */
		LOG_ERR("No packet ID in buffer, using source ID 0");
		return;
	}

	/* Calculate the original payload length before chaining */
	uint16_t payload_len = net_buf_frags_len(buf);

	/* Fill in simplified header */
	header = (struct packet_header *)net_buf_add(header_buf, sizeof(*header));
	header->packet_id = packet_id;
	header->content_length = payload_len; /* Set payload length */

	/* Chain original data after header - frag_add takes ownership of buf */
	/* Add reference since handler doesn't own the buffer it received */
	buf = net_buf_ref(buf);
	net_buf_frag_add(header_buf, buf);

	/* Log the processing with detailed packet info */
	size_t total_len = net_buf_frags_len(header_buf);
	LOG_INF("Processed: Sensor %d, %zu bytes (header %zu + payload %u)", packet_id, total_len,
		sizeof(*header), header->content_length);

	/* Forward the packet with header to all connected sinks */
	/* The packet ID is preserved in the buffer for routing */
	flow_source_send(&processor_outbound_source, header_buf, K_NO_WAIT);
}

/* Inbound handler - processes packets echoed back from TCP server */
static void inbound_handler(struct flow_sink *sink, struct net_buf *buf)
{
	struct packet_header *header;
	struct net_buf *payload_buf;

	/* Check if buffer has header */
	if (buf->len < sizeof(struct packet_header)) {
		LOG_WRN("Echo packet too small for header: %d bytes", buf->len);
		return;
	}

	header = (struct packet_header *)buf->data;

	/* Get the payload buffer - it's in the fragment chain after the header */
	if (!buf->frags) {
		LOG_WRN("No payload fragment in echoed packet");
		return;
	}

	payload_buf = buf->frags;

	/* Forward only the payload (without header) to the correct validator */
	/* flow_source_send takes its own reference, so we don't need to ref/unref */
	flow_source_send_routed(&processor_inbound_source, payload_buf, K_NO_WAIT,
				header->packet_id);
}

static void processor_thread_fn(void *p1, void *p2, void *p3)
{
	ARG_UNUSED(p1);
	ARG_UNUSED(p2);
	ARG_UNUSED(p3);

	LOG_INF("Packet processor started");

	while (1) {
		/* Process events from the queue */
		int ret = flow_event_process(&processor_queue, K_FOREVER);
		if (ret != 0 && ret != -EAGAIN) {
			LOG_ERR("Failed to process packet event: %d", ret);
		}
	}
}

/* Auto-start processor thread */
K_THREAD_DEFINE(processor_thread, 1024, processor_thread_fn, NULL, NULL, NULL, 7, 0, 0);
```

## src/processor.h
```c
/*
 * Packet I/O Sample - Processor Module
 *
 * Processes packets by adding headers and forwarding
 */

#ifndef PROCESSOR_H
#define PROCESSOR_H

#include <zephyr_io/flow/flow.h>

/* Declare packet sinks and sources for external use */
FLOW_SINK_DECLARE(processor_outbound_sink);     /* Receives from sensors */
FLOW_SINK_DECLARE(processor_inbound_sink);      /* Receives echoed packets from TCP */
FLOW_SOURCE_DECLARE(processor_outbound_source); /* Sends to TCP */
FLOW_SOURCE_DECLARE(processor_inbound_source);  /* Sends to validators */

#endif /* PROCESSOR_H */
```

## src/sensors.c
```c
/*
 * Packet I/O Sample - Sensor Module Implementation
 *
 * Self-contained sensor simulation with own buffer pool and thread
 */

#include <zephyr/kernel.h>
#include <zephyr/logging/log.h>
#include <zephyr/net/buf.h>
#include <zephyr_io/flow/flow.h>

#include "sensors.h"

LOG_MODULE_REGISTER(sensors, LOG_LEVEL_INF);

/* Sensor module's own buffer pool - larger for bigger packets */
NET_BUF_POOL_DEFINE(sensor_pool, 8, 512, 4, NULL);

/* Define packet sources with unique packet IDs */
FLOW_SOURCE_DEFINE_ROUTED(sensor1_source, SOURCE_ID_SENSOR1);
FLOW_SOURCE_DEFINE_ROUTED(sensor2_source, SOURCE_ID_SENSOR2);

/* Sensor data patterns - simulating larger sensor payloads */
static uint8_t sensor1_data[256]; /* 256 byte payload */
static uint8_t sensor2_data[384]; /* 384 byte payload */

static void init_sensor_data(void)
{
	/* Sensor 1: Repeating pattern 0xA1 throughout */
	for (int i = 0; i < sizeof(sensor1_data); i++) {
		sensor1_data[i] = 0xA1;
	}

	/* Sensor 2: Repeating pattern 0xB2 throughout */
	for (int i = 0; i < sizeof(sensor2_data); i++) {
		sensor2_data[i] = 0xB2;
	}
}

static void sensor_thread_fn(void *p1, void *p2, void *p3)
{
	struct net_buf *buf;
	int ret;

	ARG_UNUSED(p1);
	ARG_UNUSED(p2);
	ARG_UNUSED(p3);

	/* Initialize sensor data patterns */
	init_sensor_data();

	LOG_INF("Sensor module started (256B + 384B payloads)");

	while (1) {
		/* Sensor 1 packet - 256 bytes */
		buf = net_buf_alloc(&sensor_pool, K_NO_WAIT);
		if (buf) {
			net_buf_add_mem(buf, sensor1_data, sizeof(sensor1_data));
			ret = flow_source_send(&sensor1_source, buf, K_NO_WAIT);
			LOG_DBG("Sensor 1 sent %d bytes to %d sinks", sizeof(sensor1_data), ret);
			net_buf_unref(buf);
		}

		for (int i = 0; i < 2; i++) {
			/* Sensor 2 packet - 384 bytes */
			buf = net_buf_alloc(&sensor_pool, K_NO_WAIT);
			if (buf) {
				net_buf_add_mem(buf, sensor2_data, sizeof(sensor2_data));
				ret = flow_source_send_consume(&sensor2_source, buf, K_NO_WAIT);
				LOG_DBG("Sensor 2 sent %d bytes to %d sinks", sizeof(sensor2_data),
					ret);
			}

			k_sleep(K_MSEC(500)); /* Faster data rate */
		}
	}
}

/* Static thread initialization - starts automatically */
K_THREAD_DEFINE(sensor_thread, 1024, sensor_thread_fn, NULL, NULL, NULL, 7, 0, 0);
```

## src/sensors.h
```c
/*
 * Packet I/O Sample - Sensor Module
 *
 * Simulates sensor data sources generating packets
 */

#ifndef SENSORS_H
#define SENSORS_H

#include <zephyr_io/flow/flow.h>

/* Source IDs for sensors */
#define SOURCE_ID_SENSOR1 1
#define SOURCE_ID_SENSOR2 2

/* Declare packet sources for external use */
FLOW_SOURCE_DECLARE(sensor1_source);
FLOW_SOURCE_DECLARE(sensor2_source);

#endif /* SENSORS_H */
```

## src/validator.c
```c
/*
 * Packet I/O Sample - Validator Module Implementation
 *
 * Self-contained packet validator checking integrity and content
 */

#include <zephyr/kernel.h>
#include <zephyr/logging/log.h>
#include <zephyr/net/buf.h>
#include <zephyr_io/flow/flow.h>

#include "sensors.h" /* For SOURCE_ID_SENSOR1/2 */
#include "validator.h"

LOG_MODULE_REGISTER(validator, LOG_LEVEL_INF);

/* Forward declaration of handler function */
static void validator_handler(struct flow_sink *sink, struct net_buf *buf);

/* Define routed validator sinks with immediate execution - filter by packet ID
 */
FLOW_SINK_DEFINE_ROUTED_IMMEDIATE(validator1_sink, validator_handler, SOURCE_ID_SENSOR1, NULL);
FLOW_SINK_DEFINE_ROUTED_IMMEDIATE(validator2_sink, validator_handler, SOURCE_ID_SENSOR2, NULL);

/* Validator context with per-sensor statistics */
struct validator_ctx {
	uint8_t sensor_id;
	const char *name;
	uint32_t validated;
	uint32_t failed;
	bool first_packet;
	uint8_t expected_pattern;
	size_t expected_size;
	struct flow_sink *expected_sink; /* To verify correct sink is called */
};

/* Context for each validator */
static struct validator_ctx sensor1_ctx = {.sensor_id = SOURCE_ID_SENSOR1,
					   .name = "SENSOR1",
					   .first_packet = true,
					   .expected_pattern = 0xA1, /* Sensor 1 sends all 0xA1 */
					   .expected_size = 256,
					   .expected_sink = &validator1_sink};

static struct validator_ctx sensor2_ctx = {.sensor_id = SOURCE_ID_SENSOR2,
					   .name = "SENSOR2",
					   .first_packet = true,
					   .expected_pattern = 0xB2, /* Sensor 2 sends all 0xB2 */
					   .expected_size = 384,
					   .expected_sink = &validator2_sink};

/* Now update the sinks to use the contexts */
static void __attribute__((constructor)) init_sink_contexts(void)
{
	validator1_sink.user_data = &sensor1_ctx;
	validator2_sink.user_data = &sensor2_ctx;
}

/* Common validation handler */
static void validator_handler(struct flow_sink *sink, struct net_buf *buf)
{
	struct validator_ctx *ctx = (struct validator_ctx *)sink->user_data;
	size_t data_len = net_buf_frags_len(buf);

	/* Verify correct sink is being called */
	if (sink != ctx->expected_sink) {
		LOG_ERR("%s: Wrong sink called! Expected %p, got %p", ctx->name, ctx->expected_sink,
			sink);
		return;
	}

	/* Log startup message on first packet (required for test harness) */
	if (ctx->first_packet) {
		LOG_INF("Sensor %d validator started (immediate mode, filtering ID=0x%02x)",
			ctx->sensor_id, ctx->sensor_id);
		ctx->first_packet = false;
	}

	/* Validate packet size and content */
	bool valid = true;

	/* Check size first */
	if (data_len != ctx->expected_size) {
		LOG_ERR("%s: Size mismatch: Expected %zu, Got %zu", ctx->name, ctx->expected_size,
			data_len);
		valid = false;
	}

	/* Check payload content - verify all bytes match the pattern */
	for (size_t i = 0; i < buf->len; i++) {
		if (buf->data[i] != ctx->expected_pattern) {
			LOG_ERR("%s: Wrong byte at %zu: Expected 0x%02x, Got 0x%02x", ctx->name, i,
				ctx->expected_pattern, buf->data[i]);
			valid = false;
			break;
		}
	}

	/* Update statistics and log result */
	if (valid) {
		ctx->validated++;
		LOG_INF("%s VALID: %zu bytes [Total: %d valid, %d failed]", ctx->name, data_len,
			ctx->validated, ctx->failed);
	} else {
		ctx->failed++;
		LOG_ERR("%s INVALID: %zu bytes [Total: %d valid, %d failed]", ctx->name, data_len,
			ctx->validated, ctx->failed);
	}
}

/* No thread needed for immediate handler - executes in source context */
```

## src/validator.h
```c
/*
 * Packet I/O Sample - Validator Module
 *
 * Validates packet integrity and content correctness
 */

#ifndef VALIDATOR_H
#define VALIDATOR_H

#include <zephyr_io/flow/flow.h>

/* Declare routed validator sinks for external use */
FLOW_SINK_DECLARE(validator1_sink); /* For sensor 1 packets */
FLOW_SINK_DECLARE(validator2_sink); /* For sensor 2 packets */

#endif /* VALIDATOR_H */
```
