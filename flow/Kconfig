## swift_io/subsys/swift_router/Kconfig
```kconfig
# SPDX-License-Identifier: Apache-2.0

config SWIFT_ROUTER
	bool "Swift router framework"
	depends on SWIFT_IO
	help
	  Enable the Swift router framework for protocol-agnostic
	  packet routing with header addition/removal.

	  This framework provides a reusable routing engine that can
	  be used to implement any protocol requiring bidirectional
	  packet transformation and routing based on packet IDs.

if SWIFT_ROUTER

config SWIFT_ROUTER_LOG_LEVEL
	int "Swift router log level"
	depends on LOG
	default 2
	range 0 4
	help
	  Set the logging level for the Swift router subsystem.
	  0 = OFF
	  1 = ERROR
	  2 = WARNING
	  3 = INFO
	  4 = DEBUG

endif # SWIFT_ROUTER
```
