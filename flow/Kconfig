## flow/Kconfig
```kconfig
# SPDX-License-Identifier: Apache-2.0

rsource "subsys/flow/Kconfig"
rsource "subsys/flow_router/Kconfig"
```

## flow/samples/router_sample/testcase.yaml
```yaml
tests:
  sample.flow.router_tcp:
    harness: pytest
    platform_allow: native_sim
    integration_platforms:
      - native_sim
    tags:
      - flow
      - tcp
      - samples
```

## flow/subsys/flow/Kconfig
```kconfig
# SPDX-License-Identifier: Apache-2.0

menuconfig FLOW
	bool "Flow - Fast Lightweight Object Wiring"
	select NET_BUF
	help
	  Enable the Flow subsystem. This provides a zero-copy
	  mechanism for distributing net_buf packets from sources to
	  multiple sinks using reference counting.

if FLOW

config FLOW_NAMES
	bool "Enable names for sources and sinks"
	default y if DEBUG
	help
	  Enable string names for packet sources, sinks, and event processors.
	  This adds a const char* field to each structure for debugging and
	  logging purposes. Disable to save memory in production builds.

config FLOW_STATS
	bool "Enable Flow statistics"
	default y if DEBUG
	help
	  Enable statistics tracking for packet sources and sinks.
	  This includes message counts, drop counts, and delivery counts.

config FLOW_RUNTIME_OBSERVERS
	bool "Runtime observer registration"
	help
	  Enable runtime registration and deregistration of observers.
	  If disabled, all connections must be defined at compile time.

config FLOW_RUNTIME_CONNECTION_POOL_SIZE
	int "Size of runtime connection pool"
	default 16
	range 1 256
	depends on FLOW_RUNTIME_OBSERVERS
	help
	  Number of runtime connections that can be allocated from the
	  internal pool. Each connection uses approximately 32 bytes.
	  Set this based on the maximum number of runtime connections
	  your application needs simultaneously.


config FLOW_INIT_PRIORITY
	int "Flow subsystem initialization priority"
	default 99
	range 0 99
	help
	  Initialization priority for the Flow subsystem.
	  Should be high (late) to ensure sources and sinks are defined.

module = FLOW
module-str = flow
source "subsys/logging/Kconfig.template.log_config"

endif # FLOW
```

## flow/subsys/flow_router/Kconfig
```kconfig
# SPDX-License-Identifier: Apache-2.0

config FLOW_ROUTER
	bool "Flow router framework"
	depends on FLOW
	help
	  Enable the Flow router framework for protocol-agnostic
	  packet routing with header addition/removal.

	  This framework provides a reusable routing engine that can
	  be used to implement any protocol requiring bidirectional
	  packet transformation and routing based on packet IDs.

if FLOW_ROUTER

config FLOW_ROUTER_LOG_LEVEL
	int "Flow router log level"
	depends on LOG
	default 2
	range 0 4
	help
	  Set the logging level for the Flow router subsystem.
	  0 = OFF
	  1 = ERROR
	  2 = WARNING
	  3 = INFO
	  4 = DEBUG

endif # FLOW_ROUTER
```

## flow/tests/subsys/flow/runtime_test/testcase.yaml
```yaml
tests:
  flow.runtime:
    harness: ztest
    tags: flow
    platform_allow: native_sim
```

## flow/tests/subsys/flow/unit_test/testcase.yaml
```yaml
tests:
  flow.unit_test:
    tags: flow unit_test
    integration_platforms:
      - native_sim
      - qemu_cortex_m3
    harness: ztest
  flow.unit_test.no_stats:
    tags: flow unit_test no_stats
    integration_platforms:
      - native_sim
      - qemu_cortex_m3
    harness: ztest
    extra_configs:
      - CONFIG_FLOW_STATS=n
  flow.unit_test.hires_timestamp:
    tags: flow unit_test hires_timestamp
    integration_platforms:
      - native_sim
      - qemu_cortex_m3
    harness: ztest
    extra_configs:
      - CONFIG_FLOW_BUF_TIMESTAMP_HIRES=y
```

## libs/weave/Kconfig
```kconfig
# Copyright (c) 2026 Zephyr Project
# SPDX-License-Identifier: Apache-2.0

menuconfig WEAVE
	bool "Weave message passing framework"
	help
	  Enable the Weave message passing framework.
	  Provides sources and sinks for generic message distribution.
	  Includes Packet (net_buf routing) and Method (RPC) subsystems.

if WEAVE

config WEAVE_INIT_PRIORITY
	int "Initialization priority"
	default 99
	range 0 99
	help
	  SYS_INIT priority for wiring static connections.
	  Must run after kernel but before application init.

module = WEAVE
module-str = weave
source "subsys/logging/Kconfig.template.log_config"

# ========================== Packet Subsystem ==========================

config WEAVE_PACKET
	bool "Weave Packet routing (net_buf on Weave)"
	select NET_BUF
	help
	  Enable the Weave Packet routing subsystem.
	  Provides zero-copy distribution of net_buf packets
	  using reference counting, built on Weave core.

config WEAVE_PACKET_TIMESTAMP_HIRES
	bool "Use high-resolution timestamps (64-bit cycles)"
	depends on WEAVE_PACKET
	help
	  Use k_cycle_get_64() for packet timestamps instead of
	  k_uptime_ticks(). Provides higher resolution but uses
	  more memory per packet (8 bytes vs 4 bytes).

# ========================== Method Subsystem ==========================

menuconfig WEAVE_METHOD
	bool "Weave Method RPC framework"
	help
	  Enable the Weave Method RPC (Remote Procedure Call) framework.
	  Provides type-safe RPC with zero-allocation call semantics.

# ========================== Observable Subsystem ==========================

config WEAVE_OBSERVABLE
	bool "Weave Observable (stateful pub/sub)"
	help
	  Enable the Weave Observable subsystem.
	  Provides stateful publish/subscribe with zero allocation.
	  Observers can be immediate (sync callback) or async (via queue).

endif # WEAVE
```

## libs/weave/samples/observable/sample.yaml
```yaml
sample:
  name: Weave Observable Settings Sample
  description: Demonstrates Weave Observable for settings with shell commands
common:
  tags:
    - weave
    - observable
  harness: pytest
  harness_config:
    pytest_root:
      - pytest
tests:
  sample.weave.observable:
    platform_allow:
      - native_sim
    integration_platforms:
      - native_sim
    extra_configs:
      - arch:posix:CONFIG_NATIVE_UART_0_ON_STDINOUT=y
```

## libs/weave/samples/packet_routing/Kconfig
```kconfig
# Packet Routing Sample Configuration

config PACKET_ROUTING_AUTO_START_SAMPLING
	bool "Automatically start sampling on boot"
	default y
	help
	  When enabled, the packet routing sample will automatically start
	  generating sensor data packets on boot. When disabled,
	  sampling must be started manually via TCP command.

source "Kconfig.zephyr"
```

## libs/weave/samples/packet_routing/testcase.yaml
```yaml
tests:
  sample.weave.packet_routing:
    harness: pytest
    platform_allow: native_sim
    integration_platforms:
      - native_sim
    tags:
      - weave
      - packet
      - tcp
      - samples
    extra_configs:
      - CONFIG_PACKET_ROUTING_AUTO_START_SAMPLING=n
```

## libs/weave/samples/settings_registers/sample.yaml
```yaml
sample:
  name: Weave Observable Register-Based Settings
  description: Demonstrates register-based settings access using Weave Observable
common:
  tags:
    - weave
    - observable
    - settings
  harness: pytest
  harness_config:
    pytest_root:
      - pytest
tests:
  sample.weave.settings_registers:
    platform_allow:
      - native_sim
    integration_platforms:
      - native_sim
    extra_configs:
      - arch:posix:CONFIG_NATIVE_UART_0_ON_STDINOUT=y
```

## libs/weave/tests/observable/unit_test/testcase.yaml
```yaml
tests:
  weave.observable.unit_test:
    tags: weave observable unit_test
    integration_platforms:
      - native_sim
      - qemu_cortex_m3
    harness: ztest
```

## libs/weave/tests/packet/unit_test/testcase.yaml
```yaml
tests:
  weave.packet.unit_test:
    tags: weave packet unit_test
    integration_platforms:
      - native_sim
      - qemu_cortex_m3
    harness: ztest
```

## packet_io/samples/router_sample/testcase.yaml
```yaml
tests:
  packet_io.samples.router_tcp:
    tags:
      - packet_io
      - samples
      - tcp
      - router
      - pytest
    harness: pytest
    harness_config:
      pytest_root:
        - "pytest/test_router_tcp.py"
    extra_args: OVERLAY_CONFIG="overlay-native.conf"
    platform_allow:
      - native_sim
    integration_platforms:
      - native_sim
    timeout: 60
```

## packet_io/subsys/packet_io/Kconfig
```kconfig
# SPDX-License-Identifier: Apache-2.0

menuconfig PACKET_IO
	bool "Packet I/O support"
	select NET_BUF
	help
	  Enable the packet I/O subsystem. This provides a zero-copy
	  mechanism for distributing net_buf packets from sources to
	  multiple sinks using reference counting.

if PACKET_IO

config PACKET_IO_STATS
	bool "Enable packet I/O statistics"
	default y if DEBUG
	help
	  Enable statistics tracking for packet sources and sinks.
	  This includes message counts, drop counts, and delivery counts.

config PACKET_IO_LOG_LEVEL
	int "Packet I/O log level"
	depends on LOG
	default 3
	range 0 4
	help
	  Set the log level for packet I/O subsystem
	  0 - OFF
	  1 - ERROR  
	  2 - WARNING
	  3 - INFO
	  4 - DEBUG

config PACKET_IO_RUNTIME_OBSERVERS
	bool "Runtime observer registration"
	help
	  Enable runtime registration and deregistration of observers.
	  If disabled, all connections must be defined at compile time.

config PACKET_IO_ASSERT_ON_ERROR
	bool "Assert on packet I/O errors"
	default y if DEBUG
	help
	  Assert when packet I/O encounters an error condition such as
	  invalid parameters or corrupted state.

config PACKET_IO_PRIORITY
	int "Packet I/O initialization priority"
	default 99
	range 0 99
	help
	  Initialization priority for the packet I/O subsystem.
	  Should be high (late) to ensure sources and sinks are defined.

module = PACKET_IO
module-str = packet_io
source "subsys/logging/Kconfig.template.log_config"

endif # PACKET_IO
```

## packet_io/tests/subsys/packet_io/runtime_test/testcase.yaml
```yaml
tests:
  packet_io.runtime:
    harness: ztest
    tags: packet_io
    platform_allow: native_sim
```

## packet_io/tests/subsys/packet_io/unit_test/testcase.yaml
```yaml
tests:
  packet_io.unit_test:
    tags: packet_io unit_test
    integration_platforms:
      - native_sim
      - qemu_cortex_m3
    harness: ztest
  packet_io.unit_test.no_stats:
    tags: packet_io unit_test no_stats
    integration_platforms:
      - native_sim
      - qemu_cortex_m3
    harness: ztest
    extra_configs:
      - CONFIG_PACKET_IO_STATS=n
```

## register_mapper/subsys/register_mapper/Kconfig
```kconfig
# Copyright (c) 2024 Zephyr Project
# SPDX-License-Identifier: Apache-2.0

menuconfig REGISTER_MAPPER
	bool "Enable distributed register mapper"
	select ZBUS
	help
	  Enable the distributed register mapper subsystem that bridges
	  external register-based interfaces to internal ZBUS channels.

if REGISTER_MAPPER

config REGISTER_MAPPER_INIT_PRIORITY
	int "Initialization priority"
	default 90
	help
	  System initialization priority for the register mapper.
	  Should run after ZBUS initialization (70) but before
	  application code.

config REGISTER_MAPPER_BLOCK_WRITE
	bool "Enable block write transactions"
	default y
	help
	  Enable atomic block write operations for updating multiple
	  registers as a single transaction with deferred notifications.

config REGISTER_MAPPER_VALIDATION
	bool "Enable register overlap validation"
	default y if DEBUG
	help
	  Validate that no register addresses overlap at initialization.
	  Useful for catching configuration errors.

config REGISTER_MAPPER_MAX_REGISTERS
	int "Maximum number of registers"
	default 128
	help
	  Maximum number of register mappings supported.
	  Used for static allocation in validation functions.

config REGISTER_MAPPER_NAMES
	bool "Enable register names"
	default n
	help
	  Enable human-readable names for registers.
	  When enabled, each register can have an optional name string
	  that will be displayed in debug output and listings.
	  Increases ROM usage by storing name strings.

module = REGISTER_MAPPER
module-str = register_mapper
source "subsys/logging/Kconfig.template.log_config"

endif # REGISTER_MAPPER
```

## register_mapper/tests/subsys/register_mapper/unit_test/testcase.yaml
```yaml
# Copyright (c) 2024 Zephyr Project
# SPDX-License-Identifier: Apache-2.0

common:
  tags:
    - register_mapper
    - unit_test
  platform_allow:
    - native_sim
    - native_posix
  integration_platforms:
    - native_sim

tests:
  register_mapper.unit_test:
    harness: ztest
    timeout: 60
```

## samples/memslab_core/testcase.yaml
```yaml
tests:
  sample.weave.memslab_core:
    harness: console
    harness_config:
      type: multi_line
      ordered: true
      regex:
        - ".*Pool: 2 blocks of 12 bytes.*"
        - ".*Received: seq=0.*"
        - ".*Received: seq=4.*"
        - ".*Sample completed successfully.*"
    platform_allow: native_sim
    integration_platforms:
      - native_sim
    tags:
      - weave
      - memslab
      - samples
```

## swift_io/Kconfig
```kconfig
# SPDX-License-Identifier: Apache-2.0

rsource "subsys/swift_io/Kconfig"
rsource "subsys/swift_router/Kconfig"
```

## swift_io/samples/router_sample/testcase.yaml
```yaml
tests:
  swift_io.samples.router_tcp:
    tags:
      - swift_io
      - samples
      - tcp
      - router
      - pytest
    harness: pytest
    harness_config:
      pytest_root:
        - "tests/test_router_tcp.py"
    # No overlay needed - board configs are automatically selected
    platform_allow:
      - native_sim
    integration_platforms:
      - native_sim
    timeout: 60
```

## swift_io/subsys/swift_io/Kconfig
```kconfig
# SPDX-License-Identifier: Apache-2.0

menuconfig SWIFT_IO
	bool "SwiftIO - Source-sink Wired Interface for Fast Threaded I/O"
	select NET_BUF
	help
	  Enable the SwiftIO subsystem. This provides a zero-copy
	  mechanism for distributing net_buf packets from sources to
	  multiple sinks using reference counting.

if SWIFT_IO

config SWIFT_IO_NAMES
	bool "Enable names for sources and sinks"
	default y if DEBUG
	help
	  Enable string names for packet sources, sinks, and event processors.
	  This adds a const char* field to each structure for debugging and
	  logging purposes. Disable to save memory in production builds.

config SWIFT_IO_STATS
	bool "Enable SwiftIO statistics"
	default y if DEBUG
	help
	  Enable statistics tracking for packet sources and sinks.
	  This includes message counts, drop counts, and delivery counts.

config SWIFT_IO_LOG_LEVEL
	int "SwiftIO log level"
	depends on LOG
	default 3
	range 0 4
	help
	  Set the log level for SwiftIO subsystem
	  0 - OFF
	  1 - ERROR  
	  2 - WARNING
	  3 - INFO
	  4 - DEBUG

config SWIFT_IO_RUNTIME_OBSERVERS
	bool "Runtime observer registration"
	help
	  Enable runtime registration and deregistration of observers.
	  If disabled, all connections must be defined at compile time.

config SWIFT_IO_RUNTIME_STACK_CHECK
	bool "Check for stack-allocated runtime connections"
	default y if DEBUG
	depends on SWIFT_IO_RUNTIME_OBSERVERS && THREAD_STACK_INFO
	help
	  Enable detection of stack-allocated connection structures when
	  adding runtime connections. This helps catch a common error where
	  connections are mistakenly allocated on the stack instead of
	  statically or dynamically. Automatically enabled in debug builds.

config SWIFT_IO_ASSERT_ON_ERROR
	bool "Assert on SwiftIO errors"
	default y if DEBUG
	help
	  Assert when SwiftIO encounters an error condition such as
	  invalid parameters or corrupted state.

config SWIFT_IO_PRIORITY
	int "SwiftIO initialization priority"
	default 99
	range 0 99
	help
	  Initialization priority for the SwiftIO subsystem.
	  Should be high (late) to ensure sources and sinks are defined.

module = SWIFT_IO
module-str = swift_io
source "subsys/logging/Kconfig.template.log_config"

endif # SWIFT_IO
```
