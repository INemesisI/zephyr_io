## CMakeLists.txt
```
# Copyright (c) 2024 Zephyr IO Project
# SPDX-License-Identifier: Apache-2.0

cmake_minimum_required(VERSION 3.20.0)

find_package(Zephyr REQUIRED HINTS $ENV{ZEPHYR_BASE})
project(weave_sensor_monitor)

target_sources(app PRIVATE
    src/main.c
    src/sensor_module.c
    src/monitor_module.c
)
```

## sample.yaml
```
sample:
  description: Weave framework sensor monitoring sample
  name: weave_sensor_monitor

common:
  tags:
    - weave
    - threads
    - messaging
  harness: console
  harness_config:
    type: multi_line
    ordered: true
    regex:
      - "Weave Thread Integration Sample"
      - "Using clean API with direct method connections"
      - "Test 1: Configure sensor with low threshold"
      - "Config changed: old threshold=[0-9]+, new=[0-9]+"
      - "Test 2: Manual sensor reads"
      - "Manual read ch[0-9]+: value=[0-9]+"
      - "Test 3: Increase threshold"
      - "Threshold increased to [0-9]+"
      - "Test 4: Get statistics"
      - "Sensor Statistics:"
      - "Total reads:.*[0-9]+"

tests:
  weave.samples.sensor_monitor:
    platform_allow: native_sim
    integration_platforms:
      - native_sim
    tags:
      - weave
      - sample
```

## prj.conf
```kconfig
# Enable Weave framework
CONFIG_WEAVE=y
CONFIG_WEAVE_LOG_LEVEL_INF=y

# Required kernel features
CONFIG_POLL=y
CONFIG_HEAP_MEM_POOL_SIZE=4096

# Logging
CONFIG_LOG=y
CONFIG_LOG_DEFAULT_LEVEL=3

# Assertions for development
CONFIG_ASSERT=y

# Thread names for debugging
CONFIG_THREAD_NAME=y
```

## src/main.c
```c
/*
 * Copyright (c) 2024 Zephyr IO Project
 *
 * SPDX-License-Identifier: Apache-2.0
 *
 * This sample demonstrates Weave's non-invasive integration with existing threads.
 * Modules are defined in separate files, and connections are wired here at compile time.
 */

#include <zephyr/kernel.h>
#include <zephyr/logging/log.h>
#include <zephyr_io/weave/weave.h>
#include "sensor_module.h"
#include "monitor_module.h"

LOG_MODULE_REGISTER(app, LOG_LEVEL_INF);

/* ========================================================================
 * Method Ports - Define client-side endpoints for calling methods
 * ======================================================================== */

/* Define method call ports for calling sensor methods */
WEAVE_METHOD_PORT_DEFINE(monitor_call_read_sensor, struct read_sensor_request,
			 struct read_sensor_reply);

WEAVE_METHOD_PORT_DEFINE(monitor_call_set_config, struct set_config_request,
			 struct set_config_reply);

WEAVE_METHOD_PORT_DEFINE(monitor_call_get_stats, struct get_stats_request, struct get_stats_reply);

/* ========================================================================
 * Wiring - Connect modules at compile time
 * Direct method-to-method connections with module-prefixed names
 * ======================================================================== */

/* Connect monitor's method call ports to sensor's methods */
WEAVE_METHOD_CONNECT(monitor_call_read_sensor, sensor_read_sensor);
WEAVE_METHOD_CONNECT(monitor_call_set_config, sensor_set_config);
WEAVE_METHOD_CONNECT(monitor_call_get_stats, sensor_get_stats);

/* Connect sensor's threshold signal to monitor's handler */
WEAVE_SIGNAL_CONNECT(threshold_exceeded, monitor_on_threshold_exceeded);

/* ========================================================================
 * Application Main
 * ======================================================================== */

int main(void)
{
	int ret;

	LOG_INF("==============================================");
	LOG_INF("Weave Thread Integration Sample");
	LOG_INF("==============================================");
	LOG_INF("Using clean API with direct method connections");

	/* Give sensor thread time to initialize */
	k_sleep(K_MSEC(100));

	LOG_INF("\nTest 1: Configure sensor with low threshold");
	LOG_INF("----------------------------------------------");

	struct set_config_request new_config = {
		.sample_rate_ms = 500,
		.threshold = 70,
		.auto_sample = true,
	};
	struct set_config_reply old_config;

	ret = weave_call_method(&monitor_call_set_config, &new_config, sizeof(new_config),
				&old_config, sizeof(old_config), K_SECONDS(1));
	if (ret == 0) {
		LOG_INF("Config changed: old threshold=%d, new=%d", old_config.threshold,
			new_config.threshold);
	} else {
		LOG_ERR("Failed to set config: %d", ret);
	}

	/* Let auto-sampling run for a bit */
	k_sleep(K_SECONDS(3));

	LOG_INF("\nTest 2: Manual sensor reads");
	LOG_INF("----------------------------");

	for (int i = 0; i < 5; i++) {
		struct read_sensor_request req = {.channel = i};
		struct read_sensor_reply rep;

		ret = weave_call_method(&monitor_call_read_sensor, &req, sizeof(req), &rep,
					sizeof(rep), K_SECONDS(1));
		if (ret == 0) {
			LOG_INF("Manual read ch%d: value=%d", req.channel, rep.value);
		}

		k_sleep(K_SECONDS(1));
	}

	LOG_INF("\nTest 3: Increase threshold");
	LOG_INF("---------------------------");

	new_config.threshold = 150;
	new_config.sample_rate_ms = 1000;

	ret = weave_call_method(&monitor_call_set_config, &new_config, sizeof(new_config), NULL,
				0, /* No reply needed */
				K_SECONDS(1));
	if (ret == 0) {
		LOG_INF("Threshold increased to %d", new_config.threshold);
	}

	/* Let it run */
	k_sleep(K_SECONDS(3));

	LOG_INF("\nTest 4: Get statistics");
	LOG_INF("-----------------------");

	struct get_stats_request stats_req = {};
	struct get_stats_reply stats;

	ret = weave_call_method(&monitor_call_get_stats, &stats_req, sizeof(stats_req), &stats,
				sizeof(stats), K_SECONDS(1));
	if (ret == 0) {
		LOG_INF("Sensor Statistics:");
		LOG_INF("  Total reads:      %u", stats.total_reads);
		LOG_INF("  Threshold events: %u", stats.threshold_events);
		LOG_INF("  Value range:      %d to %d", stats.min_value, stats.max_value);
	}

	struct monitor_stats *mon_stats = monitor_get_statistics();
	LOG_INF("\nMonitor Statistics:");
	LOG_INF("  Alerts received: %u", mon_stats->alerts_received);
	if (mon_stats->alerts_received > 0) {
		LOG_INF("  Last alert value: %d", mon_stats->last_alert_value);
	}

	LOG_INF("\n==============================================");
	LOG_INF("Sample Complete!");
	LOG_INF("==============================================");

	LOG_INF("\nKey Observations:");
	LOG_INF("- Direct method-to-method connections (no IDs needed)");
	LOG_INF("- Type-safe connections with request/reply structures");
	LOG_INF("- Clean naming conventions (call_*, on_*, *_request, *_reply)");
	LOG_INF("- Modules cleanly separated into individual files");
	LOG_INF("- Connections wired at compile time in main.c");
	LOG_INF("- Thread boundaries properly respected");

	return 0;
}
```

## src/monitor_module.c
```c
/*
 * Copyright (c) 2024 Zephyr IO Project
 *
 * SPDX-License-Identifier: Apache-2.0
 */

#include <zephyr/kernel.h>
#include <zephyr/logging/log.h>
#include "monitor_module.h"

LOG_MODULE_REGISTER(monitor, LOG_LEVEL_INF);

/* Monitor context */
static struct monitor_stats monitor_ctx;

/* Signal handler implementation */
static void handle_threshold_exceeded(void *user_data, const struct threshold_exceeded_event *event)
{
	struct monitor_stats *ctx = &monitor_ctx;

	ctx->alerts_received++;
	ctx->last_alert_value = event->value;

	LOG_WRN("ALERT: Threshold exceeded! value=%d > %d (alert #%u)", event->value,
		event->threshold, ctx->alerts_received);
}

/* Define signal handler with immediate execution (no queue) */
WEAVE_SIGNAL_HANDLER_DEFINE_IMMEDIATE(monitor_on_threshold_exceeded, handle_threshold_exceeded,
				      struct threshold_exceeded_event);

/* Get monitor statistics */
struct monitor_stats *monitor_get_statistics(void)
{
	return &monitor_ctx;
}
```

## src/monitor_module.h
```c
/*
 * Copyright (c) 2024 Zephyr IO Project
 *
 * SPDX-License-Identifier: Apache-2.0
 */

#ifndef MONITOR_MODULE_H_
#define MONITOR_MODULE_H_

#include <zephyr/kernel.h>
#include <zephyr_io/weave/weave.h>
#include "sensor_module.h"

/* Monitor statistics */
struct monitor_stats {
	uint32_t alerts_received;
	int32_t last_alert_value;
};

/* Signal handler */
extern struct weave_signal_handler monitor_on_threshold_exceeded;

/* Get monitor statistics */
struct monitor_stats *monitor_get_statistics(void);

#endif /* MONITOR_MODULE_H_ */
```

## src/sensor_module.c
```c
/*
 * Copyright (c) 2024 Zephyr IO Project
 *
 * SPDX-License-Identifier: Apache-2.0
 */

#include <zephyr/kernel.h>
#include <zephyr/logging/log.h>
#include <errno.h>
#include "sensor_module.h"

LOG_MODULE_REGISTER(sensor, LOG_LEVEL_INF);

/* Sensor context */
struct sensor_context {
	/* Module's own functionality */
	struct set_config_request config;
	struct get_stats_reply stats;
	struct k_timer sample_timer;
	struct k_sem data_ready;
	int32_t last_value;
};

/* Static sensor context */
static struct sensor_context sensor_ctx = {
	.config =
		{
			.sample_rate_ms = 1000,
			.threshold = 100,
			.auto_sample = true,
		},
	.stats =
		{
			.min_value = INT32_MAX,
			.max_value = INT32_MIN,
		},
};

/* Define message queue for sensor (10 messages max) */
WEAVE_MSGQ_DEFINE(sensor_msgq, 10);

/* Thread automatically started at boot */
K_THREAD_DEFINE(sensor_thread_id, 2048, sensor_thread, NULL, NULL, NULL, 5, 0, 0);

/* Define signal for threshold events */
WEAVE_SIGNAL_DEFINE(threshold_exceeded, struct threshold_exceeded_event);

/* Sensor timer callback - runs in ISR context */
static void sensor_timer_expired(struct k_timer *timer)
{
	/* Signal main thread that it's time to sample */
	k_sem_give(&sensor_ctx.data_ready);
}

/* Method implementations */

static int read_sensor_handler(void *user_data, const struct read_sensor_request *request,
			       struct read_sensor_reply *reply)
{
	struct sensor_context *ctx = &sensor_ctx;

	/* Request is required for channel information */
	if (!request) {
		LOG_ERR("read_sensor: request is required");
		return -EINVAL;
	}

	/* Simulate sensor reading */
	int32_t value = (k_uptime_get_32() / 100) % 200;

	/* Only fill reply if provided */
	if (reply) {
		reply->value = value;
		reply->timestamp = k_uptime_get_32();
	}

	/* Update statistics */
	ctx->stats.total_reads++;
	if (value < ctx->stats.min_value) {
		ctx->stats.min_value = value;
	}
	if (value > ctx->stats.max_value) {
		ctx->stats.max_value = value;
	}

	ctx->last_value = value;

	LOG_INF("Sensor read ch%u: value=%d", request->channel, value);

	/* Check threshold */
	if (value > ctx->config.threshold) {
		struct threshold_exceeded_event evt = {
			.value = value,
			.threshold = ctx->config.threshold,
			.timestamp = reply ? reply->timestamp : k_uptime_get_32(),
		};

		ctx->stats.threshold_events++;
		LOG_INF("THRESHOLD EXCEEDED! value=%d > %d", value, ctx->config.threshold);

		/* Emit signal */
		weave_emit_signal(&threshold_exceeded, &evt);
	}

	return 0;
}

static int set_config_handler(void *user_data, const struct set_config_request *request,
			      struct set_config_reply *reply)
{
	struct sensor_context *ctx = &sensor_ctx;

	/* Request is required - we need the new configuration */
	if (!request) {
		LOG_ERR("set_config: request is required");
		return -EINVAL;
	}

	/* Return old config */
	if (reply) {
		reply->sample_rate_ms = ctx->config.sample_rate_ms;
		reply->threshold = ctx->config.threshold;
		reply->auto_sample = ctx->config.auto_sample;
	}

	/* Apply new config */
	ctx->config = *request;

	/* Update timer if sample rate changed */
	if (ctx->config.auto_sample) {
		k_timer_start(&ctx->sample_timer, K_MSEC(ctx->config.sample_rate_ms),
			      K_MSEC(ctx->config.sample_rate_ms));
		LOG_INF("Auto-sampling enabled at %u ms", ctx->config.sample_rate_ms);
	} else {
		k_timer_stop(&ctx->sample_timer);
		LOG_INF("Auto-sampling disabled");
	}

	LOG_INF("Config updated: threshold=%d", ctx->config.threshold);

	return 0;
}

static int get_stats_handler(void *user_data, const struct get_stats_request *request,
			     struct get_stats_reply *reply)
{
	struct sensor_context *ctx = &sensor_ctx;

	/* Reply is typically expected for stats, but we'll allow NULL
	 * in case someone just wants to trigger a log */
	if (reply) {
		*reply = ctx->stats;
		LOG_INF("Stats: reads=%u, threshold_events=%u", reply->total_reads,
			reply->threshold_events);
	}

	return 0;
}

/* Define methods with queued execution (using sensor_msgq) */
WEAVE_METHOD_DEFINE_QUEUED(sensor_read_sensor, read_sensor_handler, &sensor_msgq,
			   struct read_sensor_request, struct read_sensor_reply);

WEAVE_METHOD_DEFINE_QUEUED(sensor_set_config, set_config_handler, &sensor_msgq,
			   struct set_config_request, struct set_config_reply);

WEAVE_METHOD_DEFINE_QUEUED(sensor_get_stats, get_stats_handler, &sensor_msgq,
			   struct get_stats_request, struct get_stats_reply);

/* Sensor thread - handles multiple event sources */
void sensor_thread(void *p1, void *p2, void *p3)
{
	struct sensor_context *ctx = &sensor_ctx;

	ARG_UNUSED(p1);
	ARG_UNUSED(p2);
	ARG_UNUSED(p3);

	LOG_INF("Sensor thread started");

	/* Initialize timer */
	k_timer_init(&ctx->sample_timer, sensor_timer_expired, NULL);
	k_sem_init(&ctx->data_ready, 0, 1);

	/* Start auto-sampling if enabled */
	if (ctx->config.auto_sample) {
		k_timer_start(&ctx->sample_timer, K_MSEC(ctx->config.sample_rate_ms),
			      K_MSEC(ctx->config.sample_rate_ms));
	}

	/* Process messages and timer events */
	while (1) {
		/* Poll multiple event sources */
		struct k_poll_event events[] = {
			K_POLL_EVENT_INITIALIZER(K_POLL_TYPE_SEM_AVAILABLE, K_POLL_MODE_NOTIFY_ONLY,
						 &ctx->data_ready),
			K_POLL_EVENT_INITIALIZER(K_POLL_TYPE_MSGQ_DATA_AVAILABLE,
						 K_POLL_MODE_NOTIFY_ONLY, &sensor_msgq),
		};

		k_poll(events, ARRAY_SIZE(events), K_FOREVER);

		/* Check for timer expiry (auto-sample) */
		if (events[0].state == K_POLL_STATE_SEM_AVAILABLE) {
			k_sem_take(&ctx->data_ready, K_NO_WAIT);

			/* Auto-sample reading */
			struct read_sensor_request req = {.channel = 0};
			struct read_sensor_reply reply;

			LOG_INF("Auto-sample triggered");
			read_sensor_handler(NULL, &req, &reply);
		}

		/* Process method calls */
		if (events[1].state == K_POLL_STATE_MSGQ_DATA_AVAILABLE) {
			/* Process all pending messages */
			weave_process_all_messages(&sensor_msgq);
		}

		/* Clear poll states for next iteration */
		events[0].state = K_POLL_STATE_NOT_READY;
		events[1].state = K_POLL_STATE_NOT_READY;
	}
}
```

## src/sensor_module.h
```c
/*
 * Copyright (c) 2024 Zephyr IO Project
 *
 * SPDX-License-Identifier: Apache-2.0
 */

#ifndef SENSOR_MODULE_H_
#define SENSOR_MODULE_H_

#include <zephyr/kernel.h>
#include <zephyr_io/weave/weave.h>

/* Data structures following naming conventions */
struct read_sensor_request {
	uint32_t channel;
};

struct read_sensor_reply {
	int32_t value;
	uint32_t timestamp;
};

struct set_config_request {
	uint32_t sample_rate_ms;
	int32_t threshold;
	bool auto_sample;
};

struct set_config_reply {
	/* Returns old config */
	uint32_t sample_rate_ms;
	int32_t threshold;
	bool auto_sample;
};

struct get_stats_request {
	/* Empty request */
};

struct get_stats_reply {
	uint32_t total_reads;
	uint32_t threshold_events;
	uint32_t errors;
	int32_t min_value;
	int32_t max_value;
};

/* Signal event */
struct threshold_exceeded_event {
	int32_t value;
	int32_t threshold;
	uint32_t timestamp;
};

/* Methods provided by sensor module */
extern struct weave_method sensor_read_sensor;
extern struct weave_method sensor_set_config;
extern struct weave_method sensor_get_stats;

/* Signals emitted by sensor module */
extern struct weave_signal threshold_exceeded;

/* Thread entry point */
void sensor_thread(void *p1, void *p2, void *p3);

#endif /* SENSOR_MODULE_H_ */
```
