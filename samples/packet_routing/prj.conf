## CMakeLists.txt
```
# SPDX-License-Identifier: Apache-2.0

cmake_minimum_required(VERSION 3.20.0)
find_package(Zephyr REQUIRED HINTS $ENV{ZEPHYR_BASE})
project(packet_routing_sample)

target_sources(app PRIVATE
    src/main.c
    src/sensors.c
    src/protocol.c
    src/tcp_server.c
    src/cmd_handler.c
)
```

## prj.conf
```kconfig
# Packet Routing Sample with TCP Server Configuration

# Enable Weave subsystems
CONFIG_WEAVE=y
CONFIG_WEAVE_PACKET=y
CONFIG_WEAVE_PACKET_TIMESTAMP_HIRES=y

# Enable networking buffer support
CONFIG_NET_BUF=y

# Enable networking
CONFIG_NETWORKING=y
CONFIG_NET_TCP=y
CONFIG_NET_SOCKETS=y
CONFIG_NET_SOCKETS_POSIX_NAMES=y

# Network stack configuration
CONFIG_NET_IPV4=y
CONFIG_NET_IPV6=n
CONFIG_NET_DHCPV4=n

# Native networking for native_sim
CONFIG_NET_DRIVERS=y
CONFIG_NET_LOOPBACK=y

# Use host sockets for native_sim (allows connections from host)
CONFIG_NET_SOCKETS_OFFLOAD=y
CONFIG_NET_NATIVE_OFFLOADED_SOCKETS=y
CONFIG_HEAP_MEM_POOL_SIZE=8192

# Network buffers
CONFIG_NET_PKT_RX_COUNT=16
CONFIG_NET_PKT_TX_COUNT=16
CONFIG_NET_BUF_RX_COUNT=16
CONFIG_NET_BUF_TX_COUNT=16

# Enable logging
CONFIG_LOG=y
CONFIG_LOG_DEFAULT_LEVEL=3
CONFIG_NET_LOG=y

# Enable assertions to catch bugs
CONFIG_ASSERT=y
CONFIG_ASSERT_LEVEL=2

# Enable poll support for efficient multi-sink handling
CONFIG_POLL=y

# Thread configuration
CONFIG_MAIN_STACK_SIZE=2048
CONFIG_NET_TX_STACK_SIZE=2048
CONFIG_NET_RX_STACK_SIZE=2048
```

## src/cmd_handler.c
```c
/*
 * Packet Routing Sample - Command Handler Implementation
 *
 * Processes control commands from TCP server (start/stop sampling)
 */

#include <zephyr/kernel.h>
#include <zephyr/logging/log.h>
#include <zephyr/net/buf.h>
#include <weave/packet.h>

#include "cmd_handler.h"
#include "sensors.h"

LOG_MODULE_REGISTER(cmd_handler, LOG_LEVEL_INF);

/* Forward declaration of handler function */
static void cmd_handler_fn(struct net_buf *buf, void *user_data);

/* Define command sink with immediate execution */
WEAVE_PACKET_SINK_DEFINE(cmd_sink, cmd_handler_fn, WV_IMMEDIATE, WV_NO_FILTER, NULL);

/* Command statistics */
static uint32_t commands_processed;
static uint32_t start_commands;
static uint32_t stop_commands;
static uint32_t unknown_commands;

/* Command handler */
static void cmd_handler_fn(struct net_buf *buf, void *user_data)
{
	ARG_UNUSED(user_data);

	if (buf->len < 1) {
		LOG_WRN("Empty command received");
		return;
	}

	uint8_t cmd = buf->data[0];
	commands_processed++;

	switch (cmd) {
	case CMD_START_SAMPLING:
		start_commands++;
		LOG_INF("Command: START sampling (total: %u start, %u stop)", start_commands,
			stop_commands);
		sensor_start_sampling();
		break;

	case CMD_STOP_SAMPLING:
		stop_commands++;
		LOG_INF("Command: STOP sampling (total: %u start, %u stop)", start_commands,
			stop_commands);
		sensor_stop_sampling();
		break;

	default:
		unknown_commands++;
		LOG_WRN("Unknown command: 0x%02x (total unknown: %u)", cmd, unknown_commands);
		break;
	}
}

/* No thread needed for immediate handler - executes in source context */
```

## src/sensors.c
```c
/*
 * Packet Routing Sample - Sensor Module Implementation
 *
 * Self-contained sensor simulation with own buffer pool and thread
 */

#include <zephyr/kernel.h>
#include <zephyr/logging/log.h>
#include <zephyr/net/buf.h>
#include <weave/packet.h>

#include "sensors.h"

LOG_MODULE_REGISTER(sensors, LOG_LEVEL_INF);

/* Buffer pool for sensor packets */
WEAVE_PACKET_POOL_DEFINE(sensor_pool, 8, 512, NULL);

/* Define packet sources */
WEAVE_PACKET_SOURCE_DEFINE(sensor1_source);
WEAVE_PACKET_SOURCE_DEFINE(sensor2_source);

/* Sensor data patterns - simulating larger sensor payloads */
static uint8_t sensor1_data[256]; /* 256 byte payload */
static uint8_t sensor2_data[384]; /* 384 byte payload */

/* Sampling control - using semaphore for thread-safe start/stop */
K_SEM_DEFINE(sampling_sem, 0, 1); /* Start with sampling DISABLED */

static void init_sensor_data(void)
{
	/* Sensor 1: Repeating pattern 0xA1 throughout */
	for (int i = 0; i < sizeof(sensor1_data); i++) {
		sensor1_data[i] = 0xA1;
	}

	/* Sensor 2: Repeating pattern 0xB2 throughout */
	for (int i = 0; i < sizeof(sensor2_data); i++) {
		sensor2_data[i] = 0xB2;
	}
}

static void sensor_thread_fn(void *p1, void *p2, void *p3)
{
	struct net_buf *buf;
	int ret;

	ARG_UNUSED(p1);
	ARG_UNUSED(p2);
	ARG_UNUSED(p3);

	/* Initialize sensor data patterns */
	init_sensor_data();

	LOG_INF("Sensor module started (256B + 384B payloads)");

#ifdef CONFIG_PACKET_ROUTING_AUTO_START_SAMPLING
	/* Automatically start sampling if configured */
	sensor_start_sampling();
	LOG_INF("Sampling started automatically");
#endif

	while (1) {
		/* Check if sampling is enabled (non-blocking) */
		if (k_sem_count_get(&sampling_sem) > 0) {
			/* Sensor 1 packet - 256 bytes */
			buf = weave_packet_alloc_with_id(&sensor_pool, SOURCE_ID_SENSOR1,
							 K_NO_WAIT);
			if (buf) {
				net_buf_add_mem(buf, sensor1_data, sizeof(sensor1_data));
				ret = weave_packet_send(&sensor1_source, buf, K_NO_WAIT);
				LOG_INF("Sensor 1: sent %d bytes to %d sinks",
					(int)sizeof(sensor1_data), ret);
			}

			/* Sensor 2 packet - 384 bytes */
			buf = weave_packet_alloc_with_id(&sensor_pool, SOURCE_ID_SENSOR2,
							 K_NO_WAIT);
			if (buf) {
				net_buf_add_mem(buf, sensor2_data, sizeof(sensor2_data));
				ret = weave_packet_send(&sensor2_source, buf, K_NO_WAIT);
				LOG_INF("Sensor 2: sent %d bytes to %d sinks",
					(int)sizeof(sensor2_data), ret);
			}

			/* Sleep between packet generations */
			k_sleep(K_MSEC(100)); /* Sample every 100ms for faster testing */
		} else {
			/* When sampling is disabled, sleep until enabled */
			k_sleep(K_MSEC(100));
		}
	}
}

/* Control functions */
void sensor_start_sampling(void)
{
	k_sem_give(&sampling_sem);
}

void sensor_stop_sampling(void)
{
	k_sem_reset(&sampling_sem);
}

/* Static thread initialization - starts automatically */
K_THREAD_DEFINE(sensor_thread, 1024, sensor_thread_fn, NULL, NULL, NULL, 7, 0, 0);
```

## src/tcp_server.h
```c
/*
 * Packet Routing Sample - TCP Server Module
 *
 * Generic TCP server that forwards packets bidirectionally
 */

#ifndef TCP_SERVER_H
#define TCP_SERVER_H

#include <weave/packet.h>

/* TCP server port */
#define TCP_SERVER_PORT 4242

/* Declare packet sink for packets to send to TCP client */
WEAVE_PACKET_SINK_DECLARE(tcp_sink);

/* Declare packet source for packets received from TCP client */
WEAVE_PACKET_SOURCE_DECLARE(tcp_rx_source);

#endif /* TCP_SERVER_H */
```
