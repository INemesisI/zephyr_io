## CMakeLists.txt
```
# Copyright (c) 2026 Zephyr Project
# SPDX-License-Identifier: Apache-2.0

cmake_minimum_required(VERSION 3.20.0)
find_package(Zephyr REQUIRED HINTS $ENV{ZEPHYR_BASE})
project(settings_table)

# Linker fragment for setting_area iterable section
zephyr_linker_sources(SECTIONS sections-rom.ld)

target_sources(app PRIVATE
    src/main.c
    src/settings_api.c
    src/motor_settings.c
    src/sensor_settings.c
    src/settings_shell.c
)
```

## sample.yaml
```
sample:
  name: Settings Table API
  description: |
    Demonstrates the Settings Table API - a register-table-like settings system
    with per-field validation, access control, and cross-field validation.
common:
  tags:
    - settings
    - registers
  harness: pytest
  harness_config:
    pytest_root:
      - pytest
tests:
  sample.settings_table:
    platform_allow:
      - native_sim
    integration_platforms:
      - native_sim
    extra_configs:
      - arch:posix:CONFIG_NATIVE_UART_0_ON_STDINOUT=y
```

## prj.conf
```kconfig
# Logging
CONFIG_LOG=y

# Assertions for development
CONFIG_ASSERT=y

# Floating point printing
CONFIG_CBPRINTF_FP_SUPPORT=y

# Weave observable for pub/sub
CONFIG_WEAVE=y
CONFIG_WEAVE_OBSERVABLE=y
CONFIG_POLL=y

# Shell
CONFIG_SHELL=y
CONFIG_SHELL_LOG_BACKEND=n
```

## src/main.c
```c
/*
 * Copyright (c) 2026 Zephyr Project
 * SPDX-License-Identifier: Apache-2.0
 *
 * Settings Table Sample
 *
 * Demonstrates:
 * - Distributed settings areas (motor, sensor) via iterable sections
 * - Complete separation: main.c has no knowledge of module internals
 * - Shell interface for reading/writing settings
 *
 * Shell commands:
 *   settings dump              - Show table structure
 *   settings read <addr> <len> - Read bytes from address
 *   settings write <addr> <b0> [b1] ... - Write bytes to address
 *   settings reg_read <addr>   - Read register value
 *   settings reg_write <addr> <value> - Write register value
 *   settings reset             - Reset all to defaults
 */

#include <zephyr/kernel.h>
#include <zephyr/logging/log.h>
#include "settings_api.h"

LOG_MODULE_REGISTER(main, LOG_LEVEL_INF);

int main(void)
{
	LOG_INF("Settings Table Sample");
	LOG_INF("Areas: %zu, Initialized: %s", settings_area_count(),
		settings_is_initialized() ? "yes" : "no");
	LOG_INF("Use 'settings' shell commands to interact");

	return 0;
}
```

## src/motor_settings.c
```c
/*
 * Copyright (c) 2026 Zephyr Project
 * SPDX-License-Identifier: Apache-2.0
 *
 * Motor settings module - self-contained, no public interface
 */

#include "settings_api.h"
#include <zephyr/sys/util.h>
#include <zephyr/logging/log.h>

LOG_MODULE_REGISTER(motor, LOG_LEVEL_INF);

/* Motor settings base address */
#define MOTOR_BASE_ADDR 0x0100

/* Motor configuration structure (private to this module) */
struct motor_config {
	uint16_t speed;    /* RPM: 0-10000 */
	uint16_t accel;    /* Acceleration: 0-5000 */
	uint8_t direction; /* 0=forward, 1=reverse */
	uint8_t enabled;   /* 0=off, 1=on */
	uint8_t status;    /* Read-only: 0=idle, 1=running, 2=error */
	uint8_t _reserved; /* Padding */
};

/* Cross-register validation: if enabled, speed must be > 0 */
static int motor_validate(struct weave_observable *obs, const void *new_value, void *user_data)
{
	ARG_UNUSED(obs);
	ARG_UNUSED(user_data);
	const struct motor_config *cfg = new_value;

	if (cfg->enabled && cfg->speed == 0) {
		return -EINVAL; /* Cannot enable with zero speed */
	}
	return 0;
}

/* Owner handler - called on each change */
static void motor_on_change(struct weave_observable *obs, void *user_data)
{
	ARG_UNUSED(user_data);
	struct motor_config cfg;
	weave_observable_get_unchecked(obs, &cfg);
	LOG_INF("speed=%u accel=%u dir=%u enabled=%u status=%u", cfg.speed, cfg.accel,
		cfg.direction, cfg.enabled, cfg.status);
}

/* Register definitions - pragma silences _Generic overflow warnings */
#pragma GCC diagnostic push
#pragma GCC diagnostic ignored "-Woverflow"
static const struct setting_reg motor_regs[] = {
	REGISTER(0x00, struct motor_config, speed, 0, 10000, 1000, ST_FLAG_RW),
	REGISTER(0x02, struct motor_config, accel, 0, 5000, 500, ST_FLAG_RW),
	REGISTER(0x04, struct motor_config, direction, 0, 1, 0, ST_FLAG_RW),
	REGISTER(0x05, struct motor_config, enabled, 0, 1, 0, ST_FLAG_RW),
	REGISTER(0x06, struct motor_config, status, 0, 2, 0, ST_FLAG_R),
};
#pragma GCC diagnostic pop

/* Complete area definition - observable auto-generated, auto-registered */
SETTING_REG_AREA_DEFINE(motor, MOTOR_BASE_ADDR, struct motor_config, motor_regs,
			ARRAY_SIZE(motor_regs), motor_on_change, motor_validate);
```

## src/sensor_settings.c
```c
/*
 * Copyright (c) 2026 Zephyr Project
 * SPDX-License-Identifier: Apache-2.0
 *
 * Sensor settings module - self-contained, no public interface
 */

#include "settings_api.h"
#include <errno.h>
#include <zephyr/sys/util.h>
#include <zephyr/logging/log.h>

LOG_MODULE_REGISTER(sensor, LOG_LEVEL_INF);

/* Sensor settings base address */
#define SENSOR_BASE_ADDR 0x0200

/* Sensor configuration structure (private to this module) */
struct sensor_config {
	uint16_t sample_rate; /* Samples per second: 1-1000 */
	int16_t temp_offset;  /* Temperature calibration: -50 to +50 */
	float gain;           /* Amplifier gain: 0.1 to 10.0 */
	uint8_t channel_mask; /* Enabled channels bitmask: 0x01-0xFF */
	uint8_t _reserved[3]; /* Padding to 12 bytes */
};

/* Cross-register validation: channel_mask must have at least one bit set */
static int sensor_validate(struct weave_observable *obs, const void *new_value, void *user_data)
{
	ARG_UNUSED(obs);
	ARG_UNUSED(user_data);
	const struct sensor_config *cfg = new_value;

	if (cfg->channel_mask == 0) {
		return -EINVAL; /* At least one channel must be enabled */
	}
	return 0;
}

/* Owner handler - called on each change */
static void sensor_on_change(struct weave_observable *obs, void *user_data)
{
	ARG_UNUSED(user_data);
	struct sensor_config cfg;
	weave_observable_get_unchecked(obs, &cfg);
	LOG_INF("rate=%u offset=%d gain=%.2f mask=0x%02x", cfg.sample_rate, cfg.temp_offset,
		(double)cfg.gain, cfg.channel_mask);
}

/* Register definitions - pragma silences _Generic overflow warnings */
#pragma GCC diagnostic push
#pragma GCC diagnostic ignored "-Woverflow"
static const struct setting_reg sensor_regs[] = {
	REGISTER(0x00, struct sensor_config, sample_rate, 1, 1000, 100, ST_FLAG_RW),
	REGISTER(0x02, struct sensor_config, temp_offset, -50, 50, 0, ST_FLAG_RW),
	REGISTER(0x04, struct sensor_config, gain, 0.1f, 10.0f, 1.0f, ST_FLAG_RW),
	REGISTER(0x08, struct sensor_config, channel_mask, 1, 0xFF, 0x0F, ST_FLAG_RW),
};
#pragma GCC diagnostic pop

/* Complete area definition - observable auto-generated, auto-registered */
SETTING_REG_AREA_DEFINE(sensor, SENSOR_BASE_ADDR, struct sensor_config, sensor_regs,
			ARRAY_SIZE(sensor_regs), sensor_on_change, sensor_validate);
```

## src/settings_api.c
```c
/*
 * Copyright (c) 2026 Zephyr Project
 * SPDX-License-Identifier: Apache-2.0
 */

#include "settings_api.h"
#include <string.h>
#include <errno.h>
#include <zephyr/init.h>
#include <zephyr/logging/log.h>

LOG_MODULE_REGISTER(table, LOG_LEVEL_INF);

/* Internal iteration macro */
#define SETTINGS_AREA_FOREACH(area) STRUCT_SECTION_FOREACH(setting_area, area)

/*============================================================================
 * State
 *============================================================================*/

static bool settings_initialized;

/*============================================================================
 * Type Helpers
 *============================================================================*/

static const size_t type_sizes[ST_TYPE_COUNT] = {
	[ST_U8] = 1,  [ST_U16] = 2, [ST_U32] = 4, [ST_U64] = 8, [ST_I8] = 1,   [ST_I16] = 2,
	[ST_I32] = 4, [ST_I64] = 8, [ST_F32] = 4, [ST_F64] = 8, [ST_BOOL] = 1,
};

static const char *type_names[ST_TYPE_COUNT] = {
	[ST_U8] = "u8",   [ST_U16] = "u16", [ST_U32] = "u32",   [ST_U64] = "u64",
	[ST_I8] = "i8",   [ST_I16] = "i16", [ST_I32] = "i32",   [ST_I64] = "i64",
	[ST_F32] = "f32", [ST_F64] = "f64", [ST_BOOL] = "bool",
};

size_t register_type_size(enum register_type type)
{
	if (type >= ST_TYPE_COUNT) {
		return 0;
	}
	return type_sizes[type];
}

const char *register_type_name(enum register_type type)
{
	if (type >= ST_TYPE_COUNT) {
		return "?";
	}
	return type_names[type];
}

static const char *flags_str(uint8_t flags)
{
	uint8_t rw = flags & ST_FLAG_RW;
	if (rw == ST_FLAG_RW) {
		return "RW";
	}
	if (rw == ST_FLAG_R) {
		return "R";
	}
	if (rw == ST_FLAG_W) {
		return "W";
	}
	return "-";
}

/*============================================================================
 * Value Comparison Helpers
 *============================================================================*/

static bool value_less_than(enum register_type type, union setting_value a, union setting_value b)
{
	switch (type) {
	case ST_U8:
		return a.u8 < b.u8;
	case ST_U16:
		return a.u16 < b.u16;
	case ST_U32:
		return a.u32 < b.u32;
	case ST_U64:
		return a.u64 < b.u64;
	case ST_I8:
		return a.i8 < b.i8;
	case ST_I16:
		return a.i16 < b.i16;
	case ST_I32:
		return a.i32 < b.i32;
	case ST_I64:
		return a.i64 < b.i64;
	case ST_F32:
		return a.f32 < b.f32;
	case ST_F64:
		return a.f64 < b.f64;
	case ST_BOOL:
		return false;
	default:
		return false;
	}
}

static bool value_greater_than(enum register_type type, union setting_value a,
			       union setting_value b)
{
	switch (type) {
	case ST_U8:
		return a.u8 > b.u8;
	case ST_U16:
		return a.u16 > b.u16;
	case ST_U32:
		return a.u32 > b.u32;
	case ST_U64:
		return a.u64 > b.u64;
	case ST_I8:
		return a.i8 > b.i8;
	case ST_I16:
		return a.i16 > b.i16;
	case ST_I32:
		return a.i32 > b.i32;
	case ST_I64:
		return a.i64 > b.i64;
	case ST_F32:
		return a.f32 > b.f32;
	case ST_F64:
		return a.f64 > b.f64;
	case ST_BOOL:
		return false;
	default:
		return false;
	}
}

/*============================================================================
 * Memory Access Helpers
 *============================================================================*/

static void read_value_from_mem(enum register_type type, const void *mem, union setting_value *out)
{
	switch (type) {
	case ST_U8:
		out->u8 = *(const uint8_t *)mem;
		break;
	case ST_U16:
		memcpy(&out->u16, mem, sizeof(uint16_t));
		break;
	case ST_U32:
		memcpy(&out->u32, mem, sizeof(uint32_t));
		break;
	case ST_U64:
		memcpy(&out->u64, mem, sizeof(uint64_t));
		break;
	case ST_I8:
		out->i8 = *(const int8_t *)mem;
		break;
	case ST_I16:
		memcpy(&out->i16, mem, sizeof(int16_t));
		break;
	case ST_I32:
		memcpy(&out->i32, mem, sizeof(int32_t));
		break;
	case ST_I64:
		memcpy(&out->i64, mem, sizeof(int64_t));
		break;
	case ST_F32:
		memcpy(&out->f32, mem, sizeof(float));
		break;
	case ST_F64:
		memcpy(&out->f64, mem, sizeof(double));
		break;
	case ST_BOOL:
		out->b = *(const bool *)mem;
		break;
	default:
		break;
	}
}

static void write_value_to_mem(enum register_type type, void *mem, union setting_value val)
{
	switch (type) {
	case ST_U8:
		*(uint8_t *)mem = val.u8;
		break;
	case ST_U16:
		memcpy(mem, &val.u16, sizeof(uint16_t));
		break;
	case ST_U32:
		memcpy(mem, &val.u32, sizeof(uint32_t));
		break;
	case ST_U64:
		memcpy(mem, &val.u64, sizeof(uint64_t));
		break;
	case ST_I8:
		*(int8_t *)mem = val.i8;
		break;
	case ST_I16:
		memcpy(mem, &val.i16, sizeof(int16_t));
		break;
	case ST_I32:
		memcpy(mem, &val.i32, sizeof(int32_t));
		break;
	case ST_I64:
		memcpy(mem, &val.i64, sizeof(int64_t));
		break;
	case ST_F32:
		memcpy(mem, &val.f32, sizeof(float));
		break;
	case ST_F64:
		memcpy(mem, &val.f64, sizeof(double));
		break;
	case ST_BOOL:
		*(bool *)mem = val.b;
		break;
	default:
		break;
	}
}

/*============================================================================
 * Validation
 *============================================================================*/

bool settings_reg_validate_range(const struct setting_reg *reg, union setting_value value)
{
	if (reg->flags & ST_FLAG_NO_RANGE) {
		return true;
	}

	if (value_less_than(reg->type, value, reg->min)) {
		return false;
	}
	if (value_greater_than(reg->type, value, reg->max)) {
		return false;
	}
	return true;
}

void settings_reg_get_default(const struct setting_reg *reg, union setting_value *value)
{
	*value = reg->dflt;
}

/*============================================================================
 * Range Helpers
 *============================================================================*/

static bool ranges_overlap(uint16_t a_start, uint16_t a_end, uint16_t b_start, uint16_t b_end)
{
	return (a_start < b_end) && (b_start < a_end);
}

/*============================================================================
 * Initialization Validation
 *============================================================================*/

/* Validate no areas overlap in address space */
static int validate_area_addresses(void)
{
	SETTINGS_AREA_FOREACH(ai)
	{
		uint16_t ai_end = ai->base + ai->size;

		SETTINGS_AREA_FOREACH(aj)
		{
			if (ai >= aj) {
				continue;
			}
			uint16_t aj_end = aj->base + aj->size;

			if (ranges_overlap(ai->base, ai_end, aj->base, aj_end)) {
				return -EINVAL;
			}
		}
	}
	return 0;
}

/* Validate registers within a register-backed area */
static int validate_reg_area(const struct setting_area *area, const struct setting_reg_ctx *ctx)
{
	for (int i = 0; i < ctx->reg_count; i++) {
		const struct setting_reg *ri = &ctx->regs[i];
		size_t ri_size = register_type_size(ri->type);

		/* Check register fits in struct */
		if (ri->offset + ri_size > area->size) {
			return -EINVAL;
		}

		/* Check register fits in address space */
		if (ri->addr + ri_size > area->size) {
			return -EINVAL;
		}

		/* Check no overlap with other registers */
		for (int j = i + 1; j < ctx->reg_count; j++) {
			const struct setting_reg *rj = &ctx->regs[j];
			size_t rj_size = register_type_size(rj->type);

			if (ranges_overlap(ri->addr, ri->addr + ri_size, rj->addr,
					   rj->addr + rj_size)) {
				return -EINVAL;
			}

			if (ranges_overlap(ri->offset, ri->offset + ri_size, rj->offset,
					   rj->offset + rj_size)) {
				return -EINVAL;
			}
		}

		/* Check default value is valid */
		if (!settings_reg_validate_range(ri, ri->dflt)) {
			return -ERANGE;
		}
	}
	return 0;
}

/* Apply default values to all registers in a register-backed area */
static void apply_reg_defaults(struct setting_reg_ctx *ctx)
{
	struct weave_observable *obs = ctx->observable;
	void *data = weave_observable_claim(obs, K_FOREVER);

	for (int i = 0; i < ctx->reg_count; i++) {
		const struct setting_reg *reg = &ctx->regs[i];
		void *mem = (uint8_t *)data + reg->offset;
		write_value_to_mem(reg->type, mem, reg->dflt);
	}

	weave_observable_publish(obs);
}

/*============================================================================
 * SYS_INIT
 *============================================================================*/

static int settings_sys_init(void)
{
	/* Validate area addresses don't overlap */
	int ret = validate_area_addresses();
	if (ret < 0) {
		return ret;
	}

	/* Validate register areas and apply defaults */
	SETTINGS_AREA_FOREACH(area)
	{
		struct setting_reg_ctx *ctx = setting_area_get_reg_ctx(area);
		if (ctx) {
			ret = validate_reg_area(area, ctx);
			if (ret < 0) {
				return ret;
			}
			apply_reg_defaults(ctx);
		}
	}

	settings_initialized = true;
	return 0;
}

SYS_INIT(settings_sys_init, APPLICATION, CONFIG_SETTINGS_INIT_PRIORITY);

/*============================================================================
 * Status API
 *============================================================================*/

bool settings_is_initialized(void)
{
	return settings_initialized;
}

size_t settings_area_count(void)
{
	size_t count = 0;
	SETTINGS_AREA_FOREACH(area)
	{
		(void)area;
		count++;
	}
	return count;
}

/*============================================================================
 * Lookup
 *============================================================================*/

const struct setting_area *settings_find_area(uint16_t addr)
{
	SETTINGS_AREA_FOREACH(area)
	{
		if (addr >= area->base && addr < area->base + area->size) {
			return area;
		}
	}
	return NULL;
}

const struct setting_reg *settings_find_reg(uint16_t addr)
{
	const struct setting_area *area = settings_find_area(addr);
	if (!area) {
		return NULL;
	}

	struct setting_reg_ctx *ctx = setting_area_get_reg_ctx(area);
	if (!ctx) {
		return NULL;
	}

	uint16_t offset = addr - area->base;
	for (int i = 0; i < ctx->reg_count; i++) {
		const struct setting_reg *r = &ctx->regs[i];
		if (r->addr == offset) {
			return r;
		}
	}
	return NULL;
}

/*============================================================================
 * Register Area Read/Write Callbacks
 *============================================================================*/

/* Check if a write touches any read-only register */
static int check_reg_write_access(const struct setting_reg_ctx *ctx, uint16_t offset, size_t len)
{
	uint16_t write_end = offset + len;

	for (int i = 0; i < ctx->reg_count; i++) {
		const struct setting_reg *r = &ctx->regs[i];
		size_t r_size = register_type_size(r->type);
		uint16_t r_end = r->addr + r_size;

		if (ranges_overlap(offset, write_end, r->addr, r_end)) {
			if (!(r->flags & ST_FLAG_W)) {
				return -EROFS;
			}
		}
	}
	return 0;
}

/* Validate all registers affected by a write */
static int validate_reg_write(const struct setting_reg_ctx *ctx, uint16_t offset, size_t len,
			      const uint8_t *proposed_data)
{
	uint16_t write_end = offset + len;

	for (int i = 0; i < ctx->reg_count; i++) {
		const struct setting_reg *r = &ctx->regs[i];
		size_t r_size = register_type_size(r->type);
		uint16_t r_end = r->addr + r_size;

		if (ranges_overlap(offset, write_end, r->addr, r_end)) {
			union setting_value val;
			read_value_from_mem(r->type, proposed_data + r->offset, &val);

			if (!settings_reg_validate_range(r, val)) {
				return -ERANGE;
			}
		}
	}
	return 0;
}

int setting_reg_read(const struct setting_area *area, uint16_t offset, void *buf, size_t len)
{
	struct setting_reg_ctx *ctx = (struct setting_reg_ctx *)area->ctx;
	struct weave_observable *obs = ctx->observable;

	if (offset + len > area->size) {
		len = area->size - offset;
	}

	/* Thread-safe read from observable */
	k_sem_take(&obs->sem, K_FOREVER);
	memcpy(buf, (uint8_t *)obs->value + offset, len);
	k_sem_give(&obs->sem);

	return (int)len;
}

int setting_reg_write(const struct setting_area *area, uint16_t offset, const void *buf, size_t len)
{
	struct setting_reg_ctx *ctx = (struct setting_reg_ctx *)area->ctx;
	struct weave_observable *obs = ctx->observable;

	if (offset + len > area->size) {
		len = area->size - offset;
	}

	/* Check write access (read-only registers) */
	int ret = check_reg_write_access(ctx, offset, len);
	if (ret < 0) {
		return ret;
	}

	/* Create temporary copy with proposed changes for validation */
	uint8_t temp[area->size];
	k_sem_take(&obs->sem, K_FOREVER);
	memcpy(temp, obs->value, area->size);
	k_sem_give(&obs->sem);
	memcpy(temp + offset, buf, len);

	/* Validate affected registers (per-register min/max) */
	ret = validate_reg_write(ctx, offset, len, temp);
	if (ret < 0) {
		return ret;
	}

	/* Validate via observable's validator (cross-register validation) */
	if (obs->validator) {
		ret = obs->validator(obs, temp, obs->owner_sink.user_data);
		if (ret < 0) {
			return ret;
		}
	}

	/* Claim, apply changes, and publish to all observers */
	void *data = weave_observable_claim(obs, K_FOREVER);
	memcpy((uint8_t *)data + offset, buf, len);
	weave_observable_publish(obs);

	return (int)len;
}

/*============================================================================
 * Read/Write API
 *============================================================================*/

int settings_read(uint16_t addr, void *buf, size_t len)
{
	if (!buf) {
		return -EINVAL;
	}

	if (!settings_initialized) {
		return -ENXIO;
	}

	const struct setting_area *area = settings_find_area(addr);
	if (!area) {
		return -ENOENT;
	}

	uint16_t offset = addr - area->base;
	return area->read(area, offset, buf, len);
}

int settings_write(uint16_t addr, const void *buf, size_t len)
{
	if (!buf) {
		return -EINVAL;
	}

	if (!settings_initialized) {
		return -ENXIO;
	}

	const struct setting_area *area = settings_find_area(addr);
	if (!area) {
		return -ENOENT;
	}

	uint16_t offset = addr - area->base;
	return area->write(area, offset, buf, len);
}

/*============================================================================
 * Register API
 *============================================================================*/

int settings_reg_get(const struct setting_area *area, const struct setting_reg *reg,
		     union setting_value *value)
{
	if (!area || !reg || !value) {
		return -EINVAL;
	}

	if (!settings_initialized) {
		return -ENXIO;
	}

	struct setting_reg_ctx *ctx = setting_area_get_reg_ctx(area);
	if (!ctx) {
		return -EINVAL;
	}

	if (!(reg->flags & ST_FLAG_R)) {
		return -EROFS;
	}

	struct weave_observable *obs = ctx->observable;
	k_sem_take(&obs->sem, K_FOREVER);
	void *mem = (uint8_t *)obs->value + reg->offset;
	read_value_from_mem(reg->type, mem, value);
	k_sem_give(&obs->sem);

	return 0;
}

int settings_reg_set(const struct setting_area *area, const struct setting_reg *reg,
		     union setting_value value)
{
	if (!area || !reg) {
		return -EINVAL;
	}

	if (!settings_initialized) {
		return -ENXIO;
	}

	struct setting_reg_ctx *ctx = setting_area_get_reg_ctx(area);
	if (!ctx) {
		return -EINVAL;
	}

	if (!(reg->flags & ST_FLAG_W)) {
		return -EROFS;
	}

	/* Validate range */
	if (!settings_reg_validate_range(reg, value)) {
		return -ERANGE;
	}

	struct weave_observable *obs = ctx->observable;

	/* Create temporary copy for struct validation */
	if (obs->validator) {
		uint8_t temp[area->size];
		k_sem_take(&obs->sem, K_FOREVER);
		memcpy(temp, obs->value, area->size);
		k_sem_give(&obs->sem);
		write_value_to_mem(reg->type, temp + reg->offset, value);

		int ret = obs->validator(obs, temp, obs->owner_sink.user_data);
		if (ret < 0) {
			return ret;
		}
	}

	/* Claim, apply change, and publish to all observers */
	void *data = weave_observable_claim(obs, K_FOREVER);
	void *mem = (uint8_t *)data + reg->offset;
	write_value_to_mem(reg->type, mem, value);
	weave_observable_publish(obs);

	return 0;
}

/*============================================================================
 * Reset to Defaults
 *============================================================================*/

int settings_reset_defaults(const struct setting_area *area)
{
	if (!settings_initialized) {
		return -ENXIO;
	}

	if (area) {
		/* Reset single area */
		struct setting_reg_ctx *ctx = setting_area_get_reg_ctx(area);
		if (!ctx) {
			return -EINVAL; /* Not a register area */
		}
		apply_reg_defaults(ctx);
	} else {
		/* Reset all register areas */
		SETTINGS_AREA_FOREACH(a)
		{
			struct setting_reg_ctx *ctx = setting_area_get_reg_ctx(a);
			if (ctx) {
				apply_reg_defaults(ctx);
			}
		}
	}

	return 0;
}

/*============================================================================
 * Debug
 *============================================================================*/

void settings_dump(void)
{
	LOG_INF("Settings Table: %zu areas, %s", settings_area_count(),
		settings_initialized ? "initialized" : "NOT initialized");

	SETTINGS_AREA_FOREACH(area)
	{
		struct setting_reg_ctx *ctx = setting_area_get_reg_ctx(area);

		if (ctx) {
			LOG_INF("  Area '%s' @ 0x%04x, size=%u, regs=%u", area->name, area->base,
				area->size, ctx->reg_count);

			for (int j = 0; j < ctx->reg_count; j++) {
				const struct setting_reg *r = &ctx->regs[j];
#if CONFIG_SETTINGS_REG_NAMES
				const char *name = r->name ? r->name : "?";
#else
				const char *name = "?";
#endif
				LOG_INF("    [0x%04x] %-16s %-4s %s", area->base + r->addr, name,
					register_type_name(r->type), flags_str(r->flags));
			}
		} else {
			LOG_INF("  Area '%s' @ 0x%04x, size=%u (custom)", area->name, area->base,
				area->size);
		}
	}
}
```

## src/settings_api.h
```c
/*
 * Copyright (c) 2026 Zephyr Project
 * SPDX-License-Identifier: Apache-2.0
 *
 * Settings Area API
 *
 * A layered settings system for embedded applications:
 *
 * Layer 1: Generic Areas
 *   - Areas with read/write callbacks
 *   - Registered via iterable sections
 *   - Base address, size, name
 *
 * Layer 2: Register Areas (built on Layer 1)
 *   - Struct-backed areas with register descriptors
 *   - Per-register min/max/default validation
 *   - Cross-register struct validation
 *   - Change notifications
 *
 * Custom areas (I/O mapped, proxied, virtual) can implement their own
 * read/write callbacks while coexisting with register-backed areas.
 */

#ifndef SETTINGS_API_H_
#define SETTINGS_API_H_

#include <stdint.h>
#include <stddef.h>
#include <stdbool.h>
#include <zephyr/sys/iterable_sections.h>
#include <weave/observable.h>

#ifdef __cplusplus
extern "C" {
#endif

/*============================================================================
 * Configuration
 *============================================================================*/

#ifndef CONFIG_SETTINGS_REG_NAMES
#define CONFIG_SETTINGS_REG_NAMES 1
#endif

#ifndef CONFIG_SETTINGS_INIT_PRIORITY
#define CONFIG_SETTINGS_INIT_PRIORITY 90
#endif

/*============================================================================
 * Error Codes (standard errno)
 *============================================================================
 *
 * Return values from read/write callbacks:
 *   >= 0     Number of bytes read/written
 *   -ERANGE  Value out of valid range
 *   -ENOENT  Address not mapped within area
 *   -EROFS   Write to read-only area/register
 *   -EINVAL  Invalid argument or validation failed
 *   -EIO     I/O error
 *
 * Additional errors from settings_read/write:
 *   -ENXIO   System not initialized
 *   -EFAULT  Access spans unmapped region (hole between areas)
 */

/*============================================================================
 * Forward Declarations
 *============================================================================*/

struct setting_area;
struct setting_reg;
struct setting_reg_ctx;

/*============================================================================
 * Generic Area Interface (Layer 1)
 *============================================================================*/

/**
 * Area read callback
 *
 * @param area   Pointer to area descriptor
 * @param offset Offset from area base (0 = first byte of area)
 * @param buf    Output buffer
 * @param len    Number of bytes to read
 * @return Number of bytes read (>= 0) or negative errno
 */
typedef int (*setting_area_read_t)(const struct setting_area *area, uint16_t offset, void *buf,
				   size_t len);

/**
 * Area write callback
 *
 * @param area   Pointer to area descriptor
 * @param offset Offset from area base (0 = first byte of area)
 * @param buf    Input buffer
 * @param len    Number of bytes to write
 * @return Number of bytes written (>= 0) or negative errno
 */
typedef int (*setting_area_write_t)(const struct setting_area *area, uint16_t offset,
				    const void *buf, size_t len);

/**
 * Generic area descriptor
 *
 * Base type for all settings areas. Custom areas implement their own
 * read/write callbacks. Register areas use the provided helpers.
 */
struct setting_area {
	const char *name;           /* Area name */
	uint16_t base;              /* Base address in settings space */
	uint16_t size;              /* Size in bytes */
	setting_area_read_t read;   /* Read callback */
	setting_area_write_t write; /* Write callback */
	void *ctx;                  /* Context for callbacks */
};

/*============================================================================
 * Register Area Interface (Layer 2)
 *============================================================================*/

/**
 * Register data types
 */
enum register_type {
	ST_U8 = 0,
	ST_U16,
	ST_U32,
	ST_U64,
	ST_I8,
	ST_I16,
	ST_I32,
	ST_I64,
	ST_F32,
	ST_F64,
	ST_BOOL,
	ST_TYPE_COUNT
};

/**
 * Type-safe value union
 */
union setting_value {
	uint8_t u8;
	uint16_t u16;
	uint32_t u32;
	uint64_t u64;
	int8_t i8;
	int16_t i16;
	int32_t i32;
	int64_t i64;
	float f32;
	double f64;
	bool b;
};

/**
 * Access flags for registers
 */
enum setting_flags {
	ST_FLAG_R = 0x01,       /* Readable */
	ST_FLAG_W = 0x02,       /* Writable */
	ST_FLAG_RW = 0x03,      /* Read-write */
	ST_FLAG_NO_RANGE = 0x04 /* Skip min/max validation */
};

/**
 * Register descriptor
 */
struct setting_reg {
#if CONFIG_SETTINGS_REG_NAMES
	const char *name; /* Register name for debugging */
#endif
	uint16_t addr;            /* Offset from area base */
	uint16_t offset;          /* Byte offset within backing struct */
	enum register_type type;  /* Data type */
	uint8_t flags;            /* Access flags (ST_FLAG_*) */
	union setting_value min;  /* Minimum valid value */
	union setting_value max;  /* Maximum valid value */
	union setting_value dflt; /* Default value */
};

/**
 * Register area context
 *
 * Contains all register-specific data. Passed as ctx to generic area.
 * Uses weave_observable for data storage and pub/sub notifications.
 */
struct setting_reg_ctx {
	struct weave_observable *observable; /* Observable holding the data */
	const struct setting_reg *regs;      /* Register descriptors */
	uint8_t reg_count;                   /* Number of registers */
};

/*============================================================================
 * Register Area Callbacks (provided by API)
 *============================================================================*/

/**
 * Read callback for register-backed areas
 *
 * Reads from the backing struct, respecting read permissions.
 */
int setting_reg_read(const struct setting_area *area, uint16_t offset, void *buf, size_t len);

/**
 * Write callback for register-backed areas
 *
 * Validates values, calls struct validator, updates backing struct,
 * calls change callback.
 */
int setting_reg_write(const struct setting_area *area, uint16_t offset, const void *buf,
		      size_t len);

/*============================================================================
 * Type Utilities
 *============================================================================*/

/**
 * Get size of a setting type in bytes
 */
size_t register_type_size(enum register_type type);

/**
 * Get name of a setting type
 */
const char *register_type_name(enum register_type type);

/*============================================================================
 * Register Definition Macros
 *============================================================================*/

#if CONFIG_SETTINGS_REG_NAMES
#define _ST_NAME(member) .name = #member,
#else
#define _ST_NAME(member)
#endif

/* Auto-detect type from struct member */
#define ST_TYPE_DETECT(_type, _member)                                                             \
	_Generic(((_type *)0)->_member,                                                            \
		uint8_t: ST_U8,                                                                    \
		uint16_t: ST_U16,                                                                  \
		uint32_t: ST_U32,                                                                  \
		uint64_t: ST_U64,                                                                  \
		int8_t: ST_I8,                                                                     \
		int16_t: ST_I16,                                                                   \
		int32_t: ST_I32,                                                                   \
		int64_t: ST_I64,                                                                   \
		float: ST_F32,                                                                     \
		double: ST_F64,                                                                    \
		bool: ST_BOOL,                                                                     \
		default: ST_U8)

/* Initialize value union with correct member */
#define ST_VALUE(_type, _member, _val)                                                             \
	_Generic(((_type *)0)->_member,                                                            \
		uint8_t: (union setting_value){.u8 = (_val)},                                      \
		uint16_t: (union setting_value){.u16 = (_val)},                                    \
		uint32_t: (union setting_value){.u32 = (_val)},                                    \
		uint64_t: (union setting_value){.u64 = (_val)},                                    \
		int8_t: (union setting_value){.i8 = (_val)},                                       \
		int16_t: (union setting_value){.i16 = (_val)},                                     \
		int32_t: (union setting_value){.i32 = (_val)},                                     \
		int64_t: (union setting_value){.i64 = (_val)},                                     \
		float: (union setting_value){.f32 = (_val)},                                       \
		double: (union setting_value){.f64 = (_val)},                                      \
		bool: (union setting_value){.b = (_val)},                                          \
		default: (union setting_value){.u8 = (_val)})

/**
 * Define a register descriptor
 *
 * @param _addr    Offset from area base
 * @param _type    Struct type
 * @param _member  Struct member name
 * @param _min     Minimum valid value
 * @param _max     Maximum valid value
 * @param _dflt    Default value
 * @param _flags   Access flags (ST_FLAG_*)
 */
#define REGISTER(_addr, _type, _member, _min, _max, _dflt, _flags)                                 \
	{                                                                                          \
		_ST_NAME(_member).addr = (_addr), .offset = offsetof(_type, _member),              \
		.type = ST_TYPE_DETECT(_type, _member), .flags = (_flags),                         \
		.min = ST_VALUE(_type, _member, _min), .max = ST_VALUE(_type, _member, _max),      \
		.dflt = ST_VALUE(_type, _member, _dflt)                                            \
	}

/**
 * Define a bool register (no min/max)
 */
#define REGISTER_BOOL(_addr, _type, _member, _dflt, _flags)                                        \
	{                                                                                          \
		_ST_NAME(_member).addr = (_addr), .offset = offsetof(_type, _member),              \
		.type = ST_BOOL, .flags = (_flags) | ST_FLAG_NO_RANGE, .dflt.b = (_dflt)           \
	}

/*============================================================================
 * Area Definition Macros
 *============================================================================*/

/**
 * Define a custom area with user-provided read/write callbacks
 *
 * @param _name      Area name (C identifier)
 * @param _base      Base address
 * @param _size      Size in bytes
 * @param _read      Read callback
 * @param _write     Write callback
 * @param _ctx       Context pointer for callbacks
 */
#define SETTING_AREA_DEFINE(_name, _base, _size, _read, _write, _ctx)                              \
	STRUCT_SECTION_ITERABLE(setting_area, _name##_area) = {                                    \
		.name = #_name,                                                                    \
		.base = (_base),                                                                   \
		.size = (_size),                                                                   \
		.read = (_read),                                                                   \
		.write = (_write),                                                                 \
		.ctx = (_ctx),                                                                     \
	}

/**
 * Define a complete register-backed settings area
 *
 * Creates the observable, register context, and area descriptor in one macro.
 * Auto-registered via iterable section.
 *
 * @param _name       Area name (C identifier)
 * @param _base       Base address
 * @param _type       Struct type for the settings data
 * @param _regs       Array of register descriptors
 * @param _reg_count  Number of registers
 * @param _handler    Owner handler (WV_NO_HANDLER if none)
 * @param _validator  Validator function (WV_NO_VALID if none)
 */
#define SETTING_REG_AREA_DEFINE(_name, _base, _type, _regs, _reg_count, _handler, _validator)      \
	WEAVE_OBSERVABLE_DEFINE(_name##_obs, _type, _handler, WV_IMMEDIATE, NULL, _validator);     \
	static struct setting_reg_ctx _name##_reg_ctx = {                                          \
		.observable = &_name##_obs,                                                        \
		.regs = (_regs),                                                                   \
		.reg_count = (_reg_count),                                                         \
	};                                                                                         \
	STRUCT_SECTION_ITERABLE(setting_area, _name##_area) = {                                    \
		.name = #_name,                                                                    \
		.base = (_base),                                                                   \
		.size = sizeof(_type),                                                             \
		.read = setting_reg_read,                                                          \
		.write = setting_reg_write,                                                        \
		.ctx = &_name##_reg_ctx,                                                           \
	}

/*============================================================================
 * Initialization API
 *============================================================================*/

/**
 * Check if settings system is initialized
 */
bool settings_is_initialized(void);

/**
 * Get number of registered areas
 */
size_t settings_area_count(void);

/*============================================================================
 * Access API
 *============================================================================*/

/**
 * Read from settings address space
 *
 * @param addr  Address to read from
 * @param buf   Output buffer
 * @param len   Number of bytes to read
 * @return Bytes read (>= 0) or negative errno
 */
int settings_read(uint16_t addr, void *buf, size_t len);

/**
 * Write to settings address space
 *
 * @param addr  Address to write to
 * @param buf   Input buffer
 * @param len   Number of bytes to write
 * @return Bytes written (>= 0) or negative errno
 */
int settings_write(uint16_t addr, const void *buf, size_t len);

/*============================================================================
 * Register-Specific API (for register-backed areas)
 *============================================================================*/

/**
 * Get register context from area (NULL if not a register area)
 */
static inline struct setting_reg_ctx *setting_area_get_reg_ctx(const struct setting_area *area)
{
	if (area->read == setting_reg_read) {
		return (struct setting_reg_ctx *)area->ctx;
	}
	return NULL;
}

/**
 * Read a register value
 *
 * @param area  Area containing the register
 * @param reg   Register descriptor
 * @param value Output value
 * @return 0 on success, negative errno on failure
 */
int settings_reg_get(const struct setting_area *area, const struct setting_reg *reg,
		     union setting_value *value);

/**
 * Write a register value
 *
 * @param area  Area containing the register
 * @param reg   Register descriptor
 * @param value Value to write
 * @return 0 on success, negative errno on failure
 */
int settings_reg_set(const struct setting_area *area, const struct setting_reg *reg,
		     union setting_value value);

/**
 * Reset area to default values (register areas only)
 *
 * @param area  Area to reset (NULL = all register areas)
 * @return 0 on success, negative errno on failure
 */
int settings_reset_defaults(const struct setting_area *area);

/*============================================================================
 * Lookup API
 *============================================================================*/

/**
 * Find area containing an address
 */
const struct setting_area *settings_find_area(uint16_t addr);

/**
 * Find register at address (register areas only)
 */
const struct setting_reg *settings_find_reg(uint16_t addr);

/*============================================================================
 * Utility API
 *============================================================================*/

/**
 * Get default value for a register
 */
void settings_reg_get_default(const struct setting_reg *reg, union setting_value *value);

/**
 * Check if value is within register's min/max range
 */
bool settings_reg_validate_range(const struct setting_reg *reg, union setting_value value);

/**
 * Print table structure for debugging
 */
void settings_dump(void);

#ifdef __cplusplus
}
#endif

#endif /* SETTINGS_API_H_ */
```

## src/settings_shell.c
```c
/*
 * Copyright (c) 2026 Zephyr Project
 * SPDX-License-Identifier: Apache-2.0
 *
 * Settings shell commands
 */

#include <zephyr/shell/shell.h>
#include <stdlib.h>
#include <errno.h>
#include "settings_api.h"

static int cmd_settings_read(const struct shell *sh, size_t argc, char **argv)
{
	if (argc < 3) {
		shell_error(sh, "Usage: settings read <addr> <len>");
		return -EINVAL;
	}

	uint16_t addr = strtoul(argv[1], NULL, 0);
	size_t len = strtoul(argv[2], NULL, 0);

	if (len > 64) {
		shell_error(sh, "Max read length is 64 bytes");
		return -EINVAL;
	}

	uint8_t buf[64];
	int ret = settings_read(addr, buf, len);
	if (ret < 0) {
		shell_error(sh, "Read failed: %d", ret);
		return ret;
	}

	shell_hexdump(sh, buf, ret);
	return 0;
}

static int cmd_settings_write(const struct shell *sh, size_t argc, char **argv)
{
	if (argc < 3) {
		shell_error(sh, "Usage: settings write <addr> <byte0> [byte1] ...");
		return -EINVAL;
	}

	uint16_t addr = strtoul(argv[1], NULL, 0);
	size_t len = argc - 2;

	if (len > 64) {
		shell_error(sh, "Max write length is 64 bytes");
		return -EINVAL;
	}

	uint8_t buf[64];
	for (size_t i = 0; i < len; i++) {
		buf[i] = strtoul(argv[2 + i], NULL, 0);
	}

	int ret = settings_write(addr, buf, len);
	if (ret < 0) {
		shell_error(sh, "Write failed: %d", ret);
		return ret;
	}

	shell_print(sh, "Wrote %d bytes to 0x%04x", ret, addr);
	return 0;
}

static int cmd_settings_reg_read(const struct shell *sh, size_t argc, char **argv)
{
	if (argc < 2) {
		shell_error(sh, "Usage: settings reg_read <addr>");
		return -EINVAL;
	}

	uint16_t addr = strtoul(argv[1], NULL, 0);

	const struct setting_area *area = settings_find_area(addr);
	if (!area) {
		shell_error(sh, "No area at 0x%04x", addr);
		return -ENOENT;
	}

	const struct setting_reg *reg = settings_find_reg(addr);
	if (!reg) {
		shell_error(sh, "No register at 0x%04x", addr);
		return -ENOENT;
	}

	union setting_value val;
	int ret = settings_reg_get(area, reg, &val);
	if (ret < 0) {
		shell_error(sh, "Read failed: %d", ret);
		return ret;
	}

#if CONFIG_SETTINGS_REG_NAMES
	const char *name = reg->name ? reg->name : "?";
#else
	const char *name = "?";
#endif

	switch (reg->type) {
	case ST_U8:
		shell_print(sh, "%s = %u", name, val.u8);
		break;
	case ST_U16:
		shell_print(sh, "%s = %u", name, val.u16);
		break;
	case ST_U32:
		shell_print(sh, "%s = %u", name, val.u32);
		break;
	case ST_I8:
		shell_print(sh, "%s = %d", name, val.i8);
		break;
	case ST_I16:
		shell_print(sh, "%s = %d", name, val.i16);
		break;
	case ST_I32:
		shell_print(sh, "%s = %d", name, val.i32);
		break;
	case ST_F32:
		shell_print(sh, "%s = %.2f", name, (double)val.f32);
		break;
	case ST_F64:
		shell_print(sh, "%s = %.2f", name, val.f64);
		break;
	case ST_BOOL:
		shell_print(sh, "%s = %s", name, val.b ? "true" : "false");
		break;
	default:
		break;
	}

	return 0;
}

static int cmd_settings_reg_write(const struct shell *sh, size_t argc, char **argv)
{
	if (argc < 3) {
		shell_error(sh, "Usage: settings reg_write <addr> <value>");
		return -EINVAL;
	}

	uint16_t addr = strtoul(argv[1], NULL, 0);

	const struct setting_area *area = settings_find_area(addr);
	if (!area) {
		shell_error(sh, "No area at 0x%04x", addr);
		return -ENOENT;
	}

	const struct setting_reg *reg = settings_find_reg(addr);
	if (!reg) {
		shell_error(sh, "No register at 0x%04x", addr);
		return -ENOENT;
	}

	union setting_value val = {0};
	switch (reg->type) {
	case ST_U8:
		val.u8 = strtoul(argv[2], NULL, 0);
		break;
	case ST_U16:
		val.u16 = strtoul(argv[2], NULL, 0);
		break;
	case ST_U32:
		val.u32 = strtoul(argv[2], NULL, 0);
		break;
	case ST_I8:
		val.i8 = strtol(argv[2], NULL, 0);
		break;
	case ST_I16:
		val.i16 = strtol(argv[2], NULL, 0);
		break;
	case ST_I32:
		val.i32 = strtol(argv[2], NULL, 0);
		break;
	case ST_F32:
		val.f32 = strtof(argv[2], NULL);
		break;
	case ST_F64:
		val.f64 = strtod(argv[2], NULL);
		break;
	case ST_BOOL:
		val.b = (strtoul(argv[2], NULL, 0) != 0);
		break;
	default:
		shell_error(sh, "Unknown type");
		return -EINVAL;
	}

	int ret = settings_reg_set(area, reg, val);
	if (ret < 0) {
		shell_error(sh, "Write failed: %d", ret);
		return ret;
	}

	shell_print(sh, "OK");
	return 0;
}

static int cmd_settings_dump(const struct shell *sh, size_t argc, char **argv)
{
	ARG_UNUSED(argc);
	ARG_UNUSED(argv);

	settings_dump();
	return 0;
}

static int cmd_settings_reset(const struct shell *sh, size_t argc, char **argv)
{
	ARG_UNUSED(argc);
	ARG_UNUSED(argv);

	int ret = settings_reset_defaults(NULL);
	if (ret < 0) {
		shell_error(sh, "Reset failed: %d", ret);
		return ret;
	}

	shell_print(sh, "Reset to defaults");
	return 0;
}

SHELL_STATIC_SUBCMD_SET_CREATE(
	settings_cmds,
	SHELL_CMD_ARG(read, NULL, "Read bytes: settings read <addr> <len>", cmd_settings_read, 3,
		      0),
	SHELL_CMD_ARG(write, NULL, "Write bytes: settings write <addr> <b0> [b1] ...",
		      cmd_settings_write, 3, 62),
	SHELL_CMD_ARG(reg_read, NULL, "Read register: settings reg_read <addr>",
		      cmd_settings_reg_read, 2, 0),
	SHELL_CMD_ARG(reg_write, NULL, "Write register: settings reg_write <addr> <value>",
		      cmd_settings_reg_write, 3, 0),
	SHELL_CMD(dump, NULL, "Dump settings table", cmd_settings_dump),
	SHELL_CMD(reset, NULL, "Reset to defaults", cmd_settings_reset), SHELL_SUBCMD_SET_END);

SHELL_CMD_REGISTER(settings, &settings_cmds, "Settings table commands", NULL);
```
