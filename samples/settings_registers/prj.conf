## CMakeLists.txt
```
# Copyright (c) 2026 Zephyr Project
# SPDX-License-Identifier: Apache-2.0

cmake_minimum_required(VERSION 3.20.0)
find_package(Zephyr REQUIRED HINTS $ENV{ZEPHYR_BASE})
project(settings_registers)

target_sources(app PRIVATE
    src/main.c
    src/settings.c
    src/motor_settings.c
    src/network_settings.c
)
```

## prj.conf
```kconfig
# Enable Weave framework
CONFIG_WEAVE=y
CONFIG_WEAVE_OBSERVABLE=y
CONFIG_WEAVE_LOG_LEVEL_INF=y

# Required kernel features
CONFIG_POLL=y

# Shell support
CONFIG_SHELL=y
CONFIG_SHELL_LOG_BACKEND=n

# Logging
CONFIG_LOG=y

# Assertions for development
CONFIG_ASSERT=y
```

## src/main.c
```c
/*
 * Copyright (c) 2026 Zephyr Project
 *
 * SPDX-License-Identifier: Apache-2.0
 */

#include <zephyr/kernel.h>
#include <zephyr/shell/shell.h>
#include <zephyr/logging/log.h>
#include <stdlib.h>
#include "settings.h"
#include "motor_settings.h"
#include "network_settings.h"

LOG_MODULE_REGISTER(app, LOG_LEVEL_INF);

/* ============================ Shell Commands ============================ */

static void print_field_value(const struct shell *sh, const struct setting_group *grp,
			      const struct setting_field *field, const void *buf)
{
	shell_fprintf(sh, SHELL_NORMAL, "%s.%s (%s) = ", grp->name, field->name,
		      setting_type_name(field->type));

	switch (field->type) {
	case SETTING_U8:
		shell_fprintf(sh, SHELL_NORMAL, "%u", *(uint8_t *)buf);
		break;
	case SETTING_U16:
		shell_fprintf(sh, SHELL_NORMAL, "%u", *(uint16_t *)buf);
		break;
	case SETTING_U32:
		shell_fprintf(sh, SHELL_NORMAL, "%u", *(uint32_t *)buf);
		break;
	case SETTING_U64:
		shell_fprintf(sh, SHELL_NORMAL, "%llu", *(uint64_t *)buf);
		break;
	case SETTING_I8:
		shell_fprintf(sh, SHELL_NORMAL, "%d", *(int8_t *)buf);
		break;
	case SETTING_I16:
		shell_fprintf(sh, SHELL_NORMAL, "%d", *(int16_t *)buf);
		break;
	case SETTING_I32:
		shell_fprintf(sh, SHELL_NORMAL, "%d", *(int32_t *)buf);
		break;
	case SETTING_I64:
		shell_fprintf(sh, SHELL_NORMAL, "%lld", *(int64_t *)buf);
		break;
	case SETTING_F32:
		shell_fprintf(sh, SHELL_NORMAL, "%.6g", (double)*(float *)buf);
		break;
	case SETTING_F64:
		shell_fprintf(sh, SHELL_NORMAL, "%.6g", *(double *)buf);
		break;
	case SETTING_BOOL:
		shell_fprintf(sh, SHELL_NORMAL, "%s", *(bool *)buf ? "true" : "false");
		break;
	default:
		shell_fprintf(sh, SHELL_NORMAL, "?");
		break;
	}
	shell_fprintf(sh, SHELL_NORMAL, "\n");
}

static int cmd_reg_read(const struct shell *sh, size_t argc, char **argv)
{
	if (argc != 2) {
		shell_error(sh, "Usage: reg read <addr>");
		return -EINVAL;
	}

	uint16_t reg = strtoul(argv[1], NULL, 0);
	struct weave_observable *obs;
	const struct setting_field *field;

	int ret = settings_find_reg(reg, &obs, &field);
	if (ret < 0) {
		shell_error(sh, "Read failed: %d", ret);
		return ret;
	}

	uint64_t value = 0;
	settings_field_get(obs, field, &value);
	print_field_value(sh, settings_get_group(obs), field, &value);
	return 0;
}

static int cmd_reg_write(const struct shell *sh, size_t argc, char **argv)
{
	if (argc != 3) {
		shell_error(sh, "Usage: reg write <addr> <value>");
		return -EINVAL;
	}

	uint16_t reg = strtoul(argv[1], NULL, 0);
	struct weave_observable *obs;
	const struct setting_field *field;

	int ret = settings_find_reg(reg, &obs, &field);
	if (ret < 0) {
		shell_error(sh, "Write failed: %d", ret);
		return ret;
	}

	uint64_t value = strtoul(argv[2], NULL, 0);
	ret = settings_field_set(obs, field, &value);
	if (ret < 0) {
		shell_error(sh, "Write failed: %d", ret);
		return ret;
	}

	print_field_value(sh, settings_get_group(obs), field, &value);
	return 0;
}

static int cmd_reg_bulkr(const struct shell *sh, size_t argc, char **argv)
{
	if (argc != 3) {
		shell_error(sh, "Usage: reg bulk <addr> <len>");
		return -EINVAL;
	}

	uint16_t reg = strtoul(argv[1], NULL, 0);
	size_t len = strtoul(argv[2], NULL, 0);

	if (len > 16) {
		shell_error(sh, "Max 16 bytes");
		return -EINVAL;
	}

	uint8_t buf[16] = {0};
	int ret = settings_read(reg, buf, len);
	if (ret < 0) {
		shell_error(sh, "Bulk read failed: %d", ret);
		return ret;
	}

	shell_fprintf(sh, SHELL_NORMAL, "reg 0x%04x [%d]: ", reg, ret);
	for (int i = 0; i < ret; i++) {
		shell_fprintf(sh, SHELL_NORMAL, "%02x", buf[i]);
	}
	shell_fprintf(sh, SHELL_NORMAL, "\n");
	return 0;
}

static int cmd_reg_bulkw(const struct shell *sh, size_t argc, char **argv)
{
	if (argc != 3) {
		shell_error(sh, "Usage: reg bulkw <addr> <hexstring>");
		return -EINVAL;
	}

	uint16_t reg = strtoul(argv[1], NULL, 0);
	const char *hex = argv[2];
	size_t hex_len = strlen(hex);

	if (hex_len % 2 != 0) {
		shell_error(sh, "Hex string must have even length");
		return -EINVAL;
	}

	size_t len = hex_len / 2;
	if (len > 16) {
		shell_error(sh, "Max 16 bytes");
		return -EINVAL;
	}

	uint8_t buf[16];
	for (size_t i = 0; i < len; i++) {
		char byte_str[3] = {hex[i * 2], hex[i * 2 + 1], '\0'};
		buf[i] = strtoul(byte_str, NULL, 16);
	}

	int ret = settings_write(reg, buf, len);
	if (ret < 0) {
		shell_error(sh, "Bulk write failed: %d", ret);
		return ret;
	}

	shell_print(sh, "Wrote %d bytes to 0x%04x", ret, reg);
	return 0;
}

static int cmd_reg_list(const struct shell *sh, size_t argc, char **argv)
{
	ARG_UNUSED(argc);
	ARG_UNUSED(argv);

	for (int i = 0; i < settings_get_count(); i++) {
		struct weave_observable *obs = settings_get_at(i);
		const struct setting_group *grp = settings_get_group(obs);

		shell_print(sh, "%s (base 0x%x):", grp->name, grp->base_reg);
		for (int j = 0; j < grp->field_count; j++) {
			const struct setting_field *f = &grp->fields[j];
			shell_print(sh, "  0x%03x: %s (%s)", grp->base_reg + f->reg, f->name,
				    setting_type_name(f->type));
		}
	}
	return 0;
}

static int cmd_get(const struct shell *sh, size_t argc, char **argv)
{
	ARG_UNUSED(argc);
	ARG_UNUSED(argv);

	for (int i = 0; i < settings_get_count(); i++) {
		struct weave_observable *obs = settings_get_at(i);
		const struct setting_group *grp = settings_get_group(obs);

		shell_fprintf(sh, SHELL_NORMAL, "%s: ", grp->name);
		for (int j = 0; j < grp->field_count; j++) {
			const struct setting_field *f = &grp->fields[j];
			uint32_t value = 0;
			settings_field_get(obs, f, &value);
			shell_fprintf(sh, SHELL_NORMAL, "%s=%u ", f->name, value);
		}
		shell_fprintf(sh, SHELL_NORMAL, "\n");
	}
	return 0;
}

SHELL_STATIC_SUBCMD_SET_CREATE(
	reg_cmds, SHELL_CMD(read, NULL, "Read field: reg read <addr>", cmd_reg_read),
	SHELL_CMD(write, NULL, "Write field: reg write <addr> <value>", cmd_reg_write),
	SHELL_CMD(bulkr, NULL, "Bulk read: reg bulkr <addr> <len>", cmd_reg_bulkr),
	SHELL_CMD(bulkw, NULL, "Bulk write: reg bulkw <addr> <hex...>", cmd_reg_bulkw),
	SHELL_CMD(list, NULL, "List all registers", cmd_reg_list), SHELL_SUBCMD_SET_END);

SHELL_CMD_REGISTER(reg, &reg_cmds, "Register commands", NULL);
SHELL_CMD_REGISTER(get, NULL, "Get all settings", cmd_get);

/* ============================ Main ============================ */

int main(void)
{
	LOG_INF("Settings Register Sample");
	LOG_INF("Commands: reg list, reg read <addr>, reg write <a> <v>, get");

	settings_register(&motor_settings);
	settings_register(&network_settings);

	LOG_INF("Settings initialized.");
	return 0;
}
```

## src/motor_settings.h
```c
/*
 * Copyright (c) 2026 Zephyr Project
 *
 * SPDX-License-Identifier: Apache-2.0
 */

#ifndef MOTOR_SETTINGS_H_
#define MOTOR_SETTINGS_H_

#include <weave/observable.h>

/* Motor settings observable (base register 0x100) */
extern struct weave_observable motor_settings;

#endif /* MOTOR_SETTINGS_H_ */
```

## src/network_settings.c
```c
/*
 * Copyright (c) 2026 Zephyr Project
 *
 * SPDX-License-Identifier: Apache-2.0
 */

#include <zephyr/kernel.h>
#include <zephyr/logging/log.h>
#include "settings.h"
#include "network_settings.h"

LOG_MODULE_DECLARE(app, LOG_LEVEL_INF);

/* Network configuration structure - internal to this compilation unit */
struct network_config {
	uint32_t ip_addr;  /* IPv4 address */
	uint16_t port;     /* Port number */
	bool dhcp_enabled; /* 0=static, 1=DHCP */
};

static const struct setting_field network_fields[] = {
	SETTING_FIELD_FROM_TYPE(0x00, struct network_config, ip_addr, SETTING_FLAG_RW),
	SETTING_FIELD_FROM_TYPE(0x04, struct network_config, port, SETTING_FLAG_RW),
	SETTING_FIELD_FROM_TYPE(0x06, struct network_config, dhcp_enabled, SETTING_FLAG_RW),
};

static const struct setting_group network_group = {
	.name = "network",
	.base_reg = 0x200,
	.size = sizeof(struct network_config),
	.fields = network_fields,
	.field_count = ARRAY_SIZE(network_fields),
};

/* Validator: port != 0 */
static int network_validate(struct weave_observable *obs, const void *new_value, void *user_data)
{
	ARG_UNUSED(obs);
	ARG_UNUSED(user_data);

	const struct network_config *cfg = new_value;

	if (cfg->port == 0) {
		return -EINVAL;
	}
	return 0;
}

/* Handler prints network settings on change */
static void on_network_changed(struct weave_observable *obs, void *user_data)
{
	ARG_UNUSED(user_data);

	struct network_config cfg;
	weave_observable_get_unchecked(obs, &cfg);
	LOG_INF("[NETWORK] ip=0x%08x port=%u dhcp=%u", cfg.ip_addr, cfg.port, cfg.dhcp_enabled);
}

SETTING_OBSERVABLE_DEFINE(network_settings, struct network_config, on_network_changed, WV_IMMEDIATE,
			  &network_group, network_validate);
```

## src/network_settings.h
```c
/*
 * Copyright (c) 2026 Zephyr Project
 *
 * SPDX-License-Identifier: Apache-2.0
 */

#ifndef NETWORK_SETTINGS_H_
#define NETWORK_SETTINGS_H_

#include <weave/observable.h>

/* Network settings observable (base register 0x200) */
extern struct weave_observable network_settings;

#endif /* NETWORK_SETTINGS_H_ */
```

## src/settings.h
```c
/*
 * Copyright (c) 2026 Zephyr Project
 *
 * SPDX-License-Identifier: Apache-2.0
 */

#ifndef SETTINGS_H_
#define SETTINGS_H_

#include <weave/observable.h>

/* Field access flags */
#define SETTING_FLAG_R  0x01
#define SETTING_FLAG_W  0x02
#define SETTING_FLAG_RW (SETTING_FLAG_R | SETTING_FLAG_W)

/* Field types */
enum setting_type {
	SETTING_U8,
	SETTING_U16,
	SETTING_U32,
	SETTING_U64,
	SETTING_I8,
	SETTING_I16,
	SETTING_I32,
	SETTING_I64,
	SETTING_F32,
	SETTING_F64,
	SETTING_BOOL,
};

/* Field descriptor */
struct setting_field {
	const char *name;
	uint8_t reg;     /* Offset from base */
	uint16_t offset; /* offsetof() in struct */
	enum setting_type type;
	uint8_t flags;
};

/* Setting group descriptor */
struct setting_group {
	const char *name;
	uint16_t base_reg;
	uint16_t size;
	const struct setting_field *fields;
	uint8_t field_count;
};

/* Type helpers */
uint8_t setting_type_size(enum setting_type type);
const char *setting_type_name(enum setting_type type);

/* Generic field definition (manual) */
#define SETTING_FIELD(_name, _reg, _offset, _setting_type, _flags)                                 \
	{                                                                                          \
		_name, _reg, _offset, _setting_type, _flags                                        \
	}

/* Auto-detect type from struct member using _Generic */
#define SETTING_TYPE_DETECT(_type, _member)                                                        \
	_Generic(((_type *)0)->_member,                                                            \
		uint8_t: SETTING_U8,                                                               \
		uint16_t: SETTING_U16,                                                             \
		uint32_t: SETTING_U32,                                                             \
		uint64_t: SETTING_U64,                                                             \
		int8_t: SETTING_I8,                                                                \
		int16_t: SETTING_I16,                                                              \
		int32_t: SETTING_I32,                                                              \
		int64_t: SETTING_I64,                                                              \
		float: SETTING_F32,                                                                \
		double: SETTING_F64,                                                               \
		_Bool: SETTING_BOOL,                                                               \
		default: SETTING_U8)

/* Field with auto-detected type (name stringified from member) */
#define SETTING_FIELD_FROM_TYPE(_reg, _type, _member, _flags)                                      \
	SETTING_FIELD(#_member, _reg, offsetof(_type, _member),                                    \
		      SETTING_TYPE_DETECT(_type, _member), _flags)

/* Define a settings observable - passes through to WEAVE_OBSERVABLE_DEFINE */
#define SETTING_OBSERVABLE_DEFINE WEAVE_OBSERVABLE_DEFINE

/* Registry API */
int settings_register(struct weave_observable *obs);
int settings_get_count(void);
struct weave_observable *settings_get_at(int index);

/* Lookup API */
int settings_find_reg(uint16_t reg, struct weave_observable **obs_out,
		      const struct setting_field **field_out);
const struct setting_field *settings_find_field(uint16_t reg);

/* Register API - generic read/write by address */
int settings_read(uint16_t reg, void *buf, size_t len);
int settings_write(uint16_t reg, const void *buf, size_t len);

/* Field API - direct access via field pointer */
int settings_field_get(struct weave_observable *obs, const struct setting_field *field, void *buf);
int settings_field_set(struct weave_observable *obs, const struct setting_field *field,
		       const void *buf);

/* Get group from observable */
static inline const struct setting_group *settings_get_group(struct weave_observable *obs)
{
	return (const struct setting_group *)obs->owner_sink.user_data;
}

#endif /* SETTINGS_H_ */
```
